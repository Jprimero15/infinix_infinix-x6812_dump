/dts-v1/;

/ {
	#address-cells = <0x2>;
	#size-cells = <0x2>;
	compatible = "mediatek,MT6768";
	interrupt-parent = <0x1>;
	model = "MT6768";

	__symbols__ {
		MCDI_CLUSTER = "/cpus/idle-states/mcdi-cluster";
		MCDI_CPU = "/cpus/idle-states/mcdi-cpu";
		STANDBY = "/cpus/idle-states/standby";
		SUSPEND = "/cpus/idle-states/suspend";
		accdet = "/accdet";
		afe = "/mt6768-afe-pcm@11220000";
		apdma = "/dma-controller@11000980";
		apmixed = "/apmixed@1000c000";
		apuart0 = "/serial@11002000";
		apuart1 = "/serial@11003000";
		aud_clk_miso_off = "/pinctrl/aud_clk_miso_off";
		aud_clk_miso_on = "/pinctrl/aud_clk_miso_on";
		aud_clk_mosi_off = "/pinctrl/aud_clk_mosi_off";
		aud_clk_mosi_on = "/pinctrl/aud_clk_mosi_on";
		aud_dat_miso_off = "/pinctrl/aud_dat_miso_off";
		aud_dat_miso_on = "/pinctrl/aud_dat_miso_on";
		aud_dat_mosi_off = "/pinctrl/aud_dat_mosi_off";
		aud_dat_mosi_on = "/pinctrl/aud_dat_mosi_on";
		aud_gpio_i2s0_off = "/pinctrl/aud_gpio_i2s0_off";
		aud_gpio_i2s0_on = "/pinctrl/aud_gpio_i2s0_on";
		aud_gpio_i2s1_off = "/pinctrl/aud_gpio_i2s1_off";
		aud_gpio_i2s1_on = "/pinctrl/aud_gpio_i2s1_on";
		aud_gpio_i2s2_off = "/pinctrl/aud_gpio_i2s2_off";
		aud_gpio_i2s2_on = "/pinctrl/aud_gpio_i2s2_on";
		audio = "/audio@11220000";
		auxadc = "/auxadc@11001000";
		bat_gm30 = "/battery";
		camera_af_hw_node = "/camera_af_hw_node";
		camsys = "/camsys@1a000000";
		charger = "/charger";
		chosen = "/chosen";
		clk26m = "/clocks/clk26m";
		clk32k = "/clocks/clk32k";
		consys = "/consys@18002000";
		cpu0 = "/cpus/cpu@000";
		cpu1 = "/cpus/cpu@001";
		cpu2 = "/cpus/cpu@002";
		cpu3 = "/cpus/cpu@003";
		cpu4 = "/cpus/cpu@100";
		cpu5 = "/cpus/cpu@101";
		cpu6 = "/cpus/cpu@102";
		cpu7 = "/cpus/cpu@103";
		cpu_dbgapb = "/cpu_dbgapb@0e010000";
		dcm = "/dcm";
		dfd_cache = "/dfd_cache";
		disp_color0 = "/disp_color0@1400f000";
		disp_mutex0 = "/disp_mutex0@14001000";
		doe_dvfs_cl0 = "/cpus/cpu-map/cluster0/doe";
		doe_dvfs_cl1 = "/cpus/cpu-map/cluster1/doe";
		drcc = "/drcc";
		dsi_te = "/dsi_te";
		dvfsp = "/dvfsp@00110800";
		dvfsrc = "/dvfsrc@10012000";
		eem_fsm = "/eem_fsm@1100b000";
		eint = "/apirq@1000b000";
		flashlight_core = "/flashlight_core";
		flashlights_aw36515 = "/flashlights_aw36515";
		flashlights_ocp81375 = "/flashlights_ocp81375";
		gce = "/gce@10238000";
		gce_mbox = "/gce_mbox@10238000";
		gce_mbox_bdg = "/gce_mbox_bdg";
		gce_mbox_svp = "/gce_mbox_svp@10238000";
		gic = "/interrupt-controller";
		goodix_fp = "/fingerprint";
		gpio = "/gpio@10005000";
		gpio_usage_mapping = "/gpio";
		hwrng = "/hwrng";
		i2c0 = "/i2c0@11007000";
		i2c1 = "/i2c1@11008000";
		i2c2 = "/i2c2@11009000";
		i2c3 = "/i2c3@1100f000";
		i2c4 = "/i2c4@11011000";
		i2c5 = "/i2c5@11016000";
		i2c6 = "/i2c6@1100d000";
		i2c7 = "/i2c7@11004000";
		i2c8 = "/i2c8@11005000";
		i2c_common = "/i2c_common";
		idlebus26m = "/cpus/idle-states/idlebus26m";
		idledram = "/cpus/idle-states/idledram";
		idlesyspll = "/cpus/idle-states/idlesyspll";
		imgsys = "/imgsys@15020000";
		infracfg_ao = "/infracfg_ao@10001000";
		io_cfg_bl = "/io_cfg_bl@10002600";
		io_cfg_lb = "/io_cfg_lb@10002400";
		io_cfg_lm = "/io_cfg_lm@10002200";
		io_cfg_lt = "/io_cfg_lt@10002000";
		io_cfg_rb = "/io_cfg_rb@10002a00";
		io_cfg_rm = "/io_cfg_rm@10002800";
		io_cfg_rt = "/io_cfg_rt@10002c00";
		io_cfg_tl = "/io_cfg_tl@10002e00";
		irq_nfc = "/irq_nfc";
		irtx_pwm = "/irtx_pwm";
		kd_camera_hw1 = "/kd_camera_hw1@1a040000";
		keypad = "/kp@10010000";
		lk_charger = "/lk_charger";
		main_pmic = "/pwrap@1000d000/mt6358-pmic";
		mcdi = "/mcdi@0010fc00";
		mcucfg = "/mcucfg@0c530000";
		md1_sim1_hot_plug_eint = "/md1_sim1_hot_plug_eint";
		md1_sim2_hot_plug_eint = "/md1_sim2_hot_plug_eint";
		md_auxadc = "/md_auxadc";
		mdcldma = "/mdcldma@10014000";
		mdp_ccorr = "/mdp_ccorr0@14005000";
		mdp_rdma0 = "/mdp_rdma0@14004000";
		mdp_rsz0 = "/mdp_rsz0@14006000";
		mdp_rsz1 = "/mdp_rsz1@14007000";
		mdp_tdshp0 = "/mdp_tdshp0@1400a000";
		mdp_wdma0 = "/mdp_wdma0@14008000";
		mdp_wrot0 = "/mdp_wrot0@14009000";
		memory_ssmr_features = "/memory-ssmr-features";
		mfg_cfg = "/mfg_cfg@13000000";
		mipi_rx_ana_csi0a = "/mipi_rx_ana_csi0a@11c10000";
		mipi_rx_ana_csi0b = "/mipi_rx_ana_csi0b@11c11000";
		mipi_rx_ana_csi1a = "/mipi_rx_ana_csi1a@11c12000";
		mipi_rx_ana_csi1b = "/mipi_rx_ana_csi1b@11c13000";
		mipi_rx_ana_csi2a = "/mipi_rx_ana_csi2a@11c14000";
		mipi_rx_ana_csi2b = "/mipi_rx_ana_csi2b@11c15000";
		mmsys_config = "/mmsys_config@14000000";
		mrdump_ext_rst = "/mrdump_ext_rst";
		msdc0 = "/msdc@11230000";
		msdc0_pins_default = "/pinctrl/msdc0@default";
		msdc0_pins_hs200 = "/pinctrl/msdc0@hs200";
		msdc0_pins_hs400 = "/pinctrl/msdc0@hs400";
		msdc0_register_setting_default = "/pinctrl/msdc0@register_default";
		msdc1 = "/msdc@11240000";
		msdc1_pins_ddr50 = "/pinctrl/msdc1@ddr50";
		msdc1_pins_default = "/pinctrl/msdc1@default";
		msdc1_pins_sdr104 = "/pinctrl/msdc1@sdr104";
		msdc1_pins_sdr50 = "/pinctrl/msdc1@sdr50";
		msdc1_register_setting_default = "/pinctrl/msdc1@register_default";
		mt6358_misc = "/pwrap@1000d000/mt6358-pmic/mt6358_misc";
		mt6358_rtc = "/pwrap@1000d000/mt6358-pmic/mt6358_rtc";
		mt6358_snd = "/mt6358_snd";
		mt6358regulator = "/pwrap@1000d000/mt6358-pmic/mt6358regulator";
		mt6370_pmu = "/mt6370_pmu_dts";
		mt6370_typec = "/type_c_port0";
		mt_charger = "/mt_charger";
		mt_cpufreq = "/mt_cpufreq";
		mt_pmic_va09_ldo_reg = "/pwrap@1000d000/mt6358-pmic/mt6358regulator/ldo_va09";
		mt_pmic_va12_ldo_reg = "/pwrap@1000d000/mt6358-pmic/mt6358regulator/ldo_va12";
		mt_pmic_vaud28_ldo_reg = "/pwrap@1000d000/mt6358-pmic/mt6358regulator/ldo_vaud28";
		mt_pmic_vaux18_ldo_reg = "/pwrap@1000d000/mt6358-pmic/mt6358regulator/ldo_vaux18";
		mt_pmic_vbif28_ldo_reg = "/pwrap@1000d000/mt6358-pmic/mt6358regulator/ldo_vbif28";
		mt_pmic_vcama1_ldo_reg = "/pwrap@1000d000/mt6358-pmic/mt6358regulator/ldo_vcama1";
		mt_pmic_vcama2_ldo_reg = "/pwrap@1000d000/mt6358-pmic/mt6358regulator/ldo_vcama2";
		mt_pmic_vcamd_ldo_reg = "/pwrap@1000d000/mt6358-pmic/mt6358regulator/ldo_vcamd";
		mt_pmic_vcamio_ldo_reg = "/pwrap@1000d000/mt6358-pmic/mt6358regulator/ldo_vcamio";
		mt_pmic_vcn18_ldo_reg = "/pwrap@1000d000/mt6358-pmic/mt6358regulator/ldo_vcn18";
		mt_pmic_vcn28_ldo_reg = "/pwrap@1000d000/mt6358-pmic/mt6358regulator/ldo_vcn28";
		mt_pmic_vcn33_bt_ldo_reg = "/pwrap@1000d000/mt6358-pmic/mt6358regulator/ldo_vcn33_bt";
		mt_pmic_vcn33_wifi_ldo_reg = "/pwrap@1000d000/mt6358-pmic/mt6358regulator/ldo_vcn33_wifi";
		mt_pmic_vcore_buck_reg = "/pwrap@1000d000/mt6358-pmic/mt6358regulator/buck_vcore";
		mt_pmic_vdram1_buck_reg = "/pwrap@1000d000/mt6358-pmic/mt6358regulator/buck_vdram1";
		mt_pmic_vdram2_ldo_reg = "/pwrap@1000d000/mt6358-pmic/mt6358regulator/ldo_vdram2";
		mt_pmic_vefuse_ldo_reg = "/pwrap@1000d000/mt6358-pmic/mt6358regulator/ldo_vefuse";
		mt_pmic_vemc_ldo_reg = "/pwrap@1000d000/mt6358-pmic/mt6358regulator/ldo_vemc";
		mt_pmic_vfe28_ldo_reg = "/pwrap@1000d000/mt6358-pmic/mt6358regulator/ldo_vfe28";
		mt_pmic_vgpu_buck_reg = "/pwrap@1000d000/mt6358-pmic/mt6358regulator/buck_vgpu";
		mt_pmic_vibr_ldo_reg = "/pwrap@1000d000/mt6358-pmic/mt6358regulator/ldo_vibr";
		mt_pmic_vio18_ldo_reg = "/pwrap@1000d000/mt6358-pmic/mt6358regulator/ldo_vio18";
		mt_pmic_vio28_ldo_reg = "/pwrap@1000d000/mt6358-pmic/mt6358regulator/ldo_vio28";
		mt_pmic_vldo28_ldo_reg = "/pwrap@1000d000/mt6358-pmic/mt6358regulator/ldo_vldo28";
		mt_pmic_vmc_ldo_reg = "/pwrap@1000d000/mt6358-pmic/mt6358regulator/ldo_vmc";
		mt_pmic_vmch_ldo_reg = "/pwrap@1000d000/mt6358-pmic/mt6358regulator/ldo_vmch";
		mt_pmic_vmodem_buck_reg = "/pwrap@1000d000/mt6358-pmic/mt6358regulator/buck_vmodem";
		mt_pmic_vpa_buck_reg = "/pwrap@1000d000/mt6358-pmic/mt6358regulator/buck_vpa";
		mt_pmic_vproc11_buck_reg = "/pwrap@1000d000/mt6358-pmic/mt6358regulator/buck_vproc11";
		mt_pmic_vproc12_buck_reg = "/pwrap@1000d000/mt6358-pmic/mt6358regulator/buck_vproc12";
		mt_pmic_vrf12_ldo_reg = "/pwrap@1000d000/mt6358-pmic/mt6358regulator/ldo_vrf12";
		mt_pmic_vrf18_ldo_reg = "/pwrap@1000d000/mt6358-pmic/mt6358regulator/ldo_vrf18";
		mt_pmic_vs1_buck_reg = "/pwrap@1000d000/mt6358-pmic/mt6358regulator/buck_vs1";
		mt_pmic_vs2_buck_reg = "/pwrap@1000d000/mt6358-pmic/mt6358regulator/buck_vs2";
		mt_pmic_vsim1_ldo_reg = "/pwrap@1000d000/mt6358-pmic/mt6358regulator/ldo_vsim1";
		mt_pmic_vsim2_ldo_reg = "/pwrap@1000d000/mt6358-pmic/mt6358regulator/ldo_vsim2";
		mt_pmic_vsram_gpu_ldo_reg = "/pwrap@1000d000/mt6358-pmic/mt6358regulator/ldo_vsram_gpu";
		mt_pmic_vsram_others_ldo_reg = "/pwrap@1000d000/mt6358-pmic/mt6358regulator/ldo_vsram_others";
		mt_pmic_vsram_proc11_ldo_reg = "/pwrap@1000d000/mt6358-pmic/mt6358regulator/ldo_vsram_proc11";
		mt_pmic_vsram_proc12_ldo_reg = "/pwrap@1000d000/mt6358-pmic/mt6358regulator/ldo_vsram_proc12";
		mt_pmic_vusb_ldo_reg = "/pwrap@1000d000/mt6358-pmic/mt6358regulator/ldo_vusb";
		mt_pmic_vxo22_ldo_reg = "/pwrap@1000d000/mt6358-pmic/mt6358regulator/ldo_vxo22";
		mtkfb = "/mtkfb@0";
		nfc = "/nfc";
		odm = "/odm";
		otg_iddig = "/otg_iddig";
		pericfg = "/pericfg@10003000";
		pio = "/pinctrl";
		pmic = "/pwrap@1000d000/mt6358-pmic/mt-pmic";
		pmic_auxadc = "/pwrap@1000d000/mt6358-pmic/mt635x-auxadc";
		pmic_clock_buffer_ctrl = "/pmic_clock_buffer_ctrl";
		pwrap = "/pwrap@1000d000";
		pwraph = "/pwraphal@";
		radio_md_cfg = "/radio_md_cfg";
		reserved_memory = "/reserved-memory";
		scpsys = "/scpsys@10001000";
		sleep = "/sleep@10006000";
		smart_pa = "/smart_pa";
		smi_larb0 = "/smi_larb0@14003000";
		smi_larb1 = "/smi_larb1@16010000";
		smi_larb2 = "/smi_larb2@15021000";
		smi_larb3 = "/smi_larb3@1a002000";
		smi_larb4 = "/smi_larb4@17010000";
		snd_scp_spk = "/snd_scp_spk";
		sound = "/sound";
		speaker_amp = "/i2c7@11004000/speaker_amp@34";
		spi0 = "/spi0@1100a000";
		spi1 = "/spi1@11010000";
		spi2 = "/spi2@11012000";
		spi3 = "/spi3@11013000";
		spi4 = "/spi4@11014000";
		spi5 = "/spi5@11015000";
		sysirq = "/intpol-controller@0";
		tboard_thermistor1 = "/thermal-sensor1";
		tboard_thermistor2 = "/thermal-sensor2";
		timer = "/timer";
		topckgen = "/topckgen@10000000";
		toprgu = "/toprgu@10007000";
		touch = "/touch";
		tran_battery = "/tran_battery";
		tran_battery_aging = "/tran_battery_aging";
		vcu = "/vcu@16000000";
		vdec_gcon = "/vdec_gcon@16000000";
		venc_gcon = "/venc_gcon@17000000";
		vow_clk_miso_off = "/pinctrl/vow_clk_miso_off";
		vow_clk_miso_on = "/pinctrl/vow_clk_miso_on";
		vow_dat_miso_off = "/pinctrl/vow_dat_miso_off";
		vow_dat_miso_on = "/pinctrl/vow_dat_miso_on";
		wifi_mem = "/reserved-memory/wifi-reserve-memory";
	};

	accdet {
		compatible = "mediatek,pmic-accdet";
		phandle = <0xa9>;
	};

	aes_top0@10016000 {
		compatible = "mediatek,aes_top0";
		reg = <0x0 0x10016000 0x0 0x1000>;
	};

	amms_control {
		compatible = "mediatek,amms";
		interrupts = <0x0 0x131 0x1>;
	};

	ap_ccif0@10209000 {
		compatible = "mediatek,ap_ccif0";
		interrupts = <0x0 0xa4 0x8>;
		reg = <0x0 0x10209000 0x0 0x1000>;
	};

	ap_ccif1@1020b000 {
		compatible = "mediatek,ap_ccif1";
		interrupts = <0x0 0xa6 0x8>;
		reg = <0x0 0x1020b000 0x0 0x1000>;
	};

	ap_ccif2@1023c000 {
		compatible = "mediatek,ap_ccif2";
		interrupts = <0x0 0xa0 0x8>;
		reg = <0x0 0x1023c000 0x0 0x1000>;
	};

	ap_ccif3@1023e000 {
		compatible = "mediatek,ap_ccif3";
		interrupts = <0x0 0xa3 0x8>;
		reg = <0x0 0x1023e000 0x0 0x1000>;
	};

	ap_dma@11000000 {
		compatible = "mediatek,ap_dma";
		interrupts = <0x0 0x66 0x8>;
		reg = <0x0 0x11000000 0x0 0x1000>;
	};

	apcldmain@1021b000 {
		compatible = "mediatek,apcldmain";
		reg = <0x0 0x1021b000 0x0 0x100>;
	};

	apcldmain@1021b100 {
		compatible = "mediatek,apcldmain";
		reg = <0x0 0x1021b100 0x0 0x100>;
	};

	apcldmain_ao@10014000 {
		compatible = "mediatek,apcldmain_ao";
		reg = <0x0 0x10014000 0x0 0x400>;
	};

	apcldmamisc@1021b800 {
		compatible = "mediatek,apcldmamisc";
		interrupts = <0x0 0xb4 0x4>;
		reg = <0x0 0x1021b800 0x0 0x100>;
	};

	apcldmamisc@1021b900 {
		compatible = "mediatek,apcldmamisc";
		reg = <0x0 0x1021b900 0x0 0x400>;
	};

	apcldmamisc_ao@10014800 {
		compatible = "mediatek,apcldmamisc_ao";
		reg = <0x0 0x10014800 0x0 0x400>;
	};

	apcldmamisc_ao@10014c00 {
		compatible = "mediatek,apcldmamisc_ao";
		reg = <0x0 0x10014c00 0x0 0x400>;
	};

	apcldmaout@1021b400 {
		compatible = "mediatek,apcldmaout";
		reg = <0x0 0x1021b400 0x0 0x100>;
	};

	apcldmaout@1021b500 {
		compatible = "mediatek,apcldmaout";
		reg = <0x0 0x1021b500 0x0 0x100>;
	};

	apcldmaout_ao@10014400 {
		compatible = "mediatek,apcldmaout_ao";
		reg = <0x0 0x10014400 0x0 0x400>;
	};

	apirq@1000b000 {
		compatible = "mediatek,apirq";
		interrupts = <0x0 0xba 0x4>;
		phandle = <0x1d>;
		reg = <0x0 0x1000b000 0x0 0x1000>;
	};

	apmixed@1000c000 {
		#clock-cells = <0x1>;
		compatible = "mediatek,apmixed", "syscon";
		phandle = <0x3e>;
		reg = <0x0 0x1000c000 0x0 0x1000>;
	};

	apxgpt@10008000 {
		clocks = <0x1f>;
		compatible = "mediatek,apxgpt";
		interrupts = <0x0 0xb9 0x8>;
		reg = <0x0 0x10008000 0x0 0x1000>;
	};

	atf_logger {
		compatible = "mediatek,atf_logger";
		interrupts = <0x0 0x128 0x1>;
	};

	audio@11220000 {
		#clock-cells = <0x1>;
		compatible = "mediatek,audio", "syscon";
		phandle = <0x3f>;
		reg = <0x0 0x11220000 0x0 0x1000>;
	};

	audio_sram@11221000 {
		block_size = <0x1000>;
		compatible = "mediatek,audio_sram";
		mode_size = <0x6c00 0x9000>;
		prefer_mode = <0x1>;
		reg = <0x0 0x11221000 0x0 0x9000>;
	};

	auxadc@11001000 {
		#io-channel-cells = <0x1>;
		clock-names = "main";
		clocks = <0x21 0x21>;
		compatible = "mediatek,mt6768-auxadc";
		interrupts = <0x0 0x42 0x2>;
		mediatek,cali-efuse-index = <0x6a>;
		mediatek,cali-en-bit = <0x14>;
		mediatek,cali-ge-bit = <0xa>;
		mediatek,cali-oe-bit = <0x0>;
		phandle = <0x23>;
		reg = <0x0 0x11001000 0x0 0x1000>;
	};

	battery {
		ACTIVE_TABLE = <0x6>;
		CAR_TUNE_VALUE = <0x64>;
		COM_FG_METER_RESISTANCE = <0x64>;
		COM_R_FG_VALUE = <0x0>;
		DIFFERENCE_FULLOCV_ITH = <0xc8>;
		EMBEDDED_SEL = <0x1>;
		FG_METER_RESISTANCE = <0x64>;
		KEEP_100_PERCENT = <0x1>;
		MULTI_TEMP_GAUGE0 = <0x1>;
		PMIC_MIN_VOL = <0x82dc>;
		PMIC_SHUTDOWN_CURRENT = <0x14>;
		POWERON_SYSTEM_IBOOT = <0x1f4>;
		Q_MAX_SYS_VOLTAGE_BAT0 = <0xd16>;
		Q_MAX_SYS_VOLTAGE_BAT1 = <0xd16>;
		Q_MAX_SYS_VOLTAGE_BAT2 = <0xd16>;
		Q_MAX_SYS_VOLTAGE_BAT3 = <0xd16>;
		R_FG_VALUE = <0x5>;
		SHUTDOWN_1_TIME = <0x1e>;
		SHUTDOWN_GAUGE0_VOLTAGE = <0x84d0>;
		SHUTDOWN_GAUGE1_VBAT_EN = <0x1>;
		TEMPERATURE_T0 = <0x32>;
		TEMPERATURE_T1 = <0x19>;
		TEMPERATURE_T2 = <0xa>;
		TEMPERATURE_T3 = <0x0>;
		TEMPERATURE_T4 = <0xfffffffa>;
		TEMPERATURE_T5 = <0xfffffff6>;
		UI_LOW_LIMIT_SOC0 = <0xc8>;
		UI_LOW_LIMIT_SOC1 = <0xc8>;
		UI_LOW_LIMIT_SOC2 = <0xc8>;
		UI_LOW_LIMIT_SOC3 = <0xc8>;
		UI_LOW_LIMIT_SOC4 = <0xc8>;
		UI_LOW_LIMIT_VTH0 = <0x87f0>;
		UI_LOW_LIMIT_VTH1 = <0x87f0>;
		UI_LOW_LIMIT_VTH2 = <0x87f0>;
		UI_LOW_LIMIT_VTH3 = <0x87f0>;
		UI_LOW_LIMIT_VTH4 = <0x87f0>;
		battery0_profile_t0 = <0x0 0xaae7 0x359 0x1f9 0xaa1b 0x358 0x3f3 0xa9c8 0x35e 0x5ec 0xa958 0x354 0x7e5 0xa8eb 0x358 0x9de 0xa87e 0x359 0xbd8 0xa7bd 0x358 0xdd1 0xa757 0x358 0xfca 0xa6ff 0x35a 0x11c3 0xa6ad 0x35c 0x13bd 0xa62e 0x361 0x15b6 0xa55a 0x360 0x17af 0xa50b 0x360 0x19a8 0xa4b2 0x35f 0x1ba2 0xa43c 0x356 0x1d9b 0xa3cf 0x357 0x1f94 0xa30b 0x356 0x218d 0xa2b5 0x355 0x2387 0xa258 0x36a 0x2580 0xa1ef 0x36b 0x2779 0xa187 0x36a 0x2973 0xa120 0x369 0x2b6c 0xa0b4 0x375 0x2d65 0xa051 0x374 0x2f5e 0x9fe4 0x36a 0x3158 0x9f23 0x38a 0x3351 0x9ecf 0x39a 0x354a 0x9e70 0x3a8 0x3743 0x9e03 0x3b3 0x393d 0x9da0 0x3b6 0x3b36 0x9d32 0x3bc 0x3d2f 0x9cca 0x3c7 0x3f28 0x9ca9 0x3b6 0x4122 0x9c6d 0x3c8 0x431b 0x9c0b 0x3d0 0x4514 0x9ba9 0x3c3 0x470d 0x9b40 0x3ca 0x4907 0x9ad8 0x3f2 0x4b00 0x9a77 0x3f8 0x4cf9 0x9a4b 0x3fe 0x4ef3 0x99f3 0x40c 0x50ec 0x9984 0x3fc 0x52e5 0x98f9 0x3c2 0x54de 0x986f 0x38b 0x56d8 0x9803 0x375 0x58d1 0x97ae 0x370 0x5aca 0x9764 0x367 0x5cc3 0x9721 0x362 0x5ebd 0x96e1 0x360 0x60b6 0x96a5 0x362 0x62af 0x966d 0x363 0x64a8 0x9636 0x362 0x66a2 0x9603 0x369 0x689b 0x95d0 0x367 0x6a94 0x959e 0x364 0x6c8d 0x9571 0x36c 0x6e87 0x9545 0x36c 0x7080 0x951c 0x372 0x7279 0x94f2 0x376 0x7472 0x94cc 0x37c 0x766c 0x94a6 0x383 0x7865 0x9481 0x389 0x7a5e 0x945f 0x38a 0x7c58 0x9440 0x39a 0x7e51 0x9422 0x3a2 0x804a 0x9403 0x3ac 0x8243 0x93e6 0x3b6 0x843d 0x93c9 0x3bc 0x8636 0x93a4 0x3bc 0x882f 0x936a 0x39d 0x8a28 0x931a 0x36e 0x8c22 0x92cf 0x365 0x8e1b 0x9299 0x36b 0x9014 0x926b 0x374 0x920d 0x9240 0x37f 0x9407 0x9210 0x37e 0x9600 0x91e3 0x375 0x97f9 0x91bc 0x375 0x99f2 0x9199 0x373 0x9bec 0x9177 0x381 0x9de5 0x914c 0x388 0x9fde 0x9119 0x388 0xa1d8 0x90d9 0x385 0xa3d1 0x909c 0x37d 0xa5ca 0x9061 0x382 0xa7c3 0x901a 0x384 0xa9bd 0x8fcc 0x360 0xabb6 0x8fae 0x35c 0xadaf 0x8fa4 0x371 0xafa8 0x8f9b 0x398 0xb1a2 0x8f8e 0x3bb 0xb39b 0x8f75 0x3f5 0xb594 0x8f3f 0x41f 0xb78d 0x8e66 0x3bd 0xb987 0x8cd5 0x3c2 0xbb80 0x8ac2 0x3fc 0xbd79 0x880b 0x420 0xbf72 0x83c5 0x48d 0xc16c 0x7bee 0x6d9 0xc365 0x7bee 0x6cf>;
		battery0_profile_t0_col = <0x3>;
		battery0_profile_t0_num = <0x64>;
		battery0_profile_t1 = <0x0 0xab4e 0x32f 0x1f9 0xaaed 0x32e 0x3f3 0xaa58 0x32e 0x5ec 0xa9e0 0x32f 0x7e5 0xa969 0x32f 0x9de 0xa8e9 0x32a 0xbd8 0xa87b 0x32a 0xdd1 0xa801 0x326 0xfca 0xa762 0x32e 0x11c3 0xa710 0x321 0x13bd 0xa698 0x324 0x15b6 0xa61f 0x326 0x17af 0xa5d3 0x32a 0x19a8 0xa531 0x32b 0x1ba2 0xa4bd 0x330 0x1d9b 0xa43c 0x331 0x1f94 0xa3d3 0x339 0x218d 0xa35f 0x33b 0x2387 0xa315 0x33b 0x2580 0xa277 0x33b 0x2779 0xa209 0x346 0x2973 0xa18e 0x344 0x2b6c 0xa129 0x357 0x2d65 0xa0bb 0x358 0x2f5e 0xa04d 0x35f 0x3158 0x9fe1 0x360 0x3351 0x9f98 0x36c 0x354a 0x9f16 0x372 0x3743 0x9eb9 0x380 0x393d 0x9e5e 0x39a 0x3b36 0x9df3 0x39e 0x3d2f 0x9d79 0x398 0x3f28 0x9d01 0x3a2 0x4122 0x9c78 0x3b4 0x431b 0x9c3a 0x3c8 0x4514 0x9beb 0x3d9 0x470d 0x9ba0 0x3eb 0x4907 0x9b56 0x3f3 0x4b00 0x9b0a 0x404 0x4cf9 0x9ae1 0x40b 0x4ef3 0x9a63 0x41b 0x50ec 0x9a04 0x41c 0x52e5 0x9997 0x401 0x54de 0x98f6 0x3b5 0x56d8 0x9890 0x36d 0x58d1 0x981d 0x339 0x5aca 0x97bd 0x311 0x5cc3 0x976e 0x30a 0x5ebd 0x9701 0x306 0x60b6 0x96e9 0x2fe 0x62af 0x969a 0x2fd 0x64a8 0x9675 0x2fc 0x66a2 0x9641 0x2ff 0x689b 0x9636 0x301 0x6a94 0x95e0 0x305 0x6c8d 0x95b2 0x305 0x6e87 0x956f 0x304 0x7080 0x955a 0x30b 0x7279 0x9532 0x311 0x7472 0x950b 0x319 0x766c 0x950e 0x31b 0x7865 0x94c2 0x322 0x7a5e 0x94a2 0x32d 0x7c58 0x949e 0x331 0x7e51 0x9462 0x337 0x804a 0x9444 0x33e 0x8243 0x9429 0x341 0x843d 0x942b 0x348 0x8636 0x93f1 0x34d 0x882f 0x93d5 0x34e 0x8a28 0x93d7 0x34d 0x8c22 0x9396 0x348 0x8e1b 0x9370 0x334 0x9014 0x9370 0x323 0x920d 0x9322 0x322 0x9407 0x92f7 0x30f 0x9600 0x92ce 0x30f 0x97f9 0x92ad 0x305 0x99f2 0x927e 0x308 0x9bec 0x925e 0x308 0x9de5 0x9249 0x31c 0x9fde 0x9215 0x31a 0xa1d8 0x91e4 0x31f 0xa3d1 0x9189 0x320 0xa5ca 0x9168 0x320 0xa7c3 0x9132 0x327 0xa9bd 0x911d 0x338 0xabb6 0x909a 0x324 0xadaf 0x905e 0x320 0xafa8 0x905c 0x32e 0xb1a2 0x903c 0x345 0xb39b 0x904d 0x354 0xb594 0x901f 0x37b 0xb78d 0x8fed 0x3a4 0xb987 0x8fb3 0x3d1 0xbb80 0x8e5d 0x395 0xbd79 0x8cb8 0x3cb 0xbebe 0x87f0 0x40d 0xbf04 0x861a 0x477 0xbf68 0x84d0 0x576>;
		battery0_profile_t1_col = <0x3>;
		battery0_profile_t1_num = <0x64>;
		battery0_profile_t2 = <0x0 0xab5b 0x7b7 0x1f9 0xaae8 0x7b9 0x3f3 0xaa64 0x7b6 0x5ec 0xaa15 0x79b 0x7e5 0xa979 0x791 0x9de 0xa8ff 0x77a 0xbd8 0xa885 0x768 0xdd1 0xa80d 0x760 0xfca 0xa7aa 0x74a 0x11c3 0xa720 0x73b 0x13bd 0xa6a9 0x72d 0x15b6 0xa61e 0x71c 0x17af 0xa5bd 0x70b 0x19a8 0xa551 0x6ff 0x1ba2 0xa4d0 0x6f5 0x1d9b 0xa459 0x6f1 0x1f94 0xa3c8 0x6ea 0x218d 0xa378 0x6f7 0x2387 0xa311 0x6f6 0x2580 0xa296 0x6fb 0x2779 0xa24e 0x700 0x2973 0xa1b7 0x706 0x2b6c 0xa147 0x709 0x2d65 0xa0c3 0x70f 0x2f5e 0xa06a 0x718 0x3158 0xa000 0x71d 0x3351 0x9f99 0x725 0x354a 0x9f35 0x744 0x3743 0x9eed 0x773 0x393d 0x9e95 0x792 0x3b36 0x9e02 0x78d 0x3d2f 0x9d93 0x77a 0x3f28 0x9cff 0x770 0x4122 0x9c72 0x76f 0x431b 0x9c11 0x77e 0x4514 0x9bb5 0x785 0x470d 0x9b4b 0x797 0x4907 0x9b27 0x7a7 0x4b00 0x9ae2 0x7af 0x4cf9 0x9a7f 0x7a3 0x4ef3 0x9a1c 0x797 0x50ec 0x99d3 0x770 0x52e5 0x9963 0x735 0x54de 0x98ef 0x6f8 0x56d8 0x9880 0x6ba 0x58d1 0x981d 0x68b 0x5aca 0x97c5 0x676 0x5cc3 0x9761 0x664 0x5ebd 0x972d 0x65c 0x60b6 0x96eb 0x654 0x62af 0x969a 0x650 0x64a8 0x9676 0x654 0x66a2 0x9640 0x650 0x689b 0x960d 0x659 0x6a94 0x95d3 0x65f 0x6c8d 0x95ac 0x660 0x6e87 0x9581 0x665 0x7080 0x9557 0x66c 0x7279 0x9510 0x66e 0x7472 0x9507 0x67d 0x766c 0x94e2 0x688 0x7865 0x94b4 0x690 0x7a5e 0x949a 0x696 0x7c58 0x947a 0x6a4 0x7e51 0x9451 0x6a9 0x804a 0x943d 0x6ae 0x8243 0x9421 0x6b6 0x843d 0x93e7 0x6bd 0x8636 0x93eb 0x6c5 0x882f 0x93d1 0x6cc 0x8a28 0x93bb 0x6d0 0x8c22 0x9385 0x6cc 0x8e1b 0x938e 0x6d3 0x9014 0x9379 0x6dd 0x920d 0x9363 0x6e0 0x9407 0x9349 0x6da 0x9600 0x931e 0x6d9 0x97f9 0x9301 0x6cd 0x99f2 0x92da 0x6cd 0x9bec 0x92b9 0x6e3 0x9de5 0x9297 0x6ee 0x9fde 0x9255 0x708 0xa1d8 0x9248 0x722 0xa3d1 0x920f 0x733 0xa5ca 0x91ce 0x73b 0xa7c3 0x9197 0x756 0xa9bd 0x915c 0x770 0xabb6 0x9102 0x787 0xadaf 0x90bd 0x797 0xafa8 0x9089 0x7b4 0xb1a2 0x906e 0x7dc 0xb39b 0x9040 0x819 0xb594 0x9037 0x856 0xb78d 0x9033 0x8ac 0xb987 0x900e 0x91e 0xbb80 0x8f81 0x9b7 0xbd79 0x8e8a 0x9ed 0xbf72 0x8ca6 0xa7f 0xc16c 0x8a31 0xb88 0xc365 0x8687 0xd43>;
		battery0_profile_t2_col = <0x3>;
		battery0_profile_t2_num = <0x64>;
		battery0_profile_t3 = <0x0 0xab87 0xb42 0x1f9 0xaaf3 0xb43 0x3f3 0xaa80 0xb4a 0x5ec 0xaa08 0xb3a 0x7e5 0xa98f 0xb1c 0x9de 0xa903 0xb0a 0xbd8 0xa89b 0xaf7 0xdd1 0xa823 0xaeb 0xfca 0xa7a6 0xacd 0x11c3 0xa70e 0xaae 0x13bd 0xa6b8 0xaa4 0x15b6 0xa644 0xaa0 0x17af 0xa5ca 0xa87 0x19a8 0xa555 0xa87 0x1ba2 0xa4dc 0xa79 0x1d9b 0xa454 0xa70 0x1f94 0xa3f5 0xa6a 0x218d 0xa381 0xa60 0x2387 0xa311 0xa63 0x2580 0xa2a2 0xa6a 0x2779 0xa22f 0xa65 0x2973 0xa1c1 0xa73 0x2b6c 0xa150 0xa71 0x2d65 0xa0cc 0xa69 0x2f5e 0xa072 0xa70 0x3158 0xa008 0xa6b 0x3351 0x9fa8 0xa7b 0x354a 0x9f3c 0xaaa 0x3743 0x9efd 0xae2 0x393d 0x9e9b 0xafc 0x3b36 0x9e19 0xaeb 0x3d2f 0x9d81 0xac3 0x3f28 0x9ce5 0xaa2 0x4122 0x9c57 0xa7f 0x431b 0x9be1 0xa74 0x4514 0x9b80 0xa7c 0x470d 0x9b2c 0xa7d 0x4907 0x9ade 0xa7c 0x4b00 0x9a8d 0xa75 0x4cf9 0x9a36 0xa54 0x4ef3 0x99d4 0xa1f 0x50ec 0x996b 0x9e2 0x52e5 0x9904 0x9b3 0x54de 0x989e 0x982 0x56d8 0x983e 0x964 0x58d1 0x97d4 0x94c 0x5aca 0x9797 0x93c 0x5cc3 0x974d 0x933 0x5ebd 0x970c 0x92f 0x60b6 0x96cd 0x92f 0x62af 0x9692 0x933 0x64a8 0x9645 0x93d 0x66a2 0x9625 0x949 0x689b 0x95f2 0x94f 0x6a94 0x95c4 0x95c 0x6c8d 0x9576 0x966 0x6e87 0x9566 0x970 0x7080 0x953c 0x988 0x7279 0x9513 0x98e 0x7472 0x94ee 0x99f 0x766c 0x94ac 0x9ac 0x7865 0x94a6 0x9be 0x7a5e 0x9486 0x9d2 0x7c58 0x9464 0x9e2 0x7e51 0x9446 0x9f6 0x804a 0x9428 0xa03 0x8243 0x940d 0xa1a 0x843d 0x93f6 0xa2f 0x8636 0x93e0 0xa3f 0x882f 0x93cc 0xa54 0x8a28 0x93ba 0xa67 0x8c22 0x9393 0xa7c 0x8e1b 0x9397 0xa92 0x9014 0x9380 0xab2 0x920d 0x9367 0xac4 0x9407 0x934b 0xae0 0x9600 0x9327 0xafa 0x97f9 0x9307 0xb23 0x99f2 0x92e3 0xb47 0x9bec 0x92bc 0xb7e 0x9de5 0x928f 0xbb0 0x9fde 0x9267 0xbf0 0xa1d8 0x9223 0xc31 0xa3d1 0x91e2 0xc68 0xa5ca 0x919c 0xcc2 0xa7c3 0x916a 0xd3d 0xa9bd 0x911c 0xd97 0xabb6 0x90ca 0xdf9 0xadaf 0x9096 0xe77 0xafa8 0x906e 0xf20 0xb1a2 0x905e 0xfd9 0xb39b 0x9042 0x10bb 0xb594 0x900f 0x11e9 0xb78d 0x8fe2 0x1349 0xb987 0x8f54 0x14b8 0xbb80 0x8e04 0x15ec 0xbd79 0x8bfd 0x17da 0xbf72 0x8945 0x1adc 0xc16c 0x854d 0x1fb0 0xc365 0x7e70 0x2c88>;
		battery0_profile_t3_col = <0x3>;
		battery0_profile_t3_num = <0x64>;
		battery0_profile_t4 = <0x0 0xabad 0x1edc 0x1f9 0xaaee 0x1edc 0x3f3 0xaa2d 0x1ee0 0x5ec 0xa9b8 0x1ec1 0x7e5 0xa90a 0x1e7a 0x9de 0xa891 0x1e3b 0xbd8 0xa80b 0x1df2 0xdd1 0xa774 0x1db7 0xfca 0xa701 0x1d88 0x11c3 0xa68d 0x1d2b 0x13bd 0xa610 0x1d0a 0x15b6 0xa582 0x1cd1 0x17af 0xa51c 0x1c89 0x19a8 0xa4a8 0x1c3d 0x1ba2 0xa435 0x1bff 0x1d9b 0xa3c2 0x1b9d 0x1f94 0xa353 0x1b82 0x218d 0xa2c2 0x1b37 0x2387 0xa25e 0x1b2c 0x2580 0xa202 0x1b10 0x2779 0xa191 0x1acd 0x2973 0xa123 0x1ab1 0x2b6c 0xa0b1 0x1a6d 0x2d65 0xa04c 0x1a71 0x2f5e 0x9fef 0x1a73 0x3158 0x9f93 0x1a85 0x3351 0x9f2f 0x1a91 0x354a 0x9ebe 0x1a76 0x3743 0x9e39 0x1a2c 0x393d 0x9da3 0x19b2 0x3b36 0x9ce3 0x1935 0x3d2f 0x9c65 0x18ce 0x3f28 0x9bd8 0x187d 0x4122 0x9b54 0x1841 0x431b 0x9af6 0x182b 0x4514 0x9a96 0x184a 0x470d 0x9a27 0x1843 0x4907 0x99e9 0x1838 0x4b00 0x999a 0x1821 0x4cf9 0x994b 0x1819 0x4ef3 0x98f9 0x181c 0x50ec 0x98a8 0x1807 0x52e5 0x9838 0x17fa 0x54de 0x9806 0x17e8 0x56d8 0x97ba 0x17db 0x58d1 0x9771 0x17e6 0x5aca 0x972c 0x17f2 0x5cc3 0x96ea 0x17f9 0x5ebd 0x96ac 0x180e 0x60b6 0x966d 0x1814 0x62af 0x9635 0x1829 0x64a8 0x9600 0x1844 0x66a2 0x95cb 0x1869 0x689b 0x959c 0x186d 0x6a94 0x956d 0x18bf 0x6c8d 0x9540 0x18de 0x6e87 0x9515 0x18f2 0x7080 0x94ed 0x1924 0x7279 0x94b3 0x1945 0x7472 0x94a4 0x1986 0x766c 0x9482 0x19b6 0x7865 0x9463 0x19ed 0x7a5e 0x944b 0x1a12 0x7c58 0x9432 0x1a44 0x7e51 0x941e 0x1a6f 0x804a 0x940d 0x1aa2 0x8243 0x93fb 0x1ac3 0x843d 0x93eb 0x1b11 0x8636 0x93d9 0x1b79 0x882f 0x93c6 0x1bdf 0x8a28 0x93b3 0x1c33 0x8c22 0x9379 0x1c9d 0x8e1b 0x9389 0x1cf8 0x9014 0x9374 0x1d72 0x920d 0x935b 0x1e09 0x9407 0x9317 0x1eb7 0x9600 0x9323 0x1f69 0x97f9 0x9301 0x2017 0x99f2 0x92dc 0x20bf 0x9bec 0x92b4 0x2185 0x9de5 0x9286 0x226a 0x9fde 0x9254 0x2344 0xa1d8 0x9222 0x2454 0xa3d1 0x91e7 0x2534 0xa5ca 0x91a3 0x266e 0xa7c3 0x916f 0x27bd 0xa9bd 0x912c 0x2913 0xabb6 0x90c2 0x2aab 0xadaf 0x90ae 0x2c61 0xafa8 0x9078 0x2e8c 0xb1a2 0x9056 0x30be 0xb39b 0x9030 0x3346 0xb594 0x8fff 0x35bd 0xb78d 0x8fae 0x381a 0xb987 0x8f44 0x3a51 0xbb80 0x8e6a 0x3be9 0xbd79 0x8cf0 0x3d65 0xbf72 0x8aba 0x3fef 0xc16c 0x877e 0x4439 0xc365 0x82a8 0x4a9a>;
		battery0_profile_t4_col = <0x3>;
		battery0_profile_t4_num = <0x64>;
		battery1_profile_t0 = <0x0 0xaad3 0x354 0x1f9 0xaa4d 0x355 0x3f3 0xa9d2 0x35c 0x5ec 0xa958 0x355 0x7e5 0xa8e1 0x35c 0x9de 0xa86a 0x355 0xbd8 0xa7ef 0x35c 0xdd1 0xa775 0x355 0xfca 0xa6ff 0x35e 0x11c3 0xa685 0x35d 0x13bd 0xa610 0x363 0x15b6 0xa596 0x364 0x17af 0xa51f 0x363 0x19a8 0xa4a8 0x364 0x1ba2 0xa432 0x366 0x1d9b 0xa3bb 0x365 0x1f94 0xa347 0x36b 0x218d 0xa2d3 0x36d 0x2387 0xa262 0x375 0x2580 0xa1ef 0x374 0x2779 0xa17d 0x377 0x2973 0xa10c 0x372 0x2b6c 0xa0a0 0x380 0x2d65 0xa033 0x37c 0x2f5e 0x9fc6 0x37e 0x3158 0x9f5f 0x38d 0x3351 0x9ef7 0x390 0x354a 0x9e8e 0x38c 0x3743 0x9e2b 0x395 0x393d 0x9dc8 0x398 0x3b36 0x9d64 0x395 0x3d2f 0x9d06 0x39f 0x3f28 0x9ca9 0x3ac 0x4122 0x9c4f 0x3b4 0x431b 0x9bf7 0x3bb 0x4514 0x9b9f 0x3c3 0x470d 0x9b4a 0x3d4 0x4907 0x9af6 0x3e8 0x4b00 0x9a9f 0x3ee 0x4cf9 0x9a4b 0x3fe 0x4ef3 0x99f3 0x40c 0x50ec 0x9984 0x3fc 0x52e5 0x98f9 0x3c2 0x54de 0x986f 0x38a 0x56d8 0x9803 0x375 0x58d1 0x97ae 0x370 0x5aca 0x9764 0x367 0x5cc3 0x9721 0x364 0x5ebd 0x96e1 0x360 0x60b6 0x96a5 0x364 0x62af 0x966d 0x363 0x64a8 0x9636 0x361 0x66a2 0x9603 0x369 0x689b 0x95d0 0x367 0x6a94 0x959e 0x364 0x6c8d 0x9571 0x36c 0x6e87 0x9545 0x36a 0x7080 0x951c 0x372 0x7279 0x94f2 0x376 0x7472 0x94cc 0x37c 0x766c 0x94a6 0x383 0x7865 0x9481 0x389 0x7a5e 0x945f 0x38b 0x7c58 0x9440 0x39a 0x7e51 0x9422 0x3a2 0x804a 0x9403 0x3ac 0x8243 0x93e6 0x3b6 0x843d 0x93c9 0x3be 0x8636 0x93a4 0x3bc 0x882f 0x936a 0x399 0x8a28 0x931a 0x36e 0x8c22 0x92cf 0x365 0x8e1b 0x9299 0x36f 0x9014 0x926b 0x374 0x920d 0x9240 0x37f 0x9407 0x9210 0x37e 0x9600 0x91e3 0x375 0x97f9 0x91bc 0x373 0x99f2 0x9199 0x373 0x9bec 0x9177 0x381 0x9de5 0x914c 0x388 0x9fde 0x9119 0x38b 0xa1d8 0x90d9 0x385 0xa3d1 0x909c 0x37d 0xa5ca 0x9061 0x383 0xa7c3 0x901a 0x384 0xa9bd 0x8fcc 0x360 0xabb6 0x8fae 0x35c 0xadaf 0x8fa4 0x371 0xafa8 0x8f9b 0x398 0xb1a2 0x8f8e 0x3be 0xb39b 0x8f75 0x3f5 0xb594 0x8f3f 0x41e 0xb78d 0x8e66 0x3bd 0xb987 0x8cd5 0x3c2 0xbb80 0x8ac2 0x3e8 0xbd79 0x87f7 0x411 0xbf72 0x83c5 0x478 0xc16c 0x7c02 0x701 0xc365 0x7c02 0x701>;
		battery1_profile_t0_col = <0x3>;
		battery1_profile_t0_num = <0x64>;
		battery1_profile_t1 = <0x0 0xab58 0x332 0x1f9 0xaacf 0x331 0x3f3 0xaa58 0x32f 0x5ec 0xa9e0 0x32f 0x7e5 0xa969 0x32f 0x9de 0xa8f3 0x32a 0xbd8 0xa87b 0x32a 0xdd1 0xa801 0x328 0xfca 0xa78a 0x32e 0x11c3 0xa710 0x321 0x13bd 0xa698 0x327 0x15b6 0xa61f 0x328 0x17af 0xa5ab 0x32a 0x19a8 0xa531 0x32b 0x1ba2 0xa4bd 0x32f 0x1d9b 0xa446 0x331 0x1f94 0xa3d3 0x339 0x218d 0xa35f 0x33a 0x2387 0xa2ed 0x33b 0x2580 0xa277 0x334 0x2779 0xa209 0x346 0x2973 0xa198 0x344 0x2b6c 0xa129 0x357 0x2d65 0xa0bb 0x359 0x2f5e 0xa04d 0x35f 0x3158 0x9fe1 0x360 0x3351 0x9f7a 0x369 0x354a 0x9f16 0x372 0x3743 0x9eb9 0x380 0x393d 0x9e5e 0x39a 0x3b36 0x9df3 0x3a0 0x3d2f 0x9d79 0x398 0x3f28 0x9d01 0x3a2 0x4122 0x9c96 0x3b4 0x431b 0x9c3a 0x3c8 0x4514 0x9beb 0x3db 0x470d 0x9ba0 0x3eb 0x4907 0x9b56 0x3f3 0x4b00 0x9b0a 0x404 0x4cf9 0x9ab9 0x40f 0x4ef3 0x9a63 0x41b 0x50ec 0x9a04 0x41c 0x52e5 0x9997 0x3fd 0x54de 0x9914 0x3b5 0x56d8 0x9890 0x36d 0x58d1 0x981d 0x335 0x5aca 0x97bd 0x311 0x5cc3 0x976e 0x30a 0x5ebd 0x9729 0x306 0x60b6 0x96e9 0x2fe 0x62af 0x96ae 0x2fd 0x64a8 0x9675 0x2fd 0x66a2 0x9641 0x2ff 0x689b 0x960e 0x301 0x6a94 0x95e0 0x305 0x6c8d 0x95b2 0x308 0x6e87 0x9583 0x304 0x7080 0x955a 0x30b 0x7279 0x9532 0x311 0x7472 0x950b 0x31a 0x766c 0x94e6 0x31b 0x7865 0x94c2 0x322 0x7a5e 0x94a2 0x32c 0x7c58 0x9480 0x331 0x7e51 0x9462 0x337 0x804a 0x9444 0x33e 0x8243 0x9429 0x346 0x843d 0x940d 0x348 0x8636 0x93f1 0x34d 0x882f 0x93d5 0x348 0x8a28 0x93b9 0x34d 0x8c22 0x9396 0x348 0x8e1b 0x9370 0x334 0x9014 0x9348 0x323 0x920d 0x9322 0x322 0x9407 0x92f7 0x30f 0x9600 0x92ce 0x30f 0x97f9 0x92a3 0x305 0x99f2 0x927e 0x308 0x9bec 0x925e 0x30a 0x9de5 0x923f 0x31c 0x9fde 0x9215 0x31a 0xa1d8 0x91e4 0x31f 0xa3d1 0x91a7 0x320 0xa5ca 0x9168 0x320 0xa7c3 0x9132 0x329 0xa9bd 0x90f5 0x338 0xabb6 0x909a 0x324 0xadaf 0x905e 0x320 0xafa8 0x9048 0x32e 0xb1a2 0x903c 0x347 0xb39b 0x902f 0x354 0xb594 0x901f 0x37b 0xb78d 0x9001 0x3a4 0xb987 0x8fb3 0x3d1 0xbb80 0x8e8f 0x396 0xbd79 0x8cb8 0x3cb 0xbebe 0x87f0 0x40b 0xbf04 0x85fc 0x477 0xbf68 0x84d0 0x576>;
		battery1_profile_t1_col = <0x3>;
		battery1_profile_t1_num = <0x64>;
		battery1_profile_t2 = <0x0 0xab65 0x7b7 0x1f9 0xaade 0x7b7 0x3f3 0xaa64 0x7b6 0x5ec 0xa9ed 0x79b 0x7e5 0xa979 0x791 0x9de 0xa8ff 0x77a 0xbd8 0xa885 0x769 0xdd1 0xa80d 0x760 0xfca 0xa796 0x74a 0x11c3 0xa720 0x73b 0x13bd 0xa6a9 0x72c 0x15b6 0xa632 0x71c 0x17af 0xa5bd 0x70b 0x19a8 0xa547 0x6ff 0x1ba2 0xa4d0 0x6f5 0x1d9b 0xa459 0x6ee 0x1f94 0xa3e6 0x6ea 0x218d 0xa378 0x6f7 0x2387 0xa307 0x6f6 0x2580 0xa296 0x6f8 0x2779 0xa226 0x700 0x2973 0xa1b7 0x706 0x2b6c 0xa147 0x709 0x2d65 0xa0d7 0x70f 0x2f5e 0xa06a 0x718 0x3158 0xa000 0x71d 0x3351 0x9f99 0x725 0x354a 0x9f3f 0x744 0x3743 0x9eed 0x775 0x393d 0x9e95 0x792 0x3b36 0x9e20 0x78d 0x3d2f 0x9d93 0x77e 0x3f28 0x9cff 0x770 0x4122 0x9c7c 0x76f 0x431b 0x9c11 0x77e 0x4514 0x9bb5 0x788 0x470d 0x9b69 0x797 0x4907 0x9b27 0x7a7 0x4b00 0x9ae2 0x7af 0x4cf9 0x9a93 0x7a6 0x4ef3 0x9a3a 0x797 0x50ec 0x99d3 0x770 0x52e5 0x9963 0x735 0x54de 0x98ef 0x6f8 0x56d8 0x9880 0x6ba 0x58d1 0x981d 0x68e 0x5aca 0x97c5 0x676 0x5cc3 0x9775 0x667 0x5ebd 0x972d 0x65c 0x60b6 0x96eb 0x654 0x62af 0x96ae 0x650 0x64a8 0x9676 0x654 0x66a2 0x9640 0x650 0x689b 0x960d 0x659 0x6a94 0x95dd 0x65f 0x6c8d 0x95ac 0x660 0x6e87 0x9581 0x667 0x7080 0x9557 0x66c 0x7279 0x952e 0x670 0x7472 0x9507 0x67d 0x766c 0x94e2 0x688 0x7865 0x94be 0x690 0x7a5e 0x949a 0x697 0x7c58 0x947a 0x6a4 0x7e51 0x945b 0x6a9 0x804a 0x943d 0x6ae 0x8243 0x9421 0x6b6 0x843d 0x9405 0x6bd 0x8636 0x93eb 0x6c5 0x882f 0x93d1 0x6cc 0x8a28 0x93bb 0x6d0 0x8c22 0x93a3 0x6cc 0x8e1b 0x938e 0x6d3 0x9014 0x9379 0x6dd 0x920d 0x9363 0x6e0 0x9407 0x9349 0x6da 0x9600 0x9328 0x6d9 0x97f9 0x9301 0x6cd 0x99f2 0x92da 0x6cd 0x9bec 0x92b9 0x6e3 0x9de5 0x9297 0x6ee 0x9fde 0x9273 0x708 0xa1d8 0x9248 0x722 0xa3d1 0x920f 0x733 0xa5ca 0x91ce 0x73b 0xa7c3 0x9197 0x756 0xa9bd 0x915c 0x770 0xabb6 0x9116 0x787 0xadaf 0x90bd 0x797 0xafa8 0x9089 0x7b4 0xb1a2 0x906e 0x7dc 0xb39b 0x905e 0x819 0xb594 0x904b 0x856 0xb78d 0x9033 0x8ac 0xb987 0x900e 0x91e 0xbb80 0x8fb3 0x9b9 0xbd79 0x8e8a 0x9ed 0xbf72 0x8ca6 0xa78 0xc16c 0x8a31 0xb88 0xc365 0x86b9 0xd43>;
		battery1_profile_t2_col = <0x3>;
		battery1_profile_t2_num = <0x64>;
		battery1_profile_t3 = <0x0 0xab87 0xb42 0x1f9 0xaafd 0xb43 0x3f3 0xaa80 0xb4a 0x5ec 0xaa08 0xb3a 0x7e5 0xa98f 0xb1c 0x9de 0xa917 0xb0d 0xbd8 0xa89b 0xaf7 0xdd1 0xa823 0xaeb 0xfca 0xa7a6 0xacd 0x11c3 0xa72c 0xaae 0x13bd 0xa6b8 0xaa7 0x15b6 0xa644 0xaa0 0x17af 0xa5ca 0xa89 0x19a8 0xa555 0xa87 0x1ba2 0xa4dc 0xa79 0x1d9b 0xa468 0xa70 0x1f94 0xa3f5 0xa6a 0x218d 0xa381 0xa62 0x2387 0xa311 0xa63 0x2580 0xa2a2 0xa6a 0x2779 0xa22f 0xa65 0x2973 0xa1c1 0xa73 0x2b6c 0xa150 0xa71 0x2d65 0xa0e0 0xa6b 0x2f5e 0xa072 0xa70 0x3158 0xa008 0xa6b 0x3351 0x9fa8 0xa7b 0x354a 0x9f50 0xaaa 0x3743 0x9efd 0xae2 0x393d 0x9e9b 0xafc 0x3b36 0x9e19 0xaee 0x3d2f 0x9d81 0xac3 0x3f28 0x9ce5 0xaa2 0x4122 0x9c57 0xa7f 0x431b 0x9be1 0xa74 0x4514 0x9b80 0xa7c 0x470d 0x9b2c 0xa80 0x4907 0x9ade 0xa81 0x4b00 0x9a8d 0xa75 0x4cf9 0x9a36 0xa54 0x4ef3 0x99d4 0xa1f 0x50ec 0x996b 0x9e2 0x52e5 0x9904 0x9b3 0x54de 0x989e 0x987 0x56d8 0x983e 0x964 0x58d1 0x97e8 0x94c 0x5aca 0x9797 0x93c 0x5cc3 0x974d 0x933 0x5ebd 0x970c 0x92f 0x60b6 0x96cd 0x92f 0x62af 0x9692 0x937 0x64a8 0x9659 0x940 0x66a2 0x9625 0x949 0x689b 0x95f2 0x94f 0x6a94 0x95c4 0x95f 0x6c8d 0x9594 0x966 0x6e87 0x9566 0x970 0x7080 0x953c 0x988 0x7279 0x9513 0x990 0x7472 0x94ee 0x99f 0x766c 0x94ca 0x9ad 0x7865 0x94a6 0x9be 0x7a5e 0x9486 0x9d2 0x7c58 0x9464 0x9e2 0x7e51 0x9446 0x9f6 0x804a 0x9428 0xa03 0x8243 0x940d 0xa1a 0x843d 0x93f6 0xa2f 0x8636 0x93e0 0xa3f 0x882f 0x93cc 0xa54 0x8a28 0x93ba 0xa67 0x8c22 0x93a7 0xa7c 0x8e1b 0x9397 0xa95 0x9014 0x9380 0xab2 0x920d 0x9367 0xac5 0x9407 0x934b 0xae0 0x9600 0x9327 0xafa 0x97f9 0x9307 0xb23 0x99f2 0x92e3 0xb47 0x9bec 0x92bc 0xb7e 0x9de5 0x928f 0xbb0 0x9fde 0x925d 0xbf2 0xa1d8 0x9223 0xc31 0xa3d1 0x91e2 0xc6a 0xa5ca 0x91a6 0xcc3 0xa7c3 0x916a 0xd3d 0xa9bd 0x911c 0xd97 0xabb6 0x90ca 0xdf4 0xadaf 0x9096 0xe77 0xafa8 0x9078 0xf20 0xb1a2 0x905e 0xfd5 0xb39b 0x9042 0x10bb 0xb594 0x9023 0x11e9 0xb78d 0x8fe2 0x134a 0xb987 0x8f54 0x14b8 0xbb80 0x8e04 0x15ec 0xbd79 0x8bfd 0x17dc 0xbf72 0x8945 0x1add 0xc16c 0x854d 0x1fb0 0xc365 0x7e7a 0x2c88>;
		battery1_profile_t3_col = <0x3>;
		battery1_profile_t3_num = <0x64>;
		battery1_profile_t4 = <0x0 0xaba3 0x1edc 0x1f9 0xaae4 0x1edc 0x3f3 0xaa41 0x1ee0 0x5ec 0xa9ae 0x1ec1 0x7e5 0xa91e 0x1e7a 0x9de 0xa891 0x1e3b 0xbd8 0xa80b 0x1dfc 0xdd1 0xa788 0x1db7 0xfca 0xa70b 0x1d88 0x11c3 0xa68d 0x1d49 0x13bd 0xa610 0x1d0a 0x15b6 0xa596 0x1cd1 0x17af 0xa51c 0x1c89 0x19a8 0xa4a8 0x1c3d 0x1ba2 0xa435 0x1bff 0x1d9b 0xa3c2 0x1bbb 0x1f94 0xa353 0x1b82 0x218d 0xa2e0 0x1b4b 0x2387 0xa272 0x1b2c 0x2580 0xa202 0x1b10 0x2779 0xa191 0x1ae1 0x2973 0xa123 0x1ab1 0x2b6c 0xa0b1 0x1a81 0x2d65 0xa04c 0x1a71 0x2f5e 0x9fef 0x1a7d 0x3158 0x9f93 0x1a8f 0x3351 0x9f2f 0x1a91 0x354a 0x9ebe 0x1a76 0x3743 0x9e39 0x1a2c 0x393d 0x9da3 0x19b2 0x3b36 0x9d01 0x1935 0x3d2f 0x9c65 0x18ce 0x3f28 0x9bd8 0x187d 0x4122 0x9b5e 0x1841 0x431b 0x9af6 0x1835 0x4514 0x9a96 0x184a 0x470d 0x9a3b 0x1843 0x4907 0x99e9 0x1838 0x4b00 0x999a 0x1835 0x4cf9 0x994b 0x182d 0x4ef3 0x98f9 0x181c 0x50ec 0x98a8 0x1807 0x52e5 0x9856 0x17fa 0x54de 0x9806 0x17e8 0x56d8 0x97ba 0x17db 0x58d1 0x9771 0x17e6 0x5aca 0x972c 0x17f2 0x5cc3 0x96ea 0x17f9 0x5ebd 0x96ac 0x180e 0x60b6 0x966d 0x181e 0x62af 0x9635 0x1833 0x64a8 0x9600 0x184e 0x66a2 0x95cb 0x1869 0x689b 0x959c 0x1895 0x6a94 0x956d 0x18bf 0x6c8d 0x9540 0x18de 0x6e87 0x9515 0x18fc 0x7080 0x94ed 0x1924 0x7279 0x94c7 0x194f 0x7472 0x94a4 0x1986 0x766c 0x9482 0x19c0 0x7865 0x9463 0x19ed 0x7a5e 0x944b 0x1a1c 0x7c58 0x9432 0x1a44 0x7e51 0x941e 0x1a79 0x804a 0x940d 0x1aa2 0x8243 0x93fb 0x1ad7 0x843d 0x93eb 0x1b1b 0x8636 0x93d9 0x1b79 0x882f 0x93c6 0x1bdf 0x8a28 0x93b3 0x1c3d 0x8c22 0x93a1 0x1ca7 0x8e1b 0x9389 0x1cf8 0x9014 0x9374 0x1d72 0x920d 0x935b 0x1e13 0x9407 0x933f 0x1eb7 0x9600 0x9323 0x1f69 0x97f9 0x9301 0x2017 0x99f2 0x92dc 0x20c9 0x9bec 0x92b4 0x218f 0x9de5 0x9286 0x226a 0x9fde 0x9254 0x2344 0xa1d8 0x9222 0x2454 0xa3d1 0x91e7 0x2552 0xa5ca 0x91ad 0x2678 0xa7c3 0x916f 0x27bd 0xa9bd 0x912c 0x2913 0xabb6 0x90ea 0x2aab 0xadaf 0x90ae 0x2c75 0xafa8 0x9082 0x2e8c 0xb1a2 0x9056 0x30c8 0xb39b 0x9030 0x3346 0xb594 0x8fff 0x35c7 0xb78d 0x8fb8 0x3824 0xb987 0x8f44 0x3a51 0xbb80 0x8e6a 0x3be9 0xbd79 0x8cf0 0x3d65 0xbf72 0x8aba 0x3ff9 0xc16c 0x8788 0x4443 0xc365 0x82a8 0x4a9a>;
		battery1_profile_t4_col = <0x3>;
		battery1_profile_t4_num = <0x64>;
		battery2_profile_t0 = <0x0 0xaba0 0x43d 0x1fe 0xaaec 0x43c 0x3fc 0xaa5b 0x423 0x5f9 0xa9ce 0x417 0x7f7 0xa948 0x411 0x9f5 0xa8c6 0x414 0xbf3 0xa844 0x40a 0xdf1 0xa7c7 0x40d 0xfee 0xa74b 0x406 0x11ec 0xa6ce 0x406 0x13ea 0xa655 0x407 0x15e8 0xa5de 0x409 0x17e6 0xa568 0x407 0x19e4 0xa4f2 0x406 0x1be1 0xa47e 0x410 0x1ddf 0xa409 0x40d 0x1fdd 0xa394 0x40c 0x21db 0xa322 0x413 0x23d9 0xa2b2 0x416 0x25d6 0xa240 0x410 0x27d4 0xa1d0 0x410 0x29d2 0xa161 0x40e 0x2bd0 0xa0f1 0x416 0x2dce 0xa085 0x41c 0x2fcb 0xa018 0x418 0x31c9 0x9fb1 0x426 0x33c7 0x9f43 0x41d 0x35c5 0x9edf 0x42d 0x37c3 0x9e76 0x422 0x39c0 0x9e14 0x434 0x3bbe 0x9db1 0x431 0x3dbc 0x9d50 0x43b 0x3fba 0x9cee 0x43a 0x41b8 0x9c8f 0x442 0x43b5 0x9c32 0x443 0x45b3 0x9bd9 0x44c 0x47b1 0x9b80 0x454 0x49af 0x9b28 0x45e 0x4bad 0x9ad1 0x464 0x4dab 0x9a7b 0x470 0x4fa8 0x9a22 0x474 0x51a6 0x99c8 0x47e 0x53a4 0x9967 0x47e 0x55a2 0x9903 0x47b 0x57a0 0x9897 0x462 0x599d 0x982c 0x44f 0x5b9b 0x97c2 0x432 0x5d99 0x9763 0x421 0x5f97 0x970b 0x40f 0x6195 0x96c1 0x409 0x6392 0x9680 0x3fe 0x6590 0x9640 0x3fe 0x678e 0x9607 0x3fe 0x698c 0x95d0 0x401 0x6b8a 0x959e 0x40d 0x6d87 0x9569 0x401 0x6f85 0x953c 0x40a 0x7183 0x950f 0x40e 0x7381 0x94e1 0x40d 0x757f 0x94b4 0x409 0x777c 0x948d 0x40e 0x797a 0x9467 0x412 0x7b78 0x9442 0x41b 0x7d76 0x941c 0x41a 0x7f74 0x93f9 0x419 0x8172 0x93d9 0x421 0x836f 0x93b8 0x424 0x856d 0x9398 0x429 0x876b 0x937b 0x43a 0x8969 0x9358 0x438 0x8b67 0x9330 0x42f 0x8d64 0x9306 0x427 0x8f62 0x92cb 0x419 0x9160 0x9283 0x402 0x935e 0x9248 0x3ff 0x955c 0x921a 0x406 0x9759 0x91ed 0x3ff 0x9957 0x91bd 0x3ff 0x9b55 0x9193 0x405 0x9d53 0x9167 0x3ff 0x9f51 0x9144 0x403 0xa14e 0x9120 0x40c 0xa34c 0x90f6 0x416 0xa54a 0x90c2 0x414 0xa748 0x9086 0x40b 0xa946 0x9048 0x40b 0xab43 0x900d 0x417 0xad41 0x8fc7 0x411 0xaf3f 0x8f7e 0x3fe 0xb13d 0x8f57 0x3f7 0xb33b 0x8f49 0x405 0xb539 0x8f40 0x41e 0xb736 0x8f32 0x43c 0xb934 0x8f1c 0x467 0xbb32 0x8ef0 0x497 0xbd30 0x8e4d 0x460 0xbf2e 0x8ce0 0x440 0xbf68 0x8ae1 0x44b 0xbfcc 0x86c4 0x472 0xc15c 0x84d0 0x4b0>;
		battery2_profile_t0_col = <0x3>;
		battery2_profile_t0_num = <0x64>;
		battery2_profile_t1 = <0x0 0xab43 0x3d4 0x1fe 0xaa99 0x3d3 0x3fc 0xaa13 0x3c4 0x5f9 0xa998 0x3b9 0x7f7 0xa91e 0x3ab 0x9f5 0xa8a7 0x3a6 0xbf3 0xa82f 0x3a1 0xdf1 0xa7b5 0x393 0xfee 0xa73d 0x38c 0x11ec 0xa6c6 0x386 0x13ea 0xa64e 0x379 0x15e8 0xa5d8 0x37a 0x17e6 0xa563 0x378 0x19e4 0xa4ef 0x372 0x1be1 0xa47c 0x373 0x1ddf 0xa40a 0x376 0x1fdd 0xa394 0x368 0x21db 0xa323 0x369 0x23d9 0xa2b4 0x36a 0x25d6 0xa245 0x36c 0x27d4 0xa1d6 0x36f 0x29d2 0xa167 0x374 0x2bd0 0xa0f8 0x378 0x2dce 0xa088 0x37c 0x2fcb 0xa01b 0x386 0x31c9 0x9fb4 0x38e 0x33c7 0x9f43 0x387 0x35c5 0x9ee0 0x38f 0x37c3 0x9e8f 0x3a6 0x39c0 0x9e52 0x3de 0x3bbe 0x9df7 0x3e6 0x3dbc 0x9d6c 0x3cf 0x3fba 0x9cc5 0x3b9 0x41b8 0x9c2a 0x3ad 0x43b5 0x9bb0 0x3b1 0x45b3 0x9b52 0x3bb 0x47b1 0x9b0d 0x3cc 0x49af 0x9ad7 0x3e6 0x4bad 0x9a98 0x3f5 0x4dab 0x9a47 0x3ef 0x4fa8 0x99eb 0x3e2 0x51a6 0x9988 0x3cd 0x53a4 0x991c 0x3af 0x55a2 0x98ae 0x384 0x57a0 0x9846 0x367 0x599d 0x97e0 0x33f 0x5b9b 0x9787 0x32c 0x5d99 0x9732 0x314 0x5f97 0x96ea 0x30a 0x6195 0x96a6 0x302 0x6392 0x9665 0x2fb 0x6590 0x962b 0x2f3 0x678e 0x95f4 0x2f4 0x698c 0x95c1 0x2fb 0x6b8a 0x958e 0x2f9 0x6d87 0x955e 0x2f4 0x6f85 0x9531 0x2fc 0x7183 0x9505 0x303 0x7381 0x94db 0x304 0x757f 0x94b1 0x2ff 0x777c 0x9488 0x2fb 0x797a 0x9464 0x305 0x7b78 0x9442 0x311 0x7d76 0x941c 0x30c 0x7f74 0x93fa 0x30e 0x8172 0x93d9 0x311 0x836f 0x93bc 0x317 0x856d 0x939d 0x320 0x876b 0x937f 0x323 0x8969 0x935d 0x31d 0x8b67 0x933c 0x318 0x8d64 0x931c 0x314 0x8f62 0x92fc 0x30d 0x9160 0x92d8 0x30a 0x935e 0x92b4 0x2fb 0x955c 0x928e 0x2f3 0x9759 0x926a 0x2f3 0x9957 0x923e 0x2eb 0x9b55 0x9217 0x2eb 0x9d53 0x91f4 0x2fd 0x9f51 0x91d2 0x30a 0xa14e 0x91a6 0x30a 0xa34c 0x9174 0x30f 0xa54a 0x913b 0x31d 0xa748 0x90fc 0x325 0xa946 0x90c2 0x333 0xab43 0x9080 0x340 0xad41 0x902e 0x33d 0xaf3f 0x8fef 0x341 0xb13d 0x8fd3 0x355 0xb33b 0x8fc4 0x36e 0xb539 0x8fb5 0x38b 0xb736 0x8fa0 0x3b1 0xb934 0x8f7c 0x3d9 0xbb32 0x8f2e 0x419 0xbd30 0x8e3f 0x41d 0xbe02 0x8c8a 0x427 0xbe3c 0x8a39 0x461 0xbf04 0x86c4 0x4cc 0xbf68 0x84d0 0x4d3>;
		battery2_profile_t1_col = <0x3>;
		battery2_profile_t1_num = <0x64>;
		battery2_profile_t2 = <0x0 0xabc8 0x9f6 0x1fe 0xab1a 0x9ff 0x3fc 0xaa7b 0xaed 0x5f9 0xa9ec 0xae4 0x7f7 0xa962 0xacb 0x9f5 0xa8de 0xaa6 0xbf3 0xa85d 0xa7a 0xdf1 0xa7e3 0xa5a 0xfee 0xa76b 0xa35 0x11ec 0xa6f6 0xa1c 0x13ea 0xa680 0xa04 0x15e8 0xa60c 0x9ec 0x17e6 0xa597 0x9d4 0x19e4 0xa522 0x9bd 0x1be1 0xa4b0 0x9a3 0x1ddf 0xa43f 0x990 0x1fdd 0xa3d1 0x989 0x21db 0xa362 0x97f 0x23d9 0xa2f4 0x971 0x25d6 0xa286 0x970 0x27d4 0xa219 0x96c 0x29d2 0xa1ab 0x964 0x2bd0 0xa13e 0x968 0x2dce 0xa0ce 0x964 0x2fcb 0xa063 0x95c 0x31c9 0x9ffc 0x94d 0x33c7 0x9fa4 0x95a 0x35c5 0x9f54 0x991 0x37c3 0x9f03 0x9de 0x39c0 0x9e9b 0xa0c 0x3bbe 0x9e17 0x9ff 0x3dbc 0x9d72 0x9b4 0x3fba 0x9cc0 0x959 0x41b8 0x9c1d 0x91a 0x43b5 0x9b92 0x8e6 0x45b3 0x9b1d 0x8c1 0x47b1 0x9abb 0x8ac 0x49af 0x9a67 0x8a1 0x4bad 0x9a18 0x89a 0x4dab 0x99c5 0x884 0x4fa8 0x996f 0x865 0x51a6 0x9918 0x845 0x53a4 0x98c1 0x825 0x55a2 0x986c 0x804 0x57a0 0x9819 0x7e8 0x599d 0x97c9 0x7cf 0x5b9b 0x977e 0x7c1 0x5d99 0x9736 0x7b4 0x5f97 0x96f4 0x7b7 0x6195 0x96b6 0x7b2 0x6392 0x9679 0x7b0 0x6590 0x963f 0x7a9 0x678e 0x960b 0x7b1 0x698c 0x95d4 0x7b0 0x6b8a 0x95a0 0x7b0 0x6d87 0x9573 0x7c1 0x6f85 0x9544 0x7c1 0x7183 0x9518 0x7c5 0x7381 0x94ed 0x7c9 0x757f 0x94c7 0x7d2 0x777c 0x94a0 0x7df 0x797a 0x947a 0x7e1 0x7b78 0x9457 0x7e7 0x7d76 0x9434 0x7eb 0x7f74 0x9415 0x7f6 0x8172 0x93f8 0x7f8 0x836f 0x93dc 0x800 0x856d 0x93c5 0x809 0x876b 0x93b4 0x81c 0x8969 0x93a4 0x839 0x8b67 0x9392 0x84c 0x8d64 0x937d 0x860 0x8f62 0x9367 0x879 0x9160 0x9350 0x895 0x935e 0x9333 0x8b0 0x955c 0x9315 0x8de 0x9759 0x92f3 0x90b 0x9957 0x92ce 0x934 0x9b55 0x92a8 0x970 0x9d53 0x927b 0x9a2 0x9f51 0x924e 0x9ee 0xa14e 0x9216 0xa37 0xa34c 0x91d9 0xa8e 0xa54a 0x9196 0xae6 0xa748 0x9152 0xb47 0xa946 0x910b 0xbc1 0xab43 0x90be 0xc41 0xad41 0x9077 0xcc5 0xaf3f 0x9044 0xd61 0xb13d 0x9024 0xe10 0xb33b 0x9004 0xeda 0xb539 0x8fe0 0xfb9 0xb736 0x8fa8 0x10bf 0xb934 0x8f3f 0x11d6 0xbb32 0x8e70 0x12ed 0xbd30 0x8cfa 0x140e 0xbf2e 0x8ac5 0x15a5 0xc12b 0x87a8 0x17e8 0xc329 0x85ed 0x1923 0xc527 0x85ed 0x1923>;
		battery2_profile_t2_col = <0x3>;
		battery2_profile_t2_num = <0x64>;
		battery2_profile_t3 = <0x0 0xabc8 0xda0 0x1fe 0xab26 0xdb0 0x3fc 0xaa76 0xf52 0x5f9 0xa9d3 0xf67 0x7f7 0xa93a 0xf54 0x9f5 0xa8aa 0xf3d 0xbf3 0xa81d 0xf1c 0xdf1 0xa799 0xefe 0xfee 0xa71b 0xef1 0x11ec 0xa69e 0xee8 0x13ea 0xa622 0xed9 0x15e8 0xa5a7 0xec8 0x17e6 0xa52e 0xeb7 0x19e4 0xa4b7 0xe9f 0x1be1 0xa443 0xe90 0x1ddf 0xa3d1 0xe87 0x1fdd 0xa361 0xe85 0x21db 0xa2f1 0xe83 0x23d9 0xa281 0xe81 0x25d6 0xa211 0xe81 0x27d4 0xa1a2 0xe81 0x29d2 0xa12c 0xe81 0x2bd0 0xa0bb 0xe6e 0x2dce 0xa050 0xe5d 0x2fcb 0x9fef 0xe54 0x31c9 0x9f9f 0xe7f 0x33c7 0x9f4c 0xece 0x35c5 0x9ee7 0xf0b 0x37c3 0x9e6c 0xf32 0x39c0 0x9dd4 0xf00 0x3bbe 0x9d26 0xe87 0x3dbc 0x9c74 0xe0b 0x3fba 0x9bd4 0xdae 0x41b8 0x9b48 0xd63 0x43b5 0x9ace 0xd35 0x45b3 0x9a62 0xd11 0x47b1 0x9a04 0xd00 0x49af 0x99b3 0xd05 0x4bad 0x9968 0xd0c 0x4dab 0x9919 0xd0d 0x4fa8 0x98c5 0xcfd 0x51a6 0x9873 0xced 0x53a4 0x9823 0xcd7 0x55a2 0x97d4 0xcc4 0x57a0 0x978b 0xcc0 0x599d 0x9744 0xcbf 0x5b9b 0x96ff 0xcb9 0x5d99 0x96bc 0xcbd 0x5f97 0x967b 0xcb8 0x6195 0x9640 0xcc4 0x6392 0x9607 0xccf 0x6590 0x95cf 0xcd7 0x678e 0x9598 0xcdc 0x698c 0x9566 0xce7 0x6b8a 0x9535 0xcf7 0x6d87 0x9508 0xd0c 0x6f85 0x94d8 0xd0e 0x7183 0x94af 0xd1f 0x7381 0x9489 0xd38 0x757f 0x9463 0xd4e 0x777c 0x9440 0xd60 0x797a 0x9420 0xd73 0x7b78 0x9402 0xd84 0x7d76 0x93eb 0xda4 0x7f74 0x93d7 0xdc7 0x8172 0x93c6 0xdef 0x836f 0x93b6 0xe17 0x856d 0x93a4 0xe45 0x876b 0x9392 0xe84 0x8969 0x9382 0xecc 0x8b67 0x9370 0xf14 0x8d64 0x935b 0xf5f 0x8f62 0x9344 0xfbf 0x9160 0x932b 0x1027 0x935e 0x9311 0x1095 0x955c 0x92f5 0x111a 0x9759 0x92d5 0x119b 0x9957 0x92b2 0x1223 0x9b55 0x928b 0x12c3 0x9d53 0x9262 0x1364 0x9f51 0x9234 0x1416 0xa14e 0x9201 0x14d0 0xa34c 0x91cc 0x158a 0xa54a 0x918e 0x164b 0xa748 0x9151 0x1719 0xa946 0x910f 0x17ef 0xab43 0x90c9 0x18ca 0xad41 0x9086 0x19be 0xaf3f 0x9049 0x1abf 0xb13d 0x9014 0x1bdb 0xb33b 0x8fe6 0x1d13 0xb539 0x8fbf 0x1e5f 0xb736 0x8f92 0x1fd3 0xb934 0x8f4c 0x216f 0xbb32 0x8ed3 0x231e 0xbd30 0x8e03 0x24de 0xbf2e 0x8cb5 0x26d6 0xc12b 0x8ac6 0x2932 0xc329 0x8a30 0x29e0 0xc527 0x8a30 0x29e0>;
		battery2_profile_t3_col = <0x3>;
		battery2_profile_t3_num = <0x64>;
		battery2_profile_t4 = <0x0 0xabc8 0xda0 0x1fe 0xab26 0xdb0 0x3fc 0xaa76 0xf52 0x5f9 0xa9d3 0xf67 0x7f7 0xa93a 0xf54 0x9f5 0xa8aa 0xf3d 0xbf3 0xa81d 0xf1c 0xdf1 0xa799 0xefe 0xfee 0xa71b 0xef1 0x11ec 0xa69e 0xee8 0x13ea 0xa622 0xed9 0x15e8 0xa5a7 0xec8 0x17e6 0xa52e 0xeb7 0x19e4 0xa4b7 0xe9f 0x1be1 0xa443 0xe90 0x1ddf 0xa3d1 0xe87 0x1fdd 0xa361 0xe85 0x21db 0xa2f1 0xe83 0x23d9 0xa281 0xe81 0x25d6 0xa211 0xe81 0x27d4 0xa1a2 0xe81 0x29d2 0xa12c 0xe81 0x2bd0 0xa0bb 0xe6e 0x2dce 0xa050 0xe5d 0x2fcb 0x9fef 0xe54 0x31c9 0x9f9f 0xe7f 0x33c7 0x9f4c 0xece 0x35c5 0x9ee7 0xf0b 0x37c3 0x9e6c 0xf32 0x39c0 0x9dd4 0xf00 0x3bbe 0x9d26 0xe87 0x3dbc 0x9c74 0xe0b 0x3fba 0x9bd4 0xdae 0x41b8 0x9b48 0xd63 0x43b5 0x9ace 0xd35 0x45b3 0x9a62 0xd11 0x47b1 0x9a04 0xd00 0x49af 0x99b3 0xd05 0x4bad 0x9968 0xd0c 0x4dab 0x9919 0xd0d 0x4fa8 0x98c5 0xcfd 0x51a6 0x9873 0xced 0x53a4 0x9823 0xcd7 0x55a2 0x97d4 0xcc4 0x57a0 0x978b 0xcc0 0x599d 0x9744 0xcbf 0x5b9b 0x96ff 0xcb9 0x5d99 0x96bc 0xcbd 0x5f97 0x967b 0xcb8 0x6195 0x9640 0xcc4 0x6392 0x9607 0xccf 0x6590 0x95cf 0xcd7 0x678e 0x9598 0xcdc 0x698c 0x9566 0xce7 0x6b8a 0x9535 0xcf7 0x6d87 0x9508 0xd0c 0x6f85 0x94d8 0xd0e 0x7183 0x94af 0xd1f 0x7381 0x9489 0xd38 0x757f 0x9463 0xd4e 0x777c 0x9440 0xd60 0x797a 0x9420 0xd73 0x7b78 0x9402 0xd84 0x7d76 0x93eb 0xda4 0x7f74 0x93d7 0xdc7 0x8172 0x93c6 0xdef 0x836f 0x93b6 0xe17 0x856d 0x93a4 0xe45 0x876b 0x9392 0xe84 0x8969 0x9382 0xecc 0x8b67 0x9370 0xf14 0x8d64 0x935b 0xf5f 0x8f62 0x9344 0xfbf 0x9160 0x932b 0x1027 0x935e 0x9311 0x1095 0x955c 0x92f5 0x111a 0x9759 0x92d5 0x119b 0x9957 0x92b2 0x1223 0x9b55 0x928b 0x12c3 0x9d53 0x9262 0x1364 0x9f51 0x9234 0x1416 0xa14e 0x9201 0x14d0 0xa34c 0x91cc 0x158a 0xa54a 0x918e 0x164b 0xa748 0x9151 0x1719 0xa946 0x910f 0x17ef 0xab43 0x90c9 0x18ca 0xad41 0x9086 0x19be 0xaf3f 0x9049 0x1abf 0xb13d 0x9014 0x1bdb 0xb33b 0x8fe6 0x1d13 0xb539 0x8fbf 0x1e5f 0xb736 0x8f92 0x1fd3 0xb934 0x8f4c 0x216f 0xbb32 0x8ed3 0x231e 0xbd30 0x8e03 0x24de 0xbf2e 0x8cb5 0x26d6 0xc12b 0x8ac6 0x2932 0xc329 0x8a30 0x29e0 0xc527 0x8a30 0x29e0>;
		battery2_profile_t4_col = <0x3>;
		battery2_profile_t4_num = <0x64>;
		compatible = "mediatek,bat_gm30";
		enable_tmp_intr_suspend = <0x0>;
		g_FG_PSEUDO100_T0 = <0x64>;
		g_FG_PSEUDO100_T1 = <0x64>;
		g_FG_PSEUDO100_T2 = <0x64>;
		g_FG_PSEUDO100_T3 = <0x64>;
		g_FG_PSEUDO100_T4 = <0x64>;
		g_PMIC_MIN_VOL = <0x8660 0x84d0 0x8660 0x82dc 0x8660 0x84d0 0x8660 0x80e8 0x8598 0x84d0 0x8660 0x82dc 0x7ef4 0x84d0 0x8660 0x7dc8 0x7c9c 0x84d0 0x8660 0x7c9c 0x7b0c 0x84d0 0x8660 0x7b0c 0x7918 0x84d0 0x7918 0x7918 0x7918 0x7918 0x7918 0x7918 0x7918 0x7918 0x7918 0x7918 0x7918 0x7918 0x7918 0x79e0>;
		io-channel-names = "batteryID-channel";
		io-channels = <0x23 0x3>;
		phandle = <0xaa>;
		tran_Q_diff = <0x1388 0x1388 0x1388 0x1388>;
	};

	bpi_bsi_slv0@1021e000 {
		compatible = "mediatek,bpi_bsi_slv0";
		reg = <0x0 0x1021e000 0x0 0x1000>;
	};

	bpi_bsi_slv1@1021f000 {
		compatible = "mediatek,bpi_bsi_slv1";
		reg = <0x0 0x1021f000 0x0 0x6000>;
	};

	bpi_bsi_slv2@10225000 {
		compatible = "mediatek,bpi_bsi_slv2";
		reg = <0x0 0x10225000 0x0 0x1000>;
	};

	btif@1100c000 {
		clock-names = "btifc", "apdmac";
		clocks = <0x21 0x1a 0x21 0x26>;
		compatible = "mediatek,btif";
		interrupts = <0x0 0x85 0x8 0x0 0x73 0x8 0x0 0x8d 0x8>;
		reg = <0x0 0x1100c000 0x0 0x1000 0x0 0x11000b80 0x0 0x80 0x0 0x11000c00 0x0 0x80>;
	};

	bus_dbg@10208000 {
		compatible = "mediatek,bus_dbg-v2";
		interrupts = <0x0 0x9e 0x8>;
		mediatek,bus_dbg_con_offset = <0x2fc>;
		reg = <0x0 0x10208000 0x0 0x1000 0x0 0x10001000 0x0 0x1000>;
	};

	cache_parity {
		compatible = "mediatek,cache_parity";
		err_level = <0x1>;
		interrupts = <0x0 0x16 0x4 0x0 0x17 0x4 0x0 0x18 0x4 0x0 0x19 0x4 0x0 0x1a 0x4 0x0 0x1b 0x4 0x0 0x1c 0x4 0x0 0x1d 0x4 0x0 0x13 0x4>;
		irq_config = <0x0 0x8090 0xff00 0x8090 0x44 0x8090 0xff 0x1 0x8090 0xff00 0x8090 0x44 0x8090 0xff 0x2 0x8090 0xff00 0x8090 0x44 0x8090 0xff 0x3 0x8090 0xff00 0x8090 0x44 0x8090 0xff 0x4 0x8090 0xff00 0x8090 0x44 0x8090 0xff 0x5 0x8090 0xff00 0x8090 0x44 0x8090 0xff 0x6 0x8090 0xff00 0x8090 0x44 0x8090 0xff 0x7 0x8090 0xff00 0x8090 0x44 0x8090 0xff 0x400 0xc8c0 0x1000000 0xc8c0 0xc 0xc8c8 0x1>;
		reg = <0x0 0xc530000 0x0 0x10000>;
		version = <0x1>;
	};

	cam1@1a003000 {
		compatible = "mediatek,cam1";
		interrupts = <0x0 0xfa 0x8>;
		reg = <0x0 0x1a003000 0x0 0x1000>;
	};

	cam2@1a004000 {
		compatible = "mediatek,cam2";
		interrupts = <0x0 0xfb 0x8>;
		reg = <0x0 0x1a004000 0x0 0x1000>;
	};

	cam3@1a005000 {
		compatible = "mediatek,cam3";
		interrupts = <0x0 0xfc 0x8>;
		reg = <0x0 0x1a005000 0x0 0x1000>;
	};

	cam_clear@1a01b000 {
		compatible = "mediatek,cam_clear";
		reg = <0x0 0x1a01b000 0x0 0x1000>;
	};

	cam_inner@1a013000 {
		compatible = "mediatek,cam_inner";
		reg = <0x0 0x1a013000 0x0 0x1000>;
	};

	cam_set@1a00b000 {
		compatible = "mediatek,cam_set";
		reg = <0x0 0x1a00b000 0x0 0x1000>;
	};

	cama_clear@1a01c000 {
		compatible = "mediatek,cama_clear";
		reg = <0x0 0x1a01c000 0x0 0x1000>;
	};

	cama_ext@1a024000 {
		compatible = "mediatek,cama_ext";
		reg = <0x0 0x1a024000 0x0 0x1000>;
	};

	cama_inner@1a014000 {
		compatible = "mediatek,cama_inner";
		reg = <0x0 0x1a014000 0x0 0x1000>;
	};

	cama_set@1a00c000 {
		compatible = "mediatek,cama_set";
		reg = <0x0 0x1a00c000 0x0 0x1000>;
	};

	camb_clear@1a01d000 {
		compatible = "mediatek,camb_clear";
		reg = <0x0 0x1a01d000 0x0 0x1000>;
	};

	camb_ext@1a025000 {
		compatible = "mediatek,camb_ext";
		reg = <0x0 0x1a025000 0x0 0x1000>;
	};

	camb_inner@1a015000 {
		compatible = "mediatek,camb_inner";
		reg = <0x0 0x1a015000 0x0 0x1000>;
	};

	camb_set@1a00d000 {
		compatible = "mediatek,camb_set";
		reg = <0x0 0x1a00d000 0x0 0x1000>;
	};

	camera_af_hw_node {
		camaf_m1_pmic-supply = <0x66>;
		compatible = "mediatek,camera_af_lens";
		phandle = <0xcc>;
	};

	camsv1@1a050000 {
		compatible = "mediatek,camsv1";
		interrupts = <0x0 0x102 0x8>;
		reg = <0x0 0x1a050000 0x0 0x1000>;
	};

	camsv2@1a051000 {
		compatible = "mediatek,camsv2";
		interrupts = <0x0 0x103 0x8>;
		reg = <0x0 0x1a051000 0x0 0x1000>;
	};

	camsv3@1a052000 {
		compatible = "mediatek,camsv3";
		interrupts = <0x0 0x100 0x8>;
		reg = <0x0 0x1a052000 0x0 0x1000>;
	};

	camsv4@1a053000 {
		compatible = "mediatek,camsv4";
		interrupts = <0x0 0x101 0x8>;
		reg = <0x0 0x1a053000 0x0 0x1000>;
	};

	camsys@1a000000 {
		#clock-cells = <0x1>;
		compatible = "mediatek,camsys", "syscon";
		phandle = <0x58>;
		reg = <0x0 0x1a000000 0x0 0x1000>;
	};

	ccu@1a0b1000 {
		clock-names = "CCU_CLK_CAM_CCU", "CAM_PWR";
		clocks = <0x58 0x8 0x22 0xa>;
		compatible = "mediatek,ccu";
		interrupts = <0x0 0x105 0x8>;
		reg = <0x0 0x1a0b1000 0x0 0x10000>;
	};

	charger {
		ac_charger_current = <0x2191c0>;
		ac_charger_input_current = <0x1e8480>;
		algorithm_name = "SwitchCharging";
		apple_1_0a_charger_current = <0x9eb10>;
		apple_2_1a_charger_current = <0xc3500>;
		battery_cv = <0x432380 0x432380 0x432380 0x432380>;
		bif_cv_under_threshold2 = <0x43e6d0>;
		bif_threshold1 = <0x40d990>;
		bif_threshold2 = <0x419ce0>;
		cable_imp_threshold = <0x2bb>;
		charging_host_charger_current = <0x16e360>;
		chg1_ta_ac_charger_current = <0x16e360>;
		chg2_ta_ac_charger_current = <0x16e360>;
		compatible = "mediatek,charger";
		disable_pd_dual;
		dual_polling_ieoc = <0x6ddd0>;
		enable_dynamic_mivr;
		enable_hvdcp20;
		enable_ir_comp;
		enable_min_charge_temp;
		enable_pe_2;
		enable_pe_plus;
		enable_sw_jeita;
		enable_tc30;
		high_temp_to_enter_pe40 = <0x27>;
		high_temp_to_leave_pe40 = <0x2e>;
		ibus_err = <0xe>;
		jeita_temp_above_t4_cv = <0x3e8fa0 0x3e8fa0 0x3e8fa0 0x3e8fa0>;
		jeita_temp_below_t0_cv = <0x432380 0x432380 0x432380 0x432380>;
		jeita_temp_t0_to_t1_cv = <0x432380 0x432380 0x432380 0x432380>;
		jeita_temp_t1_to_t2_cv = <0x432380 0x432380 0x432380 0x432380>;
		jeita_temp_t2_to_t3_cv = <0x432380 0x432380 0x432380 0x432380>;
		jeita_temp_t3_to_t4_cv = <0x3e8fa0 0x3e8fa0 0x3e8fa0 0x3e8fa0>;
		low_temp_to_enter_pe40 = <0x10>;
		low_temp_to_leave_pe40 = <0xa>;
		max_charge_temp = <0x35>;
		max_charge_temp_minus_x_degree = <0x34>;
		max_charger_voltage = <0x632ea0>;
		max_charging_time = <0x11940>;
		max_dmivr_charger_current = <0x155cc0>;
		min_charge_temp = <0x0>;
		min_charge_temp_plus_x_degree = <0x1>;
		min_charger_voltage = <0x432380>;
		min_charger_voltage_1 = <0x432380>;
		min_charger_voltage_2 = <0x401640>;
		multi_battery_cv;
		non_std_ac_charger_current = <0x124f80>;
		pd_ichg_level_threshold = <0xf4240>;
		pd_stop_battery_soc = <0x50>;
		pd_vbus_low_bound = <0x4c4b40>;
		pd_vbus_upper_bound = <0x4c4b40>;
		pe20_ichg_level_threshold = <0xf4240>;
		pe40_dual_charger_chg1_current = <0x1e8480>;
		pe40_dual_charger_chg2_current = <0x1e8480>;
		pe40_dual_charger_input_current = <0x2dc6c0>;
		pe40_r_cable_1a_lower = <0x206>;
		pe40_r_cable_2a_lower = <0x17f>;
		pe40_r_cable_3a_lower = <0xf5>;
		pe40_single_charger_current = <0x2dc6c0>;
		pe40_single_charger_input_current = <0x2dc6c0>;
		pe40_stop_battery_soc = <0x50>;
		pe_ichg_level_threshold = <0xf4240>;
		phandle = <0xd8>;
		power_path_support;
		r_bat_comp = <0x1e>;
		slave_mivr_diff = <0x186a0>;
		ta_9v_support;
		ta_ac_12v_input_current = <0x30d400>;
		ta_ac_7v_input_current = <0x1e8480>;
		ta_ac_9v_input_current = <0x1e8480>;
		ta_ac_charger_current = <0x2dc6c0>;
		ta_start_battery_soc = <0x0>;
		ta_stop_battery_soc = <0x5a>;
		temp_neg_10_thres = <0x2>;
		temp_t0_thres = <0x1>;
		temp_t0_thres_plus_x_degree = <0x1>;
		temp_t1_thres = <0x1>;
		temp_t1_thres_plus_x_degree = <0x1>;
		temp_t2_thres = <0xf>;
		temp_t2_thres_plus_x_degree = <0x10>;
		temp_t3_thres = <0x2d>;
		temp_t3_thres_minus_x_degree = <0x2c>;
		temp_t4_thres = <0x37>;
		temp_t4_thres_minus_x_degree = <0x33>;
		usb_charger_current = <0x7a120>;
		usb_charger_current_configured = <0x7a120>;
		usb_charger_current_suspend = <0x0>;
		usb_charger_current_unconfigured = <0x11170>;
		v_comp_max = <0x9c40>;
		vbat_cable_imp_threshold = <0x3b8260>;
		vsys_watt = <0x4c4b40>;
	};

	chipid@08000000 {
		compatible = "mediatek,chipid";
		reg = <0x0 0x8000000 0x0 0x4 0x0 0x8000004 0x0 0x4 0x0 0x8000008 0x0 0x4 0x0 0x800000c 0x0 0x4>;
	};

	chn_emi@1021a000 {
		compatible = "mediatek,chn_emi";
		reg = <0x0 0x1021a000 0x0 0x1000>;
	};

	chosen {
		bootargs = "console=tty0 console=ttyS0,921600n1 root=/dev/ram vmalloc=400M slub_debug=OFZPU swiotlb=noforce cgroup.memory=nosocket,nokmem firmware_class.path=/vendor/firmware page_owner=on loop.max_part=7";
		kaslr-seed = <0x0 0x0>;
		phandle = <0x67>;
	};

	clocks {

		clk26m {
			#clock-cells = <0x0>;
			clock-frequency = <0x18cba80>;
			compatible = "fixed-clock";
			phandle = <0x13>;
		};

		clk32k {
			#clock-cells = <0x0>;
			clock-frequency = <0x7d00>;
			compatible = "fixed-clock";
			phandle = <0x1f>;
		};
	};

	cmdq-bdg-test {
		compatible = "mediatek,cmdq-bdg-test";
		mboxes = <0x30 0x16 0x0 0x2 0x30 0x17 0x0 0x1>;
		mediatek,gce = <0x30>;
		token_gpr_set4 = [02 c0];
		token_user0 = [02 89];
	};

	consys@18002000 {
		#address-cells = <0x2>;
		#size-cells = <0x2>;
		clock-names = "conn";
		clocks = <0x22 0x1>;
		compatible = "mediatek,mt6768-consys";
		interrupts = <0x0 0x11c 0x8 0x0 0x4e 0x8 0x0 0x11f 0x1>;
		phandle = <0xbd>;
		reg = <0x0 0x18002000 0x0 0x1000 0x0 0x10007000 0x0 0x100 0x0 0x10001000 0x0 0x1000 0x0 0x10006000 0x0 0x1000 0x0 0x18007000 0x0 0x1000 0x0 0x180b1000 0x0 0x1000 0x0 0x180a3000 0x0 0x1000 0x0 0x180a5000 0x0 0x800 0x0 0x180c1000 0x0 0x1000 0x0 0x18004000 0x0 0x1000>;
		wifi_ant_swap_gpio = <0x1e 0x6c 0x0>;
	};

	cpu_dbgapb@0e010000 {
		compatible = "mediatek,hw_dbg";
		num = <0x8>;
		phandle = <0x6b>;
		reg = <0x0 0xe010000 0x0 0x1000 0x0 0xe110000 0x0 0x1000 0x0 0xe210000 0x0 0x1000 0x0 0xe310000 0x0 0x1000 0x0 0xe410000 0x0 0x1000 0x0 0xe510000 0x0 0x1000 0x0 0xe610000 0x0 0x1000 0x0 0xe710000 0x0 0x1000>;
	};

	cpus {
		#address-cells = <0x1>;
		#size-cells = <0x0>;

		cpu-map {

			cluster0 {

				core0 {
					cpu = <0x9>;
				};

				core1 {
					cpu = <0xa>;
				};

				core2 {
					cpu = <0xb>;
				};

				core3 {
					cpu = <0xc>;
				};

				core4 {
					cpu = <0xd>;
				};

				core5 {
					cpu = <0xe>;
				};

				doe {
					phandle = <0x68>;
				};
			};

			cluster1 {

				core0 {
					cpu = <0xf>;
				};

				core1 {
					cpu = <0x10>;
				};

				doe {
					phandle = <0x69>;
				};
			};
		};

		cpu@000 {
			clock-frequency = <0x65633340>;
			compatible = "arm,cortex-a55";
			cpu-idle-states = <0x2 0x3 0x4 0x5 0x6 0x7 0x8>;
			device_type = "cpu";
			enable-method = "psci";
			phandle = <0x9>;
			reg = <0x0>;
		};

		cpu@001 {
			clock-frequency = <0x65633340>;
			compatible = "arm,cortex-a55";
			cpu-idle-states = <0x2 0x3 0x4 0x5 0x6 0x7 0x8>;
			device_type = "cpu";
			enable-method = "psci";
			phandle = <0xa>;
			reg = <0x100>;
		};

		cpu@002 {
			clock-frequency = <0x65633340>;
			compatible = "arm,cortex-a55";
			cpu-idle-states = <0x2 0x3 0x4 0x5 0x6 0x7 0x8>;
			device_type = "cpu";
			enable-method = "psci";
			phandle = <0xb>;
			reg = <0x200>;
		};

		cpu@003 {
			clock-frequency = <0x65633340>;
			compatible = "arm,cortex-a55";
			cpu-idle-states = <0x2 0x3 0x4 0x5 0x6 0x7 0x8>;
			device_type = "cpu";
			enable-method = "psci";
			phandle = <0xc>;
			reg = <0x300>;
		};

		cpu@100 {
			clock-frequency = <0x65633340>;
			compatible = "arm,cortex-a55";
			cpu-idle-states = <0x2 0x3 0x4 0x5 0x6 0x7 0x8>;
			device_type = "cpu";
			enable-method = "psci";
			phandle = <0xd>;
			reg = <0x400>;
		};

		cpu@101 {
			clock-frequency = <0x65633340>;
			compatible = "arm,cortex-a55";
			cpu-idle-states = <0x2 0x3 0x4 0x5 0x6 0x7 0x8>;
			device_type = "cpu";
			enable-method = "psci";
			phandle = <0xe>;
			reg = <0x500>;
		};

		cpu@102 {
			clock-frequency = <0x8166d4c0>;
			compatible = "arm,cortex-a75";
			cpu-idle-states = <0x2 0x3 0x4 0x5 0x6 0x7 0x8>;
			device_type = "cpu";
			enable-method = "psci";
			phandle = <0xf>;
			reg = <0x600>;
		};

		cpu@103 {
			clock-frequency = <0x8166d4c0>;
			compatible = "arm,cortex-a75";
			cpu-idle-states = <0x2 0x3 0x4 0x5 0x6 0x7 0x8>;
			device_type = "cpu";
			enable-method = "psci";
			phandle = <0x10>;
			reg = <0x700>;
		};

		idle-states {
			entry-method = "arm,psci";

			idlebus26m {
				arm,psci-suspend-param = <0x1010004>;
				compatible = "arm,idle-state";
				entry-latency-us = <0x320>;
				exit-latency-us = <0x3e8>;
				min-residency-us = <0x7d0>;
				phandle = <0x7>;
				status = "okay";
			};

			idledram {
				arm,psci-suspend-param = <0x1010002>;
				compatible = "arm,idle-state";
				entry-latency-us = <0x320>;
				exit-latency-us = <0x3e8>;
				min-residency-us = <0x7d0>;
				phandle = <0x5>;
				status = "okay";
			};

			idlesyspll {
				arm,psci-suspend-param = <0x1010003>;
				compatible = "arm,idle-state";
				entry-latency-us = <0x320>;
				exit-latency-us = <0x3e8>;
				min-residency-us = <0x7d0>;
				phandle = <0x6>;
				status = "okay";
			};

			mcdi-cluster {
				arm,psci-suspend-param = <0x1010001>;
				compatible = "arm,idle-state";
				entry-latency-us = <0x258>;
				exit-latency-us = <0x258>;
				min-residency-us = <0x4b0>;
				phandle = <0x4>;
			};

			mcdi-cpu {
				arm,psci-suspend-param = <0x10001>;
				compatible = "arm,idle-state";
				entry-latency-us = <0x258>;
				exit-latency-us = <0x258>;
				min-residency-us = <0x4b0>;
				phandle = <0x3>;
			};

			standby {
				arm,psci-suspend-param = <0x1>;
				compatible = "arm,idle-state";
				entry-latency-us = <0x258>;
				exit-latency-us = <0x258>;
				min-residency-us = <0x4b0>;
				phandle = <0x2>;
			};

			suspend {
				arm,psci-suspend-param = <0x1010005>;
				compatible = "arm,idle-state";
				entry-latency-us = <0x320>;
				exit-latency-us = <0x3e8>;
				min-residency-us = <0x7d0>;
				phandle = <0x8>;
			};
		};
	};

	cq_dma@10212000 {
		clock-names = "cqdma";
		clocks = <0x21 0x43>;
		compatible = "mediatek,mt-cqdma-v1";
		interrupts = <0x0 0x86 0x8 0x0 0x87 0x8 0x0 0x88 0x8>;
		nr_channel = <0x3>;
		reg = <0x0 0x10212000 0x0 0x80 0x0 0x10212080 0x0 0x80 0x0 0x10212100 0x0 0x80>;
	};

	dbg_apmcu_mp0@0d400000 {
		compatible = "mediatek,dbg_apmcu_mp0";
		reg = <0x0 0xd400000 0x0 0x1000>;
	};

	dbg_apmcu_mp0@0d410000 {
		compatible = "mediatek,dbg_apmcu_mp0";
		reg = <0x0 0xd410000 0x0 0x1000>;
	};

	dbg_apmcu_mp0@0d420000 {
		compatible = "mediatek,dbg_apmcu_mp0";
		reg = <0x0 0xd420000 0x0 0x1000>;
	};

	dbg_apmcu_mp0@0d430000 {
		compatible = "mediatek,dbg_apmcu_mp0";
		reg = <0x0 0xd430000 0x0 0x1000>;
	};

	dbg_apmcu_mp0@0d440000 {
		compatible = "mediatek,dbg_apmcu_mp0";
		reg = <0x0 0xd440000 0x0 0x1000>;
	};

	dbg_apmcu_mp0@0d510000 {
		compatible = "mediatek,dbg_apmcu_mp0";
		reg = <0x0 0xd510000 0x0 0x1000>;
	};

	dbg_apmcu_mp0@0d520000 {
		compatible = "mediatek,dbg_apmcu_mp0";
		reg = <0x0 0xd520000 0x0 0x1000>;
	};

	dbg_apmcu_mp0@0d530000 {
		compatible = "mediatek,dbg_apmcu_mp0";
		reg = <0x0 0xd530000 0x0 0x1000>;
	};

	dbg_apmcu_mp0@0d540000 {
		compatible = "mediatek,dbg_apmcu_mp0";
		reg = <0x0 0xd540000 0x0 0x1000>;
	};

	dbg_apmcu_mp0@0d610000 {
		compatible = "mediatek,dbg_apmcu_mp0";
		reg = <0x0 0xd610000 0x0 0x1000>;
	};

	dbg_apmcu_mp0@0d620000 {
		compatible = "mediatek,dbg_apmcu_mp0";
		reg = <0x0 0xd620000 0x0 0x1000>;
	};

	dbg_apmcu_mp0@0d630000 {
		compatible = "mediatek,dbg_apmcu_mp0";
		reg = <0x0 0xd630000 0x0 0x1000>;
	};

	dbg_apmcu_mp0@0d640000 {
		compatible = "mediatek,dbg_apmcu_mp0";
		reg = <0x0 0xd640000 0x0 0x1000>;
	};

	dbg_apmcu_mp0@0d710000 {
		compatible = "mediatek,dbg_apmcu_mp0";
		reg = <0x0 0xd710000 0x0 0x1000>;
	};

	dbg_apmcu_mp0@0d720000 {
		compatible = "mediatek,dbg_apmcu_mp0";
		reg = <0x0 0xd720000 0x0 0x1000>;
	};

	dbg_apmcu_mp0@0d730000 {
		compatible = "mediatek,dbg_apmcu_mp0";
		reg = <0x0 0xd730000 0x0 0x1000>;
	};

	dbg_apmcu_mp0@0d740000 {
		compatible = "mediatek,dbg_apmcu_mp0";
		reg = <0x0 0xd740000 0x0 0x1000>;
	};

	dbg_apmcu_mp1@0d800000 {
		compatible = "mediatek,dbg_apmcu_mp1";
		reg = <0x0 0xd800000 0x0 0x1000>;
	};

	dbg_apmcu_mp1@0d810000 {
		compatible = "mediatek,dbg_apmcu_mp1";
		reg = <0x0 0xd810000 0x0 0x1000>;
	};

	dbg_apmcu_mp1@0d820000 {
		compatible = "mediatek,dbg_apmcu_mp1";
		reg = <0x0 0xd820000 0x0 0x1000>;
	};

	dbg_apmcu_mp1@0d830000 {
		compatible = "mediatek,dbg_apmcu_mp1";
		reg = <0x0 0xd830000 0x0 0x1000>;
	};

	dbg_apmcu_mp1@0d840000 {
		compatible = "mediatek,dbg_apmcu_mp1";
		reg = <0x0 0xd840000 0x0 0x1000>;
	};

	dbg_apmcu_mp1@0d910000 {
		compatible = "mediatek,dbg_apmcu_mp1";
		reg = <0x0 0xd910000 0x0 0x1000>;
	};

	dbg_apmcu_mp1@0d920000 {
		compatible = "mediatek,dbg_apmcu_mp1";
		reg = <0x0 0xd920000 0x0 0x1000>;
	};

	dbg_apmcu_mp1@0d930000 {
		compatible = "mediatek,dbg_apmcu_mp1";
		reg = <0x0 0xd930000 0x0 0x1000>;
	};

	dbg_apmcu_mp1@0d940000 {
		compatible = "mediatek,dbg_apmcu_mp1";
		reg = <0x0 0xd940000 0x0 0x1000>;
	};

	dbg_apmcu_mp1@0da10000 {
		compatible = "mediatek,dbg_apmcu_mp1";
		reg = <0x0 0xda10000 0x0 0x1000>;
	};

	dbg_apmcu_mp1@0da20000 {
		compatible = "mediatek,dbg_apmcu_mp1";
		reg = <0x0 0xda20000 0x0 0x1000>;
	};

	dbg_apmcu_mp1@0da30000 {
		compatible = "mediatek,dbg_apmcu_mp1";
		reg = <0x0 0xda30000 0x0 0x1000>;
	};

	dbg_apmcu_mp1@0da40000 {
		compatible = "mediatek,dbg_apmcu_mp1";
		reg = <0x0 0xda40000 0x0 0x1000>;
	};

	dbg_apmcu_mp1@0db10000 {
		compatible = "mediatek,dbg_apmcu_mp1";
		reg = <0x0 0xdb10000 0x0 0x1000>;
	};

	dbg_apmcu_mp1@0db20000 {
		compatible = "mediatek,dbg_apmcu_mp1";
		reg = <0x0 0xdb20000 0x0 0x1000>;
	};

	dbg_apmcu_mp1@0db30000 {
		compatible = "mediatek,dbg_apmcu_mp1";
		reg = <0x0 0xdb30000 0x0 0x1000>;
	};

	dbg_apmcu_mp1@0db40000 {
		compatible = "mediatek,dbg_apmcu_mp1";
		reg = <0x0 0xdb40000 0x0 0x1000>;
	};

	dbg_cti@0d020000 {
		compatible = "mediatek,dbg_cti";
		reg = <0x0 0xd020000 0x0 0x10000>;
	};

	dbg_dem@0d0a0000 {
		compatible = "mediatek,dbg_dem";
		interrupts = <0x0 0x9d 0x8>;
		reg = <0x0 0xd0a0000 0x0 0x10000>;
	};

	dbg_etr@0d030000 {
		compatible = "mediatek,dbg_etr";
		reg = <0x0 0xd030000 0x0 0x10000>;
	};

	dbg_funnel@0d040000 {
		compatible = "mediatek,dbg_funnel";
		reg = <0x0 0xd040000 0x0 0x10000>;
	};

	dbg_mdsys1@0d0c0000 {
		compatible = "mediatek,dbg_mdsys1";
		reg = <0x0 0xd0c0000 0x0 0x40000>;
	};

	dcm {
		compatible = "mediatek,dcm";
		phandle = <0x71>;
	};

	ddrphy@10015000 {
		compatible = "mediatek,ddrphy";
		reg = <0x0 0x10015000 0x0 0x1000>;
	};

	devapc@10207000 {
		clock-names = "devapc-infra-clock";
		clocks = <0x21 0x28>;
		compatible = "mediatek,mt6768-devapc";
		interrupts = <0x0 0x9f 0x8>;
		reg = <0x0 0x10207000 0x0 0x1000 0x0 0x1000e000 0x0 0x1000 0x0 0x10033000 0x0 0x1000>;
	};

	dfd@10200b00 {
		compatible = "mediatek,dfd";
		mediatek,chain_length = <0xa7f8>;
		mediatek,enabled = <0x1>;
		mediatek,rg_dfd_timeout = <0xa0>;
		reg = <0x0 0x10200b00 0x0 0x10000>;
	};

	dfd_cache {
		compatible = "mediatek,dfd_cache";
		mediatek,enabled = <0x0>;
		mediatek,rg_dfd_timeout = <0x3e80>;
		phandle = <0xab>;
	};

	dip1@15022000 {
		compatible = "mediatek,dip1";
		interrupts = <0x0 0x10e 0x8>;
		reg = <0x0 0x15022000 0x0 0x3000>;
	};

	disp_aal0@14011000 {
		compatible = "mediatek,disp_aal0";
		interrupts = <0x0 0xeb 0x8>;
		reg = <0x0 0x14011000 0x0 0x1000>;
	};

	disp_ccorr0@14010000 {
		compatible = "mediatek,disp_ccorr0";
		interrupts = <0x0 0xea 0x8>;
		reg = <0x0 0x14010000 0x0 0x1000>;
	};

	disp_color0@1400f000 {
		clock-names = "MDP_COLOR";
		clocks = <0x24 0xc>;
		compatible = "mediatek,disp_color0";
		interrupts = <0x0 0xe9 0x8>;
		phandle = <0x2b>;
		reg = <0x0 0x1400f000 0x0 0x1000>;
	};

	disp_dither0@14013000 {
		compatible = "mediatek,disp_dither0";
		interrupts = <0x0 0xed 0x8>;
		reg = <0x0 0x14013000 0x0 0x1000>;
	};

	disp_gamma0@14012000 {
		compatible = "mediatek,disp_gamma0";
		interrupts = <0x0 0xec 0x8>;
		reg = <0x0 0x14012000 0x0 0x1000>;
	};

	disp_mutex0@14001000 {
		compatible = "mediatek,disp_mutex0";
		interrupts = <0x0 0xdf 0x8>;
		phandle = <0x2d>;
		reg = <0x0 0x14001000 0x0 0x1000>;
	};

	disp_ovl0@1400b000 {
		compatible = "mediatek,disp_ovl0";
		interrupts = <0x0 0xe6 0x8>;
		reg = <0x0 0x1400b000 0x0 0x1000>;
	};

	disp_ovl0_2l@1400c000 {
		compatible = "mediatek,disp_ovl0_2l";
		interrupts = <0x0 0xf2 0x8>;
		reg = <0x0 0x1400c000 0x0 0x1000>;
	};

	disp_pwm@1100e000 {
		compatible = "mediatek,disp_pwm";
		reg = <0x0 0x1100e000 0x0 0x1000>;
	};

	disp_rdma0@1400d000 {
		compatible = "mediatek,disp_rdma0";
		interrupts = <0x0 0xe7 0x8>;
		reg = <0x0 0x1400d000 0x0 0x1000>;
	};

	disp_rsz0@14015000 {
		compatible = "mediatek,disp_rsz0";
		interrupts = <0x0 0x125 0x8>;
		reg = <0x0 0x14015000 0x0 0x1000>;
	};

	disp_wdma0@1400e000 {
		compatible = "mediatek,disp_wdma0";
		interrupts = <0x0 0xe8 0x8>;
		reg = <0x0 0x1400e000 0x0 0x1000>;
	};

	dispsys {
		clock-names = "MMSYS_MTCMOS", "MMSYS_SMI_COMMON", "MMSYS_SMI_LARB0", "MMSYS_GALS_COMM0", "MMSYS_GALS_COMM1", "MMSYS_DISP_OVL0", "MMSYS_DISP_OVL0_2L", "MMSYS_DISP_RDMA0", "MMSYS_DISP_WDMA0", "MMSYS_DISP_COLOR0", "MMSYS_DISP_CCORR0", "MMSYS_DISP_AAL0", "MMSYS_DISP_GAMMA0", "MMSYS_DISP_DITHER0", "MMSYS_DSI0_MM_CK", "MMSYS_DSI0_IF_CK", "MMSYS_IMG_DL_RELAY", "MMSYS_26M", "MMSYS_DISP_RSZ0", "APMIXED_MIPI_26M", "TOP_MUX_DISP_PWM", "DISP_PWM", "TOP_26M", "TOP_UNIVPLL2_D4", "TOP_ULPOSC1_D2", "TOP_ULPOSC1_D8";
		clocks = <0x22 0x3 0x24 0x13 0x24 0x14 0x24 0x15 0x24 0x16 0x24 0x7 0x24 0x8 0x24 0xa 0x24 0xb 0x24 0xc 0x24 0xd 0x24 0xe 0x24 0xf 0x24 0x10 0x24 0x11 0x24 0x1e 0x24 0x1c 0x24 0x1f 0x24 0x9 0x3e 0x15 0x12 0x63 0x21 0x31 0x13 0x12 0x1b 0x12 0x2e 0x12 0x30>;
		compatible = "mediatek,dispsys";
		mediatek,larb = <0x56>;
	};

	dma-controller@11000980 {
		#dma-cells = <0x1>;
		clock-names = "apdma";
		clocks = <0x21 0x26>;
		compatible = "mediatek,mt6577-uart-dma";
		dma-bits = <0x22>;
		interrupts = <0x0 0x66 0x8 0x0 0x67 0x8 0x0 0x68 0x8 0x0 0x72 0x8>;
		phandle = <0x31>;
		reg = <0x0 0x11000980 0x0 0x80 0x0 0x11000a00 0x0 0x80 0x0 0x11000a80 0x0 0x80 0x0 0x11000b00 0x0 0x80>;
	};

	dpe@15028000 {
		clock-names = "DPE_CG_IMG_DPE";
		clocks = <0x57 0x3>;
		compatible = "mediatek,dpe";
		interrupts = <0x0 0x10f 0x8>;
		reg = <0x0 0x15028000 0x0 0x1000>;
	};

	dramc@1022a000 {
		compatible = "mediatek,dramc";
		reg = <0x0 0x1022a000 0x0 0x2000 0x0 0x10232000 0x0 0x2000 0x0 0x1022c000 0x0 0x1000 0x0 0x10234000 0x0 0x1000 0x0 0x10228000 0x0 0x2000 0x0 0x10230000 0x0 0x2000 0x0 0x1022e000 0x0 0x1000 0x0 0x10236000 0x0 0x1000>;
	};

	drcc {
		compatible = "mediatek,drcc";
		drcc0_Code = <0xff>;
		drcc0_Hwgatepct = <0xff>;
		drcc0_Vref = <0xff>;
		drcc1_Code = <0xff>;
		drcc1_Hwgatepct = <0xff>;
		drcc1_Vref = <0xff>;
		drcc2_Code = <0xff>;
		drcc2_Hwgatepct = <0xff>;
		drcc2_Vref = <0xff>;
		drcc3_Code = <0xff>;
		drcc3_Hwgatepct = <0xff>;
		drcc3_Vref = <0xff>;
		drcc4_Code = <0xff>;
		drcc4_Hwgatepct = <0xff>;
		drcc4_Vref = <0xff>;
		drcc5_Code = <0xff>;
		drcc5_Hwgatepct = <0xff>;
		drcc5_Vref = <0xff>;
		drcc6_Code = <0xff>;
		drcc6_Hwgatepct = <0xff>;
		drcc6_Vref = <0xff>;
		drcc7_Code = <0xff>;
		drcc7_Hwgatepct = <0xff>;
		drcc7_Vref = <0xff>;
		phandle = <0xbc>;
		state = <0xff>;
	};

	dsi0@14014000 {
		compatible = "mediatek,dsi0";
		interrupts = <0x0 0xee 0x8>;
		reg = <0x0 0x14014000 0x0 0x1000>;
	};

	dsi_te {
		compatible = "mediatek, dsi_te-eint";
		phandle = <0xc8>;
		status = "disabled";
	};

	dsu-pmu-0 {
		compatible = "arm,dsu-pmu";
		cpus = <0x9 0xa 0xb 0xc 0xd 0xe 0xf 0x10>;
		interrupts = <0x0 0x12 0x4>;
	};

	dvfsp@00110800 {
		B-table = <0x7d0 0x48 0x1 0x1 0x79e 0x45 0x1 0x1 0x76c 0x41 0x1 0x1 0x73a 0x3d 0x1 0x1 0x708 0x3a 0x1 0x1 0x6ae 0x36 0x1 0x1 0x655 0x32 0x1 0x1 0x60c 0x30 0x2 0x1 0x5a3 0x2b 0x2 0x1 0x54a 0x27 0x2 0x1 0x4f1 0x24 0x2 0x1 0x498 0x20 0x2 0x1 0x43f 0x1d 0x2 0x1 0x3e6 0x19 0x2 0x1 0x38d 0x16 0x2 0x1 0x352 0x13 0x2 0x1>;
		CCI-table = <0x4a3 0x38 0x2 0x1 0x460 0x34 0x2 0x1 0x419 0x30 0x2 0x1 0x3f6 0x2e 0x2 0x1 0x3c1 0x2b 0x2 0x1 0x38d 0x28 0x2 0x1 0x358 0x24 0x2 0x1 0x335 0x22 0x2 0x1 0x300 0x1f 0x2 0x1 0x2dd 0x1d 0x4 0x1 0x2ba 0x1b 0x4 0x1 0x297 0x19 0x4 0x1 0x274 0x17 0x4 0x1 0x251 0x15 0x4 0x1 0x3a 0x13 0x4 0x1 0x1f4 0x10 0x4 0x1>;
		L-table = <0x6a4 0x38 0x2 0x1 0x659 0x35 0x2 0x1 0x5dc 0x30 0x2 0x1 0x5aa 0x2e 0x2 0x1 0x55f 0x2b 0x2 0x1 0x52d 0x29 0x2 0x1 0x4fb 0x27 0x2 0x1 0x497 0x22 0x2 0x1 0x44c 0x29 0x2 0x1 0x41a 0x1d 0x2 0x1 0x3e7 0x1b 0x2 0x1 0x3b6 0x19 0x2 0x1 0x384 0x17 0x2 0x1 0x352 0x15 0x4 0x1 0x306 0x13 0x4 0x1 0x1f4 0x10 0x4 0x1>;
		big-down-time = <0x2ee>;
		big-rise-time = <0x3e8>;
		change_flag = <0x0>;
		compatible = "mediatek,mt6768-dvfsp";
		little-down-time = <0x2ee>;
		little-rise-time = <0x3e8>;
		phandle = <0xa5>;
		reg = <0x0 0x110800 0x0 0x1400 0x0 0x110800 0x0 0x1400>;
		state = <0x1>;
	};

	dvfsp@10227000 {
		compatible = "mediatek,dvfsp";
		reg = <0x0 0x10227000 0x0 0x1000>;
	};

	dvfsrc@10012000 {
		compatible = "mediatek,dvfsrc";
		phandle = <0xa0>;
		reg = <0x0 0x10012000 0x0 0x1000 0x0 0x110780 0x0 0x80>;
	};

	dxcc_sec@10210000 {
		compatible = "mediatek,dxcc_sec";
		interrupts = <0x0 0xb1 0x4>;
		reg = <0x0 0x10210000 0x0 0x1000>;
	};

	eem_fsm@1100b000 {
		compatible = "mediatek,eem_fsm";
		eem-clamp-big = <0x0>;
		eem-clamp-cci = <0x0>;
		eem-clamp-gpu = <0x0>;
		eem-clamp-little = <0x0>;
		eem-initmon-big = <0xf>;
		eem-initmon-cci = <0xf>;
		eem-initmon-gpu = <0xf>;
		eem-initmon-little = <0xf>;
		eem-offset-big = <0xff>;
		eem-offset-cci = <0xff>;
		eem-offset-gpu = <0xff>;
		eem-offset-little = <0xff>;
		eem-status = <0x1>;
		interrupts = <0x0 0x8e 0x8>;
		phandle = <0xb9>;
		reg = <0x0 0x1100b000 0x0 0x1000>;
	};

	efuse_dbg@10004000 {
		compatible = "mediatek,efuse_dbg";
		reg = <0x0 0x10004000 0x0 0x1000>;
	};

	efusec@11ce0000 {
		compatible = "mediatek,efusec";
		reg = <0x0 0x11ce0000 0x0 0x10000>;
	};

	emi@10219000 {
		compatible = "mediatek,emi";
		interrupts = <0x0 0xa1 0x8>;
		reg = <0x0 0x10219000 0x0 0x1000 0x0 0x10226000 0x0 0x1000 0x0 0x1022d000 0x0 0x1000 0x0 0x10235000 0x0 0x1000 0x0 0x1020e000 0x0 0x1000>;
	};

	emi_mpu@10226000 {
		compatible = "mediatek,emi_mpu";
		reg = <0x0 0x10226000 0x0 0x1000>;
	};

	fdvt@1502b000 {
		clock-names = "FD_CLK_IMG_FDVT";
		clocks = <0x57 0x2>;
		compatible = "mediatek,fdvt";
		interrupts = <0x0 0x111 0x8>;
		reg = <0x0 0x1502b000 0x0 0x1000>;
	};

	fhctl@1000ce00 {
		compatible = "mediatek,fhctl";
		reg = <0x0 0x1000ce00 0x0 0x200>;
	};

	fingerprint {
		compatible = "mediatek,goodix-fp";
		phandle = <0xa8>;
	};

	flashlight_core {
		compatible = "mediatek,flashlight_core";
		phandle = <0xcd>;
	};

	flashlights_aw36515 {
		compatible = "mediatek,flashlights_aw36515";
		phandle = <0xcf>;
	};

	flashlights_ocp81375 {
		compatible = "mediatek,flashlights_ocp81375";
		phandle = <0xce>;
	};

	gauge_timer {
		compatible = "mediatek,gauge_timer_service";
	};

	gce@10238000 {
		#clock-cells = <0x1>;
		ap_dma_base = <0x18010000 0x17 0xffff0000>;
		audio_base = <0x17000000 0x12 0xffff0000>;
		buf_underrun_event_0 = <0x8c>;
		camsv_0_pass1_done = <0x143>;
		camsv_1_pass1_done = <0x144>;
		camsv_2_pass1_done = <0x145>;
		camsys1_base = <0x180a0000 0x1c 0xffff0000>;
		camsys2_base = <0x180b0000 0x1d 0xffff0000>;
		camsys_base = <0x18080000 0x1b 0xffff0000>;
		clock-names = "GCE", "GCE_TIMER", "MMSYS_MTCMOS";
		clocks = <0x21 0x9 0x21 0x18 0x22 0x3>;
		compatible = "mediatek,gce", "syscon";
		conn_peri_base = <0x18820000 0x7 0xffff0000>;
		dip_cq_thread0_frame_done = <0x101>;
		dip_cq_thread10_frame_done = <0x10b>;
		dip_cq_thread11_frame_done = <0x10c>;
		dip_cq_thread12_frame_done = <0x10d>;
		dip_cq_thread13_frame_done = <0x10e>;
		dip_cq_thread14_frame_done = <0x10f>;
		dip_cq_thread15_frame_done = <0x110>;
		dip_cq_thread16_frame_done = <0x111>;
		dip_cq_thread17_frame_done = <0x112>;
		dip_cq_thread18_frame_done = <0x113>;
		dip_cq_thread1_frame_done = <0x102>;
		dip_cq_thread2_frame_done = <0x103>;
		dip_cq_thread3_frame_done = <0x104>;
		dip_cq_thread4_frame_done = <0x105>;
		dip_cq_thread5_frame_done = <0x106>;
		dip_cq_thread6_frame_done = <0x107>;
		dip_cq_thread7_frame_done = <0x108>;
		dip_cq_thread8_frame_done = <0x109>;
		dip_cq_thread9_frame_done = <0x10a>;
		disp_2l_ovl0_frame_done = <0x1c>;
		disp_2l_ovl0_sof = <0x8>;
		disp_aal0_frame_done = <0x22>;
		disp_aal0_sof = <0xd>;
		disp_ccorr0_frame_done = <0x21>;
		disp_ccorr0_sof = <0xc>;
		disp_color0_frame_done = <0x20>;
		disp_color0_sof = <0xb>;
		disp_dither0_frame_done = <0x24>;
		disp_dither0_sof = <0xf>;
		disp_dither_base = <0x14010000 0x2 0xffff0000>;
		disp_dsi0_frame_done = <0x25>;
		disp_dsi0_sof = <0x10>;
		disp_gamma0_frame_done = <0x23>;
		disp_gamma0_sof = <0xe>;
		disp_mutex_reg = <0x14016000 0x1000>;
		disp_ovl0_frame_done = <0x1b>;
		disp_ovl0_frame_rst_done_pusle = <0x98>;
		disp_ovl0_sof = <0x7>;
		disp_pwm0_sof = <0x13>;
		disp_rdma0_frame_done = <0x1e>;
		disp_rdma0_sof = <0x9>;
		disp_rsz0_frame_done = <0x1d>;
		disp_rsz0_sof = <0x11>;
		disp_wdma0_frame_done = <0x1f>;
		disp_wdma0_rst_done = <0x93>;
		disp_wdma0_sof = <0xa>;
		dsi0_done_event = <0x8f>;
		dsi0_irq_event = <0x8e>;
		dsi0_te_event = <0x8d>;
		dsi0_te_from_infra = <0x382>;
		dve_frame_done = <0x114>;
		g3d_config_base = <0x13000000 0x0 0xffff0000>;
		gce_base = <0x18020000 0x18 0xffff0000>;
		gce_mbox_bdg = <0x30>;
		gcpu_base = <0x10050000 0xf 0xffff0000>;
		img_dl_relay_sof = <0x12>;
		imgsys_base = <0x15020000 0x4 0xffff0000>;
		infra_na3_base = <0x10010000 0xb 0xffff0000>;
		infra_na4_base = <0x10020000 0xc 0xffff0000>;
		interrupts = <0x0 0xaa 0x8>;
		isp_frame_done_b = <0x142>;
		jpgenc_done = <0x123>;
		kp_base = <0x18840000 0x9 0xffff0000>;
		mboxes = <0x2e 0x0 0x0 0x4 0x2e 0x2 0x0 0x5 0x2e 0x3 0x0 0x4 0x2e 0x4 0x0 0x4 0x2e 0x6 0x0 0x3 0x2e 0x7 0xffffffff 0x2 0x2f 0x8 0x0 0x4 0x2f 0x9 0x0 0x4 0x2f 0xa 0x0 0x1 0x2e 0xb 0x0 0x1 0x2e 0xc 0x0 0x1 0x2e 0xd 0x0 0x1 0x2e 0xe 0x0 0x1 0x2e 0xf 0xffffffff 0x1>;
		mcucfg_base = <0x10040000 0xe 0xffff0000>;
		mdp_ccorr0 = <0x2c>;
		mdp_ccorr0_frame_done = <0x15>;
		mdp_ccorr0_sof = <0x1>;
		mdp_color0 = <0x2b>;
		mdp_rdma0 = <0x25>;
		mdp_rdma0_frame_done = <0x14>;
		mdp_rdma0_rst_done = <0x97>;
		mdp_rdma0_sof = <0x0>;
		mdp_rsz0 = <0x26>;
		mdp_rsz0_frame_done = <0x16>;
		mdp_rsz0_sof = <0x2>;
		mdp_rsz1 = <0x27>;
		mdp_rsz1_frame_done = <0x17>;
		mdp_rsz1_sof = <0x3>;
		mdp_tdshp0 = <0x2a>;
		mdp_tdshp0_frame_done = <0x1a>;
		mdp_tdshp0_sof = <0x6>;
		mdp_wdma0 = <0x28>;
		mdp_wdma_frame_done = <0x19>;
		mdp_wdma_rst_done = <0x94>;
		mdp_wdma_sof = <0x4>;
		mdp_wrot0 = <0x29>;
		mdp_wrot0_rst_done = <0x95>;
		mdp_wrot0_sof = <0x5>;
		mdp_wrot0_write_frame_done = <0x18>;
		mediatek,mailbox-gce = <0x2e>;
		mm_mutex = <0x2d>;
		mm_na_base = <0x14020000 0x3 0xffff0000>;
		mmsys_config = <0x24>;
		mmsys_config_base = <0x14000000 0x1 0xffff0000>;
		msdc2_base = <0x17020000 0x14 0xffff0000>;
		msdc3_base = <0x18000000 0x16 0xffff0000>;
		phandle = <0xa7>;
		pwm_sw_base = <0x1100e000 0x63 0xffff0000>;
		reg = <0x0 0x10238000 0x0 0x4000>;
		rsc_frame_done = <0x116>;
		scp_base = <0x10030000 0xd 0xffff0000>;
		scp_sram_base = <0x10000000 0xa 0xffff0000>;
		secure_thread = <0x6 0x8>;
		seninf_0_fifo_full = <0x147>;
		seninf_1_fifo_full = <0x148>;
		seninf_2_fifo_full = <0x149>;
		seninf_3_fifo_full = <0x14a>;
		seninf_4_fifo_full = <0x14b>;
		seninf_5_fifo_full = <0x14c>;
		seninf_6_fifo_full = <0x14d>;
		seninf_7_fifo_full = <0x14e>;
		sram_share_cnt = <0x1>;
		sram_share_engine = <0xd>;
		sram_share_event = <0x2c6>;
		stream_done_0 = <0x82>;
		stream_done_1 = <0x83>;
		stream_done_2 = <0x84>;
		stream_done_3 = <0x85>;
		stream_done_4 = <0x86>;
		stream_done_5 = <0x87>;
		stream_done_6 = <0x88>;
		stream_done_7 = <0x89>;
		stream_done_8 = <0x8a>;
		stream_done_9 = <0x8b>;
		topckgen_base = <0x18830000 0x8 0xffff0000>;
		tsf_done = <0x146>;
		usb0_base = <0x10200000 0x10 0xffff0000>;
		usb_sif_base = <0x10280000 0x11 0xffff0000>;
		vdec1_base = <0x17030000 0x15 0xffff0000>;
		vdec2_base = <0x18040000 0x19 0xffff0000>;
		vdec3_base = <0x18050000 0x1a 0xffff0000>;
		vdec_base = <0x17010000 0x13 0xffff0000>;
		vdec_gcon_base = <0x18800000 0x5 0xffff0000>;
		venc_128byte_cnt_done = <0x125>;
		venc_frame_done = <0x121>;
		venc_gcon_base = <0x18810000 0x6 0xffff0000>;
		venc_mb_done = <0x124>;
		venc_pause_done = <0x122>;
		wmf_frame_done = <0x115>;
	};

	gce_mbox@10238000 {
		#gce-event-cells = <0x1>;
		#gce-subsys-cells = <0x2>;
		#mbox-cells = <0x3>;
		clock-names = "gce", "gce-timer";
		clocks = <0x21 0x9 0x21 0x18>;
		compatible = "mediatek,mt6768-gce";
		default_tokens = [02 bc 02 bd 02 be 02 bf 02 c0 02 c6 02 c7];
		interrupts = <0x0 0xaa 0x8>;
		phandle = <0x2e>;
		reg = <0x0 0x10238000 0x0 0x4000>;
	};

	gce_mbox_bdg {
		#gce-event-cells = <0x1>;
		#gce-subsys-cells = <0x2>;
		#mbox-cells = <0x3>;
		compatible = "mediatek,mailbox-gce-bdg";
		mboxes = <0x30 0x14 0x0 0x2 0x30 0x15 0x0 0x1>;
		phandle = <0x30>;
	};

	gce_mbox_svp@10238000 {
		#mbox-cells = <0x3>;
		clock-names = "gce", "gce-timer";
		clocks = <0x21 0x9 0x21 0x18>;
		compatible = "mediatek,mailbox-gce-svp";
		interrupts = <0x0 0xaa 0x8 0x0 0xab 0x8>;
		phandle = <0x2f>;
		reg = <0x0 0x10238000 0x0 0x4000>;
	};

	gic500@0c000000 {
		compatible = "mediatek,gic500";
		reg = <0x0 0xc000000 0x0 0x400000>;
	};

	gic_cpu@0c400000 {
		compatible = "mediatek,gic_cpu";
		reg = <0x0 0xc400000 0x0 0x40000>;
	};

	gpio {
		compatible = "mediatek,gpio_usage_mapping";
		phandle = <0xdf>;
	};

	gpio@10005000 {
		compatible = "mediatek,gpio";
		phandle = <0x14>;
		reg = <0x0 0x10005000 0x0 0x1000>;
	};

	gpufreq {
		clock-names = "clk_mux", "clk_main_parent", "clk_sub_parent", "subsys_mfg_cg", "mtcmos_mfg_async", "mtcmos_mfg", "mtcmos_mfg_core0", "mtcmos_mfg_core1";
		clocks = <0x12 0x54 0x12 0x26 0x12 0x6 0x55 0x0 0x22 0x9 0x22 0x4 0x22 0x7 0x22 0x8>;
		compatible = "mediatek,mt6768-gpufreq";
	};

	hacc@1000a000 {
		compatible = "mediatek,hacc";
		interrupts = <0x0 0xcb 0x8>;
		reg = <0x0 0x1000a000 0x0 0x1000>;
	};

	hwrng {
		compatible = "mediatek,mt67xx-rng";
		phandle = <0xa2>;
	};

	i2c0@11007000 {
		aed = <0x1a>;
		clock-div = <0x5>;
		clock-names = "main", "dma";
		clocks = <0x21 0xb 0x21 0x26>;
		compatible = "mediatek,i2c";
		eh_cfg = <0x30>;
		gpio_start = <0x10002a00>;
		id = <0x0>;
		interrupts = <0x0 0x69 0x8>;
		mem_len = <0x200>;
		phandle = <0xaf>;
		pu_cfg = <0x70>;
		reg = <0x0 0x11007000 0x0 0x1000 0x0 0x11000080 0x0 0x80>;
		rsel_cfg = <0x90>;
		scl-gpio-id = <0x53>;
		sda-gpio-id = <0x52>;
	};

	i2c1@11008000 {
		aed = <0x1a>;
		clock-div = <0x5>;
		clock-names = "main", "dma";
		clocks = <0x21 0xb 0x21 0x26>;
		compatible = "mediatek,i2c";
		eh_cfg = <0x30>;
		gpio_start = <0x10002a00>;
		id = <0x1>;
		interrupts = <0x0 0x6a 0x8>;
		mem_len = <0x200>;
		phandle = <0xb0>;
		pu_cfg = <0x70>;
		reg = <0x0 0x11008000 0x0 0x1000 0x0 0x11000100 0x0 0x80>;
		rsel_cfg = <0x90>;
		scl-gpio-id = <0x54>;
		sda-gpio-id = <0x51>;
	};

	i2c2@11009000 {
		aed = <0x1a>;
		ch_offset_ccu = <0x200>;
		ch_offset_default = <0x100>;
		clock-div = <0x5>;
		clock-names = "main", "dma";
		clocks = <0x21 0xb 0x21 0x26>;
		compatible = "mediatek,i2c";
		eh_cfg = <0x40>;
		gpio_start = <0x10002800>;
		id = <0x2>;
		interrupts = <0x0 0x6b 0x8>;
		mem_len = <0x200>;
		phandle = <0xb1>;
		pu_cfg = <0xa0>;
		reg = <0x0 0x11009000 0x0 0x1000 0x0 0x11000180 0x0 0x180>;
		rsel_cfg = <0xf0>;
		scl-gpio-id = <0x67>;
		sda-gpio-id = <0x68>;
	};

	i2c3@1100f000 {
		aed = <0x1a>;
		ch_offset_ccu = <0x200>;
		ch_offset_default = <0x100>;
		clock-div = <0x5>;
		clock-names = "main", "dma";
		clocks = <0x21 0xb 0x21 0x26>;
		compatible = "mediatek,i2c";
		eh_cfg = <0x30>;
		gpio_start = <0x10002600>;
		id = <0x3>;
		interrupts = <0x0 0x6c 0x8>;
		mem_len = <0x200>;
		phandle = <0xb2>;
		pu_cfg = <0x60>;
		reg = <0x0 0x1100f000 0x0 0x1000 0x0 0x11000300 0x0 0x100>;
		rsel_cfg = <0x90>;
		scl-gpio-id = <0x32>;
		sda-gpio-id = <0x33>;
	};

	i2c4@11011000 {
		aed = <0x1a>;
		ch_offset_ccu = <0x200>;
		ch_offset_default = <0x100>;
		clock-div = <0x5>;
		clock-names = "main", "dma";
		clocks = <0x21 0xb 0x21 0x26>;
		compatible = "mediatek,i2c";
		eh_cfg = <0x40>;
		gpio_start = <0x10002800>;
		id = <0x4>;
		interrupts = <0x0 0x6d 0x8>;
		mem_len = <0x200>;
		phandle = <0xb3>;
		pu_cfg = <0xa0>;
		reg = <0x0 0x11011000 0x0 0x1000 0x0 0x11000400 0x0 0x180>;
		rsel_cfg = <0xf0>;
		scl-gpio-id = <0x69>;
		sda-gpio-id = <0x6a>;
	};

	i2c5@11016000 {
		aed = <0x1a>;
		clock-div = <0x5>;
		clock-names = "main", "dma";
		clocks = <0x21 0xb 0x21 0x26>;
		compatible = "mediatek,i2c";
		eh_cfg = <0x30>;
		gpio_start = <0x10002600>;
		id = <0x5>;
		interrupts = <0x0 0x93 0x8>;
		mem_len = <0x200>;
		phandle = <0xb4>;
		pu_cfg = <0x60>;
		reg = <0x0 0x11016000 0x0 0x1000 0x0 0x11000580 0x0 0x80>;
		rsel_cfg = <0x90>;
		scl-gpio-id = <0x30>;
		sda-gpio-id = <0x31>;

		rt-swchg@53 {
			compatible = "richtek,swchg";
			hvdcp20_dp_gpio = <0x1e 0x96 0x0>;
			led_ctl_gpio = <0x1e 0xa5 0x0>;
			reg = <0x53>;
			rt,intr_gpio = <0x1e 0x9 0x0>;
			rt,intr_gpio_num = <0x9>;
			status = "okay";
			tc30_dm_gpio = <0x1e 0xb3 0x0>;

			rt9471 {
				aicr = <0x7a120>;
				charger_name = "primary_chg";
				chg_alias_name = "rt9471_chg";
				cv = <0x432380>;
				en_qon_rst;
				en_safe_tmr;
				en_te;
				ichg = <0x16e360>;
				ieoc = <0x30d40>;
				interrupt-names = "wdt", "chg_mivr", "vac_ov", "otg_fault", "chg_rdy", "chg_done", "aicc_done", "pe_done", "chg_tout", "ieoc", "rechg", "chg_batov";
				mivr = <0x432380>;
				mivr_track = <0x0>;
				rm-name = "rt9471";
				rm-slave-addr = [53];
				safe_tmr = <0xa>;
				vac_ovp = <0xd59f80>;
				wdt = <0x28>;
			};
		};
	};

	i2c6@1100d000 {
		aed = <0x1a>;
		clock-div = <0x5>;
		clock-names = "main", "dma";
		clocks = <0x21 0xb 0x21 0x26>;
		compatible = "mediatek,i2c";
		eh_cfg = <0x30>;
		gpio_start = <0x10002000>;
		id = <0x6>;
		interrupts = <0x0 0x94 0x8>;
		mem_len = <0x200>;
		phandle = <0xb5>;
		pu_cfg = <0x60>;
		reg = <0x0 0x1100d000 0x0 0x1000 0x0 0x11000600 0x0 0x80>;
		rsel_cfg = <0x90>;
		scl-gpio-id = <0x59>;
		sda-gpio-id = <0x5a>;
	};

	i2c7@11004000 {
		aed = <0x1a>;
		clock-div = <0x5>;
		clock-names = "main", "dma";
		clocks = <0x21 0xb 0x21 0x26>;
		compatible = "mediatek,i2c";
		eh_cfg = <0x30>;
		gpio_start = <0x10002600>;
		id = <0x7>;
		interrupts = <0x0 0x6e 0x8>;
		mem_len = <0x200>;
		phandle = <0xb6>;
		pu_cfg = <0x60>;
		reg = <0x0 0x11004000 0x0 0x1000 0x0 0x11000680 0x0 0x180>;
		rsel_cfg = <0x90>;
		scl-gpio-id = <0xaf>;
		sda-gpio-id = <0xb0>;

		speaker_amp@34 {
			#sound-dai-cells = <0x0>;
			compatible = "mediatek,speaker_amp";
			phandle = <0x54>;
			reg = <0x34>;
			status = "okay";
		};
	};

	i2c8@11005000 {
		aed = <0x1a>;
		clock-div = <0x5>;
		clock-names = "main", "dma";
		clocks = <0x21 0xb 0x21 0x26>;
		compatible = "mediatek,i2c";
		id = <0x8>;
		interrupts = <0x0 0x6f 0x8>;
		phandle = <0xb7>;
		reg = <0x0 0x11005000 0x0 0x1000 0x0 0x11000800 0x0 0x180>;
	};

	i2c_common {
		check_max_freq = [01];
		cnt_constraint = [01];
		compatible = "mediatek,i2c_common";
		control_irq_sel = [01];
		dma_support = [03];
		ext_time_config = [18 01];
		idvfs = [01];
		phandle = <0xae>;
		set_dt_div = [01];
		set_ltiming = [01];
		ver = [02];
	};

	imgsys@15020000 {
		#clock-cells = <0x1>;
		clock-names = "ISP_SCP_SYS_DIS", "ISP_SCP_SYS_ISP", "ISP_SCP_SYS_CAM", "ISP_CLK_IMG_DIP", "ISP_CLK_CAM", "ISP_CLK_CAMTG", "ISP_CLK_CAM_SENINF", "ISP_CLK_CAMSV0", "ISP_CLK_CAMSV1", "ISP_CLK_CAMSV2";
		clocks = <0x22 0x3 0x22 0x5 0x22 0xa 0x57 0x1 0x58 0x2 0x58 0x3 0x58 0x4 0x58 0x5 0x58 0x6 0x58 0x7>;
		compatible = "mediatek,imgsys", "syscon";
		phandle = <0x57>;
		reg = <0x0 0x15020000 0x0 0x1000>;
	};

	imp_iic@11017000 {
		compatible = "mediatek,imp_iic";
		reg = <0x0 0x11017000 0x0 0x1000>;
	};

	infra_dbgsystop_cpu0@0e000000 {
		compatible = "mediatek,infra_dbgsystop_cpu0";
		reg = <0x0 0xe000000 0x0 0x100000>;
	};

	infra_dbgsystop_cpu1@0e100000 {
		compatible = "mediatek,infra_dbgsystop_cpu1";
		reg = <0x0 0xe100000 0x0 0x100000>;
	};

	infra_dbgsystop_cpu2@0e200000 {
		compatible = "mediatek,infra_dbgsystop_cpu2";
		reg = <0x0 0xe200000 0x0 0x100000>;
	};

	infra_dbgsystop_cpu3@0e300000 {
		compatible = "mediatek,infra_dbgsystop_cpu3";
		reg = <0x0 0xe300000 0x0 0x100000>;
	};

	infra_dbgsystop_cpu4@0e400000 {
		compatible = "mediatek,infra_dbgsystop_cpu4";
		reg = <0x0 0xe400000 0x0 0x100000>;
	};

	infra_dbgsystop_cpu5@0e500000 {
		compatible = "mediatek,infra_dbgsystop_cpu5";
		reg = <0x0 0xe500000 0x0 0x100000>;
	};

	infra_dbgsystop_cpu6@0e600000 {
		compatible = "mediatek,infra_dbgsystop_cpu6";
		reg = <0x0 0xe600000 0x0 0x100000>;
	};

	infra_dbgsystop_cpu7@0e700000 {
		compatible = "mediatek,infra_dbgsystop_cpu7";
		reg = <0x0 0xe700000 0x0 0x100000>;
	};

	infra_mbist@1020d000 {
		compatible = "mediatek,infra_mbist";
		reg = <0x0 0x1020d000 0x0 0x1000>;
	};

	infracfg@1020e000 {
		compatible = "mediatek,infracfg";
		reg = <0x0 0x1020e000 0x0 0x1000>;
	};

	infracfg_ao@10001000 {
		#clock-cells = <0x1>;
		compatible = "mediatek,infracfg_ao", "syscon";
		interrupts = <0x0 0x47 0x1>;
		phandle = <0x21>;
		reg = <0x0 0x10001000 0x0 0x1000>;
	};

	interrupt-controller {
		#address-cells = <0x2>;
		#interrupt-cells = <0x3>;
		#redistributor-regions = <0x1>;
		#size-cells = <0x2>;
		compatible = "arm,gic-v3";
		interrupt-controller;
		interrupt-parent = <0x11>;
		interrupts = <0x1 0x9 0x4>;
		phandle = <0x11>;
		reg = <0x0 0xc000000 0x0 0x40000 0x0 0xc040000 0x0 0x200000 0x0 0xc53a650 0x0 0x50>;
	};

	intpol-controller@0 {
		#interrupt-cells = <0x3>;
		compatible = "mediatek,mt6577-sysirq";
		interrupt-controller;
		interrupt-parent = <0x11>;
		phandle = <0x1>;
		reg = <0x0 0xc53a650 0x0 0x50>;
	};

	io_cfg_bl@10002600 {
		compatible = "mediatek,io_cfg_bl";
		phandle = <0x18>;
		reg = <0x0 0x10002600 0x0 0x200>;
	};

	io_cfg_lb@10002400 {
		compatible = "mediatek,io_cfg_lb";
		phandle = <0x17>;
		reg = <0x0 0x10002400 0x0 0x200>;
	};

	io_cfg_lm@10002200 {
		compatible = "mediatek,io_cfg_lm";
		phandle = <0x16>;
		reg = <0x0 0x10002200 0x0 0x200>;
	};

	io_cfg_lt@10002000 {
		compatible = "mediatek,io_cfg_lt";
		phandle = <0x15>;
		reg = <0x0 0x10002000 0x0 0x200>;
	};

	io_cfg_rb@10002a00 {
		compatible = "mediatek,io_cfg_rb";
		phandle = <0x1a>;
		reg = <0x0 0x10002a00 0x0 0x200>;
	};

	io_cfg_rm@10002800 {
		compatible = "mediatek,io_cfg_rm";
		phandle = <0x19>;
		reg = <0x0 0x10002800 0x0 0x200>;
	};

	io_cfg_rt@10002c00 {
		compatible = "mediatek,io_cfg_rt";
		phandle = <0x1b>;
		reg = <0x0 0x10002c00 0x0 0x200>;
	};

	io_cfg_tl@10002e00 {
		compatible = "mediatek,io_cfg_tl";
		phandle = <0x1c>;
		reg = <0x0 0x10002e00 0x0 0x200>;
	};

	iocfg_0@10002000 {
		compatible = "mediatek,iocfg_0";
		reg = <0x0 0x10002000 0x0 0x200>;
	};

	iocfg_1@10002200 {
		compatible = "mediatek,iocfg_1";
		reg = <0x0 0x10002200 0x0 0x200>;
	};

	iocfg_2@10002400 {
		compatible = "mediatek,iocfg_2";
		reg = <0x0 0x10002400 0x0 0x200>;
	};

	iocfg_3@10002600 {
		compatible = "mediatek,iocfg_3";
		reg = <0x0 0x10002600 0x0 0x200>;
	};

	iocfg_4@10002800 {
		compatible = "mediatek,iocfg_4";
		reg = <0x0 0x10002800 0x0 0x200>;
	};

	iocfg_5@10002a00 {
		compatible = "mediatek,iocfg_5";
		reg = <0x0 0x10002a00 0x0 0x200>;
	};

	irq_nfc {
		compatible = "mediatek,irq_nfc-eint";
		phandle = <0xdd>;
	};

	irtx_pwm {
		compatible = "mediatek,irtx-pwm";
		phandle = <0xd9>;
		pwm_ch = <0x0>;
		pwm_data_invert = <0x0>;
	};

	kd_camera_hw1@1a040000 {
		clock-names = "CLK_TOP_CAMTG_SEL", "CLK_TOP_CAMTG1_SEL", "CLK_TOP_CAMTG2_SEL", "CLK_TOP_CAMTG3_SEL", "CLK_MCLK_6M", "CLK_MCLK_12M", "CLK_MCLK_13M", "CLK_MCLK_48M", "CLK_MCLK_52M", "CLK_MCLK_24M", "CLK_MCLK_26M", "CLK_CAM_SENINF_CG", "CLK_MIPI_C0_26M_CG", "CLK_MIPI_C1_26M_CG", "CLK_MIPI_ANA_0A_CG", "CLK_MIPI_ANA_0B_CG", "CLK_MIPI_ANA_1A_CG", "CLK_MIPI_ANA_1B_CG", "CLK_MIPI_ANA_2A_CG", "CLK_MIPI_ANA_2B_CG", "CLK_TOP_CAMTM_SEL_CG", "CLK_TOP_CAMTM_208_CG", "CLK_SCP_SYS_CAM";
		clocks = <0x12 0x56 0x12 0x57 0x12 0x58 0x12 0x59 0x12 0x14 0x12 0x13 0x12 0x1d 0x12 0x11 0x12 0x1c 0x12 0x12 0x13 0x58 0x4 0x3e 0xe 0x3e 0x12 0x60 0x0 0x61 0x0 0x62 0x0 0x63 0x0 0x64 0x0 0x65 0x0 0x12 0x6d 0x12 0x1a 0x22 0xa>;
		compatible = "mediatek,camera_hw";
		phandle = <0xcb>;
		pmic = <0x5f>;
		reg = <0x0 0x1a040000 0x0 0x1000>;
	};

	kp@10010000 {
		compatible = "mediatek,kp";
		interrupts = <0x0 0x49 0x2>;
		phandle = <0x9e>;
		reg = <0x0 0x10010000 0x0 0x1000>;
	};

	lastbus@10001000 {
		compatible = "mediatek,lastbus-v1";
		reg = <0x0 0x10001000 0x0 0x1000 0x0 0x10003000 0x0 0x1000>;
	};

	lk_charger {
		ac_charger_current = <0x16e360>;
		ac_charger_input_current = <0x16e360>;
		charging_host_charger_current = <0x16e360>;
		compatible = "mediatek,lk_charger";
		cur_threshold = <0x7a120>;
		enable_anime;
		enable_pd20_reset;
		enable_pe_plus;
		fast_charge_voltage = <0x2625a0>;
		max_charger_voltage = <0x632ea0>;
		non_std_ac_charger_current = <0x7a120>;
		pd_charger_current = <0x7a120>;
		phandle = <0xd7>;
		power_path_support;
		ta_ac_charger_current = <0x2dc6c0>;
		temp_t1_threshold = <0x0>;
		temp_t2_threshold = <0xf>;
		temp_t3_threshold = <0x2d>;
		temp_t4_threshold = <0x32>;
		usb_charger_current = <0x7a120>;
	};

	m4u@10205000 {
		cell-index = <0x0>;
		compatible = "mediatek,m4u";
		interrupts = <0x0 0xae 0x8>;
		reg = <0x0 0x10205000 0x0 0x1000>;
	};

	mali@13040000 {
		compatible = "mediatek,mali", "arm,mali-midgard", "arm,mali-bifrost";
		interrupt-names = "GPU", "MMU", "JOB", "EVENT", "PWR";
		interrupts = <0x0 0x112 0x8 0x0 0x113 0x8 0x0 0x114 0x8 0x0 0x115 0x8 0x0 0x116 0x8>;
		reg = <0x0 0x13040000 0x0 0x4000>;
	};

	mbist@17040000 {
		compatible = "mediatek,mbist";
		reg = <0x0 0x17040000 0x0 0x10000>;
	};

	mbist@17050000 {
		compatible = "mediatek,mbist";
		reg = <0x0 0x17050000 0x0 0x10000>;
	};

	mbist@17060000 {
		compatible = "mediatek,mbist";
		reg = <0x0 0x17060000 0x0 0x10000>;
	};

	mbist@17070000 {
		compatible = "mediatek,mbist";
		reg = <0x0 0x17070000 0x0 0x10000>;
	};

	mbist_ao@10013000 {
		compatible = "mediatek,mbist_ao";
		reg = <0x0 0x10013000 0x0 0x1000>;
	};

	mcdi@0010fc00 {
		compatible = "mediatek,mt6768-mcdi";
		mediatek,enabled = <0x1>;
		phandle = <0x6d>;
		reg = <0x0 0x10fc00 0x0 0x800 0x0 0xc53a000 0x0 0x1000>;
	};

	mcucfg@0c530000 {
		compatible = "mediatek,mcucfg";
		phandle = <0xa1>;
		reg = <0x0 0xc530000 0x0 0x10000>;
	};

	mcucfg_mp0_counter@0c530000 {
		compatible = "mediatek,mcucfg_mp0_counter";
		reg = <0x0 0xc530000 0x0 0x10000>;
	};

	mcupm_reg@10216000 {
		compatible = "mediatek,mcupm_reg";
		reg = <0x0 0x10216000 0x0 0x1000>;
	};

	mcupm_sram0@10217000 {
		compatible = "mediatek,mcupm_sram0";
		reg = <0x0 0x10217000 0x0 0x1000>;
	};

	mcupm_sram1@10218000 {
		compatible = "mediatek,mcupm_sram1";
		reg = <0x0 0x10218000 0x0 0x1000>;
	};

	mcupm_sram2@10211000 {
		compatible = "mediatek,mcupm_sram2";
		reg = <0x0 0x10211000 0x0 0x1000>;
	};

	mcupm_sram3@10213000 {
		compatible = "mediatek,mcupm_sram3";
		reg = <0x0 0x10213000 0x0 0x1000>;
	};

	md1_sim1_hot_plug_eint {
		phandle = <0xe0>;
	};

	md1_sim2_hot_plug_eint {
		phandle = <0xe1>;
	};

	md_auxadc {
		compatible = "mediatek,md_auxadc";
		io-channel-names = "md-channel";
		io-channels = <0x23 0x2>;
		phandle = <0xa4>;
	};

	md_ccif0@1020a000 {
		compatible = "mediatek,md_ccif0";
		reg = <0x0 0x1020a000 0x0 0x1000>;
	};

	md_ccif1@1020c000 {
		compatible = "mediatek,md_ccif1";
		reg = <0x0 0x1020c000 0x0 0x1000>;
	};

	md_ccif2@1023d000 {
		compatible = "mediatek,md_ccif2";
		reg = <0x0 0x1023d000 0x0 0x1000>;
	};

	md_ccif3@1023f000 {
		compatible = "mediatek,md_ccif3";
		reg = <0x0 0x1023f000 0x0 0x1000>;
	};

	mdcldma@10014000 {
		clock-names = "scp-sys-md1-main", "infra-cldma-bclk", "infra-ccif-ap", "infra-ccif-md", "infra-ccif1-ap", "infra-ccif1-md", "infra-ccif2-ap", "infra-ccif2-md";
		clocks = <0x22 0x0 0x21 0x32 0x21 0x29 0x21 0x2c 0x21 0x23 0x21 0x24 0x21 0x51 0x21 0x52>;
		compatible = "mediatek,mdcldma";
		interrupts = <0x0 0xb4 0x4 0x0 0xa4 0x8 0x0 0xa5 0x8 0x0 0x4b 0x2>;
		mediatek,cldma_capability = <0x6>;
		mediatek,md_id = <0x0>;
		phandle = <0xa3>;
		reg = <0x0 0x10014000 0x0 0x1000 0x0 0x1021b000 0x0 0x1000 0x0 0x10209000 0x0 0x1000 0x0 0x1020a000 0x0 0x1000>;
	};

	mdcldmain@1021c000 {
		compatible = "mediatek,mdcldmain";
		reg = <0x0 0x1021c000 0x0 0x400>;
	};

	mdcldmain_ao@10015000 {
		compatible = "mediatek,mdcldmain_ao";
		reg = <0x0 0x10015000 0x0 0x400>;
	};

	mdcldmamisc@1021c000 {
		compatible = "mediatek,mdcldmamisc";
		reg = <0x0 0x1021c000 0x0 0x1000>;
	};

	mdcldmamisc@1021c900 {
		compatible = "mediatek,mdcldmamisc";
		reg = <0x0 0x1021c900 0x0 0x400>;
	};

	mdcldmamisc_ao@10015800 {
		compatible = "mediatek,mdcldmamisc_ao";
		reg = <0x0 0x10015800 0x0 0x400>;
	};

	mdcldmaout@1021c400 {
		compatible = "mediatek,mdcldmaout";
		reg = <0x0 0x1021c400 0x0 0x400>;
	};

	mdcldmaout_ao@10015400 {
		compatible = "mediatek,mdcldmaout_ao";
		reg = <0x0 0x10015400 0x0 0x400>;
	};

	mdp_ccorr0@14005000 {
		clock-names = "MDP_CCORR";
		clocks = <0x24 0x1>;
		compatible = "mediatek,mdp_ccorr0";
		interrupts = <0x0 0xef 0x8>;
		phandle = <0x2c>;
		reg = <0x0 0x14005000 0x0 0x1000>;
	};

	mdp_rdma0@14004000 {
		clock-names = "MDP_RDMA0";
		clocks = <0x24 0x0>;
		compatible = "mediatek,mdp_rdma0";
		interrupts = <0x0 0xe0 0x8>;
		phandle = <0x25>;
		reg = <0x0 0x14004000 0x0 0x1000>;
	};

	mdp_rsz0@14006000 {
		clock-names = "MDP_RSZ0";
		clocks = <0x24 0x2>;
		compatible = "mediatek,mdp_rsz0";
		interrupts = <0x0 0xe1 0x8>;
		phandle = <0x26>;
		reg = <0x0 0x14006000 0x0 0x1000>;
	};

	mdp_rsz1@14007000 {
		clock-names = "MDP_RSZ1";
		clocks = <0x24 0x3>;
		compatible = "mediatek,mdp_rsz1";
		interrupts = <0x0 0xe2 0x8>;
		phandle = <0x27>;
		reg = <0x0 0x14007000 0x0 0x1000>;
	};

	mdp_tdshp0@1400a000 {
		clock-names = "MDP_TDSHP";
		clocks = <0x24 0x4>;
		compatible = "mediatek,mdp_tdshp0";
		phandle = <0x2a>;
		reg = <0x0 0x1400a000 0x0 0x1000>;
	};

	mdp_wdma0@14008000 {
		clock-names = "MDP_WDMA";
		clocks = <0x24 0x6>;
		compatible = "mediatek,mdp_wdma0";
		interrupts = <0x0 0xe5 0x8>;
		phandle = <0x28>;
		reg = <0x0 0x14008000 0x0 0x1000>;
	};

	mdp_wrot0@14009000 {
		clock-names = "MDP_WROT0";
		clocks = <0x24 0x5>;
		compatible = "mediatek,mdp_wrot0";
		interrupts = <0x0 0xe4 0x8>;
		phandle = <0x29>;
		reg = <0x0 0x14009000 0x0 0x1000>;
	};

	memory {
		device_type = "memory";
		reg = <0x0 0x40000000 0x0 0x3e605000>;
	};

	memory-ssmr-features {
		2d_fr-size = <0x0 0x0>;
		compatible = "mediatek,memory-ssmr-features";
		iris-recognition-size = <0x0 0x10000000>;
		phandle = <0xd1>;
		prot-sharedmem-size = <0x0 0x8000000>;
		sdsp-firmware-size = <0x0 0x1000000>;
		sdsp-tee-sharedmem-size = <0x0 0x1000000>;
		svp-size = <0x0 0x10000000>;
		ta-elf-size = <0x0 0x1000000>;
		ta-stack-heap-size = <0x0 0x6000000>;
		tui-size = <0x0 0x4000000>;
		wfd-size = <0x0 0x4000000>;
	};

	mfg_cfg@13000000 {
		#clock-cells = <0x1>;
		compatible = "mediatek,mfgcfg", "syscon";
		phandle = <0x55>;
		reg = <0x0 0x13000000 0x0 0x1000>;
	};

	mipi_rx_ana_csi0a@11c10000 {
		#clock-cells = <0x1>;
		compatible = "mediatek,mipi_rx_ana_csi0a", "syscon";
		phandle = <0x60>;
		reg = <0x0 0x11c10000 0x0 0x1000>;
	};

	mipi_rx_ana_csi0b@11c11000 {
		#clock-cells = <0x1>;
		compatible = "mediatek,mipi_rx_ana_csi0b", "syscon";
		phandle = <0x61>;
		reg = <0x0 0x11c11000 0x0 0x1000>;
	};

	mipi_rx_ana_csi1a@11c12000 {
		#clock-cells = <0x1>;
		compatible = "mediatek,mipi_rx_ana_csi1a", "syscon";
		phandle = <0x62>;
		reg = <0x0 0x11c12000 0x0 0x1000>;
	};

	mipi_rx_ana_csi1b@11c13000 {
		#clock-cells = <0x1>;
		compatible = "mediatek,mipi_rx_ana_csi1b", "syscon";
		phandle = <0x63>;
		reg = <0x0 0x11c13000 0x0 0x1000>;
	};

	mipi_rx_ana_csi2a@11c14000 {
		#clock-cells = <0x1>;
		compatible = "mediatek,mipi_rx_ana_csi2a", "syscon";
		phandle = <0x64>;
		reg = <0x0 0x11c14000 0x0 0x1000>;
	};

	mipi_rx_ana_csi2b@11c15000 {
		#clock-cells = <0x1>;
		compatible = "mediatek,mipi_rx_ana_csi2b", "syscon";
		phandle = <0x65>;
		reg = <0x0 0x11c15000 0x0 0x1000>;
	};

	mipi_tx0@11c80000 {
		compatible = "mediatek,mipi_tx0";
		reg = <0x0 0x11c80000 0x0 0x10000>;
	};

	mm_mutex@14016000 {
		compatible = "mediatek,mm_mutex";
		reg = <0x0 0x14016000 0x0 0x1000>;
	};

	mmdvfs_pmqos {
		cam_freq = "cam_step0", "cam_step1", "cam_step2";
		cam_step0 = <0x222 0x1 0x2 0x7>;
		cam_step1 = <0x138 0x1 0x2 0x4>;
		cam_step2 = <0xe4 0x1 0x2 0x5>;
		clock-names = "mmdvfs_clk_mm_sel_ck", "mmdvfs_clk_venc_sel_ck", "mmdvfs_clk_cam_sel_ck", "mmdvfs_clk_mmpll_ck", "mmdvfs_clk_univpll1_d2_ck", "mmdvfs_clk_mmpll_d2_ck", "mmdvfs_clk_univpll_d3_ck", "mmdvfs_clk_syspll_d2_ck";
		clocks = <0x12 0x52 0x12 0x6e 0x12 0x6f 0x12 0x21 0x12 0x17 0x12 0x22 0x12 0x19 0x12 0x1>;
		compatible = "mediatek,mmdvfs_pmqos";
		disp_freq = "mm_step0", "mm_step1", "mm_step2";
		img_freq = "mm_step0", "mm_step1", "mm_step2";
		mdp_freq = "mm_step0", "mm_step1", "mm_step2";
		mm_step0 = <0x1c9 0x1 0x0 0x3>;
		mm_step1 = <0x138 0x1 0x0 0x4>;
		mm_step2 = <0xe4 0x1 0x0 0x5>;
		vdec_freq = "mm_step0", "mm_step1", "mm_step2";
		venc_freq = "venc_step0", "venc_step1", "venc_step2";
		venc_step0 = <0x1c9 0x1 0x1 0x3>;
		venc_step1 = <0x1a0 0x1 0x1 0x6>;
		venc_step2 = <0x138 0x1 0x1 0x4>;
		vopp_steps = <0x0 0x1 0x3>;
	};

	mmsys_config@14000000 {
		#clock-cells = <0x1>;
		clock-names = "CAM_MDP", "IMG_DL_RELAY", "IMG_DL_ASYNC_TOP";
		clocks = <0x24 0x17 0x24 0x1c 0x24 0x1d>;
		compatible = "mediatek,mmsys_config", "syscon";
		interrupts = <0x0 0xf0 0x8>;
		phandle = <0x24>;
		reg = <0x0 0x14000000 0x0 0x1000>;
	};

	mobicore {
		compatible = "trustonic,mobicore";
		interrupts = <0x0 0x129 0x1>;
	};

	modem_temp_share@10018000 {
		compatible = "mediatek,modem_temp_share";
		reg = <0x0 0x10018000 0x0 0x1000>;
	};

	mrdump_ext_rst {
		compatible = "mediatek, mrdump_disable";
		mode = "IRQ";
		phandle = <0x9f>;
		status = "okay";
	};

	msdc0_top@11cd0000 {
		compatible = "mediatek,msdc0_top";
		reg = <0x0 0x11cd0000 0x0 0x1000>;
	};

	msdc1_top@11c90000 {
		compatible = "mediatek,msdc1_top";
		reg = <0x0 0x11c90000 0x0 0x1000>;
	};

	msdc@11230000 {
		bootable;
		bus-width = <0x8>;
		cap-mmc-highspeed;
		clk_src = [01];
		clock-names = "msdc0-clock", "msdc0-hclock", "msdc0-aes-clock";
		clocks = <0x21 0x4c 0x21 0x1c 0x21 0x44>;
		compatible = "mediatek,msdc";
		host_function = [00];
		index = [00];
		interrupts = <0x0 0x64 0x8>;
		max-frequency = <0xbebc200>;
		mmc-ddr-1_8v;
		mmc-hs200-1_8v;
		mmc-hs400-1_8v;
		no-sd;
		no-sdio;
		non-removable;
		phandle = <0xc3>;
		pinctl = <0x32>;
		pinctl_hs200 = <0x34>;
		pinctl_hs400 = <0x33>;
		reg = <0x0 0x11230000 0x0 0x10000>;
		register_setting = <0x35>;
		req_vcore = <0x1>;
		status = "okay";
		vmmc-supply = <0x36>;
	};

	msdc@11240000 {
		bus-width = <0x4>;
		cap-sd-highspeed;
		cd-gpios = <0x1e 0x4 0x0>;
		cd_level = [01];
		clk_src = [02];
		clock-names = "msdc1-clock", "msdc1-hclock";
		clocks = <0x21 0x4d 0x21 0x1d>;
		compatible = "mediatek,msdc";
		host_function = [01];
		index = [01];
		interrupts = <0x0 0x65 0x8>;
		max-frequency = <0xbebc200>;
		no-mmc;
		no-sdio;
		phandle = <0xc4>;
		pinctl = <0x37>;
		pinctl_ddr50 = <0x3a>;
		pinctl_sdr104 = <0x38>;
		pinctl_sdr50 = <0x39>;
		reg = <0x0 0x11240000 0x0 0x10000>;
		register_setting = <0x3b>;
		sd-uhs-ddr50;
		sd-uhs-sdr104;
		sd-uhs-sdr12;
		sd-uhs-sdr25;
		sd-uhs-sdr50;
		status = "okay";
		vmmc-supply = <0x3c>;
		vqmmc-supply = <0x3d>;
	};

	mt6358_gauge {
		alias_name = "MT6358";
		compatible = "mediatek,mt6358_gauge";
		gauge_name = "gauge";
	};

	mt6358_snd {
		compatible = "mediatek,mt6358-sound";
		mediatek,pwrap-regmap = <0x20>;
		phandle = <0x52>;
	};

	mt6370_pmu_dts {
		#interrupt-cells = <0x1>;
		interrupt-controller;
		mt6370,intr_gpio = <0x1e 0x3 0x0>;
		mt6370,intr_gpio_num = <0x3>;
		phandle = <0xe2>;

		bled {
			compatible = "mediatek,mt6370_pmu_bled";
			interrupt-names = "bled_ocp";
			mt,bl_ocp_level = <0x2>;
			mt,bl_ovp_level = <0x3>;
			mt,bled_curr_scale = <0x0>;
			mt,bled_flash_ramp = <0x1>;
			mt,bled_name = "mt6370_pmu_bled";
			mt,bled_ramptime = <0x3>;
			mt,chan_en = <0xf>;
			mt,map_linear;
			mt,max_bled_brightness = <0x200>;
			mt,pwm_avg_cycle = <0x0>;
			mt,pwm_deglitch = <0x1>;
			mt,pwm_fsample = <0x2>;
			mt,pwm_hys = <0x0>;
			mt,pwm_hys_en = <0x1>;
			mt,pwm_lpf_coef = <0x0>;
			mt,use_pwm;
		};

		charger {
			aicr = <0x7a120>;
			charger_name = "primary_chg";
			compatible = "mediatek,mt6370_pmu_charger";
			cv = <0x426030>;
			dc_wdt = <0x3d0900>;
			enable_te;
			enable_wdt;
			ichg = <0x1e8480>;
			ieoc = <0x249f0>;
			interrupt-names = "chg_mivr", "chg_aiclmeasi", "attachi", "ovpctrl_uvp_d_evt", "chg_wdtmri", "chg_vbusov", "chg_tmri", "chg_treg", "dcdti";
			ircmp_resistor = <0x61a8>;
			ircmp_vclamp = <0x7d00>;
			lbp_dt = <0x1>;
			lbp_hys_sel = <0x1>;
			load_switch_name = "primary_load_switch";
			mivr = <0x432380>;
			safety_timer = <0xc>;
		};

		core {
			compatible = "mediatek,mt6370_pmu_core";
			i2cstmr_rst_tmr = <0x0>;
			int_deg = <0x0>;
			int_wdt = <0x0>;
			interrupt-names = "otp", "vdda_ovp", "vdda_uv";
			mrstb_en;
			mrstb_tmr = <0x3>;
		};

		dsv {
			compatible = "mediatek,mt6370_pmu_dsv";
			db_delay = <0x3>;
			db_ext_en = <0x0>;
			db_freq_pm = <0x0>;
			db_periodic_fix = <0x0>;
			db_periodic_mode = <0x0>;
			db_single_pin = <0x0>;
			db_startup = <0x0>;
			db_vbst = <0x1644>;
			db_vneg_20ms = <0x1>;
			db_vneg_disc = <0x0>;
			db_vneg_slew = <0x1>;
			db_vpos_20ms = <0x1>;
			db_vpos_disc = <0x1>;
			db_vpos_slew = <0x1>;
			interrupt-names = "dsv_vneg_ocp", "dsv_vpos_ocp", "dsv_bst_ocp", "dsv_vneg_scp", "dsv_vpos_scp";

			mt6370_dsvn {
				regulator-max-microvolt = <0x5b8d80>;
				regulator-min-microvolt = <0x3d0900>;
				regulator-name = "dsv_neg";
			};

			mt6370_dsvp {
				regulator-max-microvolt = <0x5b8d80>;
				regulator-min-microvolt = <0x3d0900>;
				regulator-name = "dsv_pos";
			};
		};

		ldo {
			compatible = "mediatek,mt6370_pmu_ldo";
			interrupt-names = "ldo_oc";
			ldo_oms = <0x1>;
			ldo_vrc_lt = <0x1>;

			mt6370_ldo {
				regulator-max-microvolt = <0x3d0900>;
				regulator-min-microvolt = <0x186a00>;
				regulator-name = "irtx_ldo";
			};
		};

		mt6370_pmu_fled1 {
			compatible = "mediatek,mt6370_pmu_fled1";
			fled_enable = <0x1>;
			interrupt-names = "fled_lvf", "fled2_short", "fled1_short";
			strobe_cur = <0x124f80>;
			strobe_timeout = <0x960>;
			torch_cur = <0x493e0>;
		};

		mt6370_pmu_fled2 {
			compatible = "mediatek,mt6370_pmu_fled2";
			fled_enable = <0x1>;
			strobe_cur = <0xf4240>;
			strobe_timeout = <0x4b0>;
			torch_cur = <0x30d40>;
		};

		rgbled {
			compatible = "mediatek,mt6370_pmu_rgbled";
			interrupt-names = "isink4_short", "isink3_short", "isink2_short", "isink1_short", "isink4_open", "isink3_open", "isink2_open", "isink1_open";
			mt,led_default_trigger = "cc_mode", "cc_mode", "cc_mode", "none";
			mt,led_name = "mt6370_pmu_led1", "mt6370_pmu_led2", "mt6370_pmu_led3", "mt6370_pmu_led4";
		};
	};

	mt6768-afe-pcm@11220000 {
		apmixed = <0x3e>;
		clock-names = "aud_afe_clk", "aud_dac_clk", "aud_dac_predis_clk", "aud_adc_clk", "aud_apll22m_clk", "aud_apll24m_clk", "aud_apll1_tuner_clk", "aud_tml_clk", "aud_infra_axi_clk", "aud_infra_26m_clk", "top_mux_audio", "top_mux_audio_int", "top_sys_pll1_d4", "top_mux_aud_1", "top_apll1_ck", "top_mux_aud_eng1", "top_apll1_d8", "top_i2s0_m_sel", "top_i2s1_m_sel", "top_i2s2_m_sel", "top_i2s3_m_sel", "top_apll12_div0", "top_apll12_div1", "top_apll12_div2", "top_apll12_div3", "apmixed_apll1", "top_clk26m_clk";
		clocks = <0x3f 0x0 0x3f 0x5 0x3f 0x6 0x3f 0x4 0x3f 0x1 0x3f 0x2 0x3f 0x3 0x3f 0x7 0x21 0x2b 0x21 0x33 0x12 0x5f 0x12 0x60 0x12 0x3 0x12 0x61 0x12 0x29 0x12 0x62 0x12 0x2c 0x12 0x82 0x12 0x83 0x12 0x84 0x12 0x85 0x12 0x70 0x12 0x71 0x12 0x72 0x12 0x73 0x3e 0x8 0x13>;
		compatible = "mediatek,mt6768-sound";
		interrupts = <0x0 0xa9 0x8>;
		phandle = <0x53>;
		pinctrl-0 = <0x40>;
		pinctrl-1 = <0x41>;
		pinctrl-10 = <0x4a>;
		pinctrl-11 = <0x4b>;
		pinctrl-12 = <0x4c>;
		pinctrl-13 = <0x4d>;
		pinctrl-16 = <0x4e>;
		pinctrl-17 = <0x4f>;
		pinctrl-18 = <0x50>;
		pinctrl-19 = <0x51>;
		pinctrl-2 = <0x42>;
		pinctrl-3 = <0x43>;
		pinctrl-4 = <0x44>;
		pinctrl-5 = <0x45>;
		pinctrl-6 = <0x46>;
		pinctrl-7 = <0x47>;
		pinctrl-8 = <0x48>;
		pinctrl-9 = <0x49>;
		pinctrl-names = "aud_clk_mosi_off", "aud_clk_mosi_on", "aud_clk_miso_off", "aud_clk_miso_on", "aud_dat_mosi_off", "aud_dat_mosi_on", "aud_dat_miso_off", "aud_dat_miso_on", "aud_gpio_i2s0_off", "aud_gpio_i2s0_on", "aud_gpio_i2s1_off", "aud_gpio_i2s1_on", "aud_gpio_i2s2_off", "aud_gpio_i2s2_on", "vow_dat_miso_off", "vow_dat_miso_on", "vow_clk_miso_off", "vow_clk_miso_on";
		reg = <0x0 0x11220000 0x0 0x1000>;
		topckgen = <0x12>;
	};

	mt_charger {
		compatible = "mediatek,mt-charger";
		phandle = <0xd6>;
	};

	mt_cpufreq {
		compatible = "mediatek,mt-cpufreq";
		phandle = <0xa6>;
	};

	mt_soc_playback_offload {
		compatible = "mediatek,mt_soc_offload_common";
	};

	mtk-btcvsd-snd@18050000 {
		compatible = "mediatek,mtk-btcvsd-snd";
		disable_write_silence = <0x0>;
		interrupts = <0x0 0x11b 0x8>;
		mediatek,infracfg = <0x21>;
		mediatek,offset = <0xf00 0x800 0x140 0x144 0x148>;
		reg = <0x0 0x18050000 0x0 0x1000 0x0 0x18080000 0x0 0x10000>;
	};

	mtkfb@0 {
		compatible = "mediatek,mtkfb";
		phandle = <0xc7>;
	};

	nebula {
		#address-cells = <0x2>;
		#size-cells = <0x2>;
		compatible = "android,nebula-smc-v1";
		ranges;
		tee-id = <0x1>;
		tee-name = "nebula";

		nebula-gz-log {
			compatible = "android,nebula-gz-log-v1";
		};

		nebula-irq {
			compatible = "android,nebula-irq-v1";
			ppi-interrupt-parent = <0x11>;
		};

		nebula-virtio {
			compatible = "android,nebula-virtio-v1";
		};
	};

	nfc {
		compatible = "mediatek,nfc-gpio-v2";
		gpio-irq = <0x9>;
		gpio-irq-std = <0x1e 0x9 0x0>;
		gpio-rst = <0x9f>;
		gpio-rst-std = <0x1e 0x9f 0x0>;
		phandle = <0xdc>;
	};

	nfi@11018000 {
		compatible = "mediatek,nfi";
		reg = <0x0 0x11018000 0x0 0x1000>;
	};

	nfiecc@11019000 {
		compatible = "mediatek,nfiecc";
		reg = <0x0 0x11019000 0x0 0x1000>;
	};

	odm {
		compatible = "simple-bus";
		phandle = <0xd0>;
	};

	otg_iddig {
		compatible = "mediatek,usb_iddig_bi_eint";
		fake_typec_otg_detect;
		io-channel-names = "AUX_IN4_CHG";
		io-channels = <0x23 0x4>;
		phandle = <0xd3>;
	};

	pericfg@10003000 {
		#clock-cells = <0x1>;
		compatible = "mediatek,pericfg", "syscon";
		phandle = <0x6e>;
		reg = <0x0 0x10003000 0x0 0x1000>;
	};

	pinctrl {
		#gpio-cells = <0x2>;
		#interrupt-cells = <0x4>;
		compatible = "mediatek,mt6768-pinctrl";
		gpio-controller;
		gpio-ranges = <0x1e 0x0 0x0 0xba>;
		interrupt-controller;
		interrupts = <0x0 0xba 0x4>;
		phandle = <0x1e>;
		pins-are-numbered;
		reg_base_eint = <0x1d>;
		reg_bases = <0x14 0x15 0x16 0x17 0x18 0x19 0x1a 0x1b 0x1c>;

		aud_clk_miso_off {
			phandle = <0x42>;

			pins_cmd0_dat {
				pinmux = <0x8c00 0x8d00>;
			};
		};

		aud_clk_miso_on {
			phandle = <0x43>;

			pins_cmd0_dat {
				input-schmitt-enable;
				pinmux = <0x8c01>;
			};

			pins_cmd1_dat {
				input-schmitt-enable;
				pinmux = <0x8d01>;
			};
		};

		aud_clk_mosi_off {
			phandle = <0x40>;

			pins_cmd0_dat {
				pinmux = <0x8800 0x8900>;
			};
		};

		aud_clk_mosi_on {
			phandle = <0x41>;

			pins_cmd0_dat {
				input-schmitt-enable;
				pinmux = <0x8801>;
			};

			pins_cmd1_dat {
				input-schmitt-enable;
				pinmux = <0x8901>;
			};
		};

		aud_dat_miso_off {
			phandle = <0x46>;

			pins_cmd0_dat {
				bias-disable;
				input-enable;
				pinmux = <0x8c00>;
				slew-rate = <0x0>;
			};

			pins_cmd1_dat {
				bias-disable;
				input-enable;
				pinmux = <0x8d00>;
				slew-rate = <0x0>;
			};

			pins_cmd2_dat {
				bias-disable;
				input-enable;
				pinmux = <0x8e00>;
				slew-rate = <0x0>;
			};

			pins_cmd3_dat {
				bias-disable;
				input-enable;
				pinmux = <0x8f00>;
				slew-rate = <0x0>;
			};
		};

		aud_dat_miso_on {
			phandle = <0x47>;

			pins_cmd0_dat {
				input-schmitt-enable;
				pinmux = <0x8c01>;
			};

			pins_cmd1_dat {
				input-schmitt-enable;
				pinmux = <0x8d01>;
			};

			pins_cmd2_dat {
				input-schmitt-enable;
				pinmux = <0x8e01>;
			};

			pins_cmd3_dat {
				input-schmitt-enable;
				pinmux = <0x8f01>;
			};
		};

		aud_dat_mosi_off {
			phandle = <0x44>;

			pins_cmd0_dat {
				bias-disable;
				input-enable;
				pinmux = <0x8800>;
				slew-rate = <0x0>;
			};

			pins_cmd1_dat {
				bias-disable;
				input-enable;
				pinmux = <0x8900>;
				slew-rate = <0x0>;
			};

			pins_cmd2_dat {
				bias-disable;
				input-enable;
				pinmux = <0x8a00>;
				slew-rate = <0x0>;
			};

			pins_cmd3_dat {
				bias-pull-down;
				input-enable;
				pinmux = <0x8b00>;
				slew-rate = <0x0>;
			};
		};

		aud_dat_mosi_on {
			phandle = <0x45>;

			pins_cmd0_dat {
				input-schmitt-enable;
				pinmux = <0x8801>;
			};

			pins_cmd1_dat {
				input-schmitt-enable;
				pinmux = <0x8901>;
			};

			pins_cmd2_dat {
				input-schmitt-enable;
				pinmux = <0x8a01>;
			};

			pins_cmd3_dat {
				input-schmitt-enable;
				pinmux = <0x8b01>;
			};
		};

		aud_gpio_i2s0_off {
			phandle = <0x48>;

			pins_cmd_dat {
				pinmux = <0x2800>;
			};
		};

		aud_gpio_i2s0_on {
			phandle = <0x49>;

			pins_cmd_dat {
				pinmux = <0x2802>;
			};
		};

		aud_gpio_i2s1_off {
			phandle = <0x4a>;
		};

		aud_gpio_i2s1_on {
			phandle = <0x4b>;
		};

		aud_gpio_i2s2_off {
			phandle = <0x4c>;
		};

		aud_gpio_i2s2_on {
			phandle = <0x4d>;
		};

		msdc0@default {
			phandle = <0x32>;

			pins_clk {
				drive-strength = [03];
			};

			pins_cmd {
				drive-strength = [03];
			};

			pins_dat {
				drive-strength = [03];
			};

			pins_ds {
				drive-strength = [03];
			};

			pins_rst {
				drive-strength = [03];
			};
		};

		msdc0@hs200 {
			phandle = <0x34>;

			pins_clk {
				drive-strength = [04];
			};

			pins_cmd {
				drive-strength = [03];
			};

			pins_dat {
				drive-strength = [04];
			};

			pins_ds {
				drive-strength = [04];
			};

			pins_rst {
				drive-strength = [03];
			};
		};

		msdc0@hs400 {
			phandle = <0x33>;

			pins_clk {
				drive-strength = [04];
			};

			pins_cmd {
				drive-strength = [03];
			};

			pins_dat {
				drive-strength = [04];
			};

			pins_ds {
				drive-strength = [04];
			};

			pins_rst {
				drive-strength = [03];
			};
		};

		msdc0@register_default {
			cmd_edge = [00];
			phandle = <0x35>;
			rdata_edge = [00];
			wdata_edge = [00];
		};

		msdc1@ddr50 {
			phandle = <0x3a>;

			pins_clk {
				drive-strength = [03];
			};

			pins_cmd {
				drive-strength = [03];
			};

			pins_dat {
				drive-strength = [03];
			};
		};

		msdc1@default {
			phandle = <0x37>;

			pins_clk {
				drive-strength = [03];
			};

			pins_cmd {
				drive-strength = [03];
			};

			pins_dat {
				drive-strength = [03];
			};
		};

		msdc1@register_default {
			cmd_edge = [00];
			phandle = <0x3b>;
			rdata_edge = [00];
			wdata_edge = [00];
		};

		msdc1@sdr104 {
			phandle = <0x38>;

			pins_clk {
				drive-strength = [03];
			};

			pins_cmd {
				drive-strength = [03];
			};

			pins_dat {
				drive-strength = [03];
			};
		};

		msdc1@sdr50 {
			phandle = <0x39>;

			pins_clk {
				drive-strength = [03];
			};

			pins_cmd {
				drive-strength = [03];
			};

			pins_dat {
				drive-strength = [03];
			};
		};

		vow_clk_miso_off {
			phandle = <0x50>;

			pins_cmd3_dat {
				pinmux = <0x8f00>;
			};
		};

		vow_clk_miso_on {
			phandle = <0x51>;

			pins_cmd3_dat {
				pinmux = <0x8f04>;
			};
		};

		vow_dat_miso_off {
			phandle = <0x4e>;

			pins_cmd1_dat {
				pinmux = <0x8e00>;
			};
		};

		vow_dat_miso_on {
			phandle = <0x4f>;

			pins_cmd1_dat {
				pinmux = <0x8e04>;
			};
		};
	};

	pmic_clock_buffer_ctrl {
		compatible = "mediatek,pmic_clock_buffer";
		mediatek,clkbuf-config = <0x2 0x1 0x1 0x2 0x0 0x0 0x0>;
		mediatek,clkbuf-driving-current = <0x1 0x1 0x1 0x1 0x1 0x1 0x1>;
		mediatek,clkbuf-quantity = <0x7>;
		phandle = <0xda>;
	};

	pmu {
		compatible = "arm,armv8-pmuv3";
		interrupt-parent = <0x11>;
		interrupts = <0x1 0x7 0x8>;
	};

	psci {
		compatible = "arm,psci-1.0";
		method = "smc";
	};

	pwm@11006000 {
		clock-names = "PWM1-main", "PWM2-main", "PWM3-main", "PWM4-main", "PWM5-main", "PWM6-main", "PWM-HCLK-main", "PWM-main";
		clocks = <0x21 0x10 0x21 0x11 0x21 0x12 0x21 0x13 0x21 0x14 0x21 0x30 0x21 0xf 0x21 0x15>;
		compatible = "mediatek,pwm";
		interrupts = <0x0 0x62 0x8>;
		reg = <0x0 0x11006000 0x0 0x1000>;
	};

	pwrap@1000d000 {
		clock-names = "spi", "wrap";
		clocks = <0x13 0x13>;
		compatible = "mediatek,mt6768-pwrap";
		interrupts = <0x0 0xc2 0x4>;
		phandle = <0x20>;
		reg = <0x0 0x1000d000 0x0 0x1000>;
		reg-names = "pwrap";

		mt6358-pmic {
			#interrupt-cells = <0x2>;
			compatible = "mediatek,mt6358-pmic";
			interrupt-controller;
			interrupt-names = "vproc11_oc", "vproc12_oc", "vcore_oc", "vgpu_oc", "vmodem_oc", "vdram1_oc", "vs1_oc", "vs2_oc", "vpa_oc", "vcore_preoc", "vfe28_oc", "vxo22_oc", "vrf18_oc", "vrf12_oc", "vefuse_oc", "vcn33_oc", "vcn28_oc", "vcn18_oc", "vcama1_oc", "vcama2_oc", "vcamd_oc", "vcamio_oc", "vldo28_oc", "va12_oc", "vaux18_oc", "vaud28_oc", "vio28_oc", "vio18_oc", "vsram_proc11_oc", "vsram_proc12_oc", "vsram_others_oc", "vsram_gpu_oc", "vdram2_oc", "vmc_oc", "vmch_oc", "vemc_oc", "vsim1_oc", "vsim2_oc", "vibr_oc", "vusb_oc", "vbif28_oc", "pwrkey", "homekey", "pwrkey_r", "homekey_r", "ni_lbat_int", "chrdet", "chrdet_edge", "vcdt_hv_det", "rtc", "fg_bat0_h", "fg_bat0_l", "fg_cur_h", "fg_cur_l", "fg_zcv", "fg_bat1_h", "fg_bat1_l", "fg_n_charge_l", "fg_iavg_h", "fg_iavg_l", "fg_time_h", "fg_discharge", "fg_charge", "baton_lv", "baton_ht", "baton_bat_in", "baton_bat_out", "bif", "bat_h", "bat_l", "bat2_h", "bat2_l", "bat_temp_h", "bat_temp_l", "auxadc_imp", "nag_c_dltv", "audio", "accdet", "accdet_eint0", "accdet_eint1", "spi_cmd_alert";
			interrupt-parent = <0x1e>;
			interrupts = <0x90 0x4 0x90 0x0>;
			mediatek,num-pmic-irqs = <0x91>;
			mediatek,pmic-irqs = <0x0 0x0 0x1 0x0 0x2 0x0 0x3 0x0 0x4 0x0 0x5 0x0 0x6 0x0 0x7 0x0 0x8 0x0 0x9 0x0 0x10 0x1 0x11 0x1 0x12 0x1 0x13 0x1 0x14 0x1 0x15 0x1 0x16 0x1 0x17 0x1 0x18 0x1 0x19 0x1 0x1a 0x1 0x1b 0x1 0x1c 0x1 0x1d 0x1 0x1e 0x1 0x1f 0x1 0x20 0x1 0x21 0x1 0x22 0x1 0x23 0x1 0x24 0x1 0x25 0x1 0x26 0x1 0x27 0x1 0x28 0x1 0x29 0x1 0x2a 0x1 0x2b 0x1 0x2c 0x1 0x2d 0x1 0x2e 0x1 0x30 0x2 0x31 0x2 0x32 0x2 0x33 0x2 0x34 0x2 0x35 0x2 0x36 0x2 0x37 0x2 0x40 0x3 0x50 0x4 0x51 0x4 0x52 0x4 0x53 0x4 0x54 0x4 0x55 0x4 0x56 0x4 0x57 0x4 0x58 0x4 0x59 0x4 0x5a 0x4 0x5b 0x4 0x5c 0x4 0x60 0x4 0x61 0x4 0x62 0x4 0x63 0x4 0x64 0x4 0x70 0x5 0x71 0x5 0x72 0x5 0x73 0x5 0x74 0x5 0x75 0x5 0x76 0x5 0x77 0x5 0x80 0x6 0x85 0x6 0x86 0x6 0x87 0x6 0x90 0x7>;
			phandle = <0x5f>;
			status = "okay";

			mt-pmic {
				compatible = "mediatek,mt-pmic";
				interrupt-names = "pwrkey", "pwrkey_r", "homekey", "homekey_r", "bat_h", "bat_l", "fg_cur_h", "fg_cur_l";
				interrupts = <0x30 0x4 0x32 0x4 0x31 0x4 0x33 0x4 0x70 0x4 0x71 0x4 0x52 0x4 0x53 0x4>;
				phandle = <0x72>;
			};

			mt6358_misc {
				apply-lpsd-solution;
				base = <0x580>;
				compatible = "mediatek,mt6358-misc";
				dcxo-switch;
				phandle = <0x9c>;
			};

			mt6358_rtc {
				apply-lpsd-solution;
				base = <0x580>;
				compatible = "mediatek,mt6358-rtc";
				interrupt-names = "rtc";
				interrupts = <0x40 0x0>;
				phandle = <0x9b>;
			};

			mt6358regulator {
				compatible = "mediatek,mt6358-regulator";
				phandle = <0x74>;

				buck_vcore {
					phandle = <0x76>;
					regulator-enable-ramp-delay = <0xc8>;
					regulator-max-microvolt = <0x13bdb6>;
					regulator-min-microvolt = <0x7a120>;
					regulator-name = "vcore";
				};

				buck_vdram1 {
					phandle = <0x75>;
					regulator-enable-ramp-delay = <0x0>;
					regulator-max-microvolt = <0x1fda4c>;
					regulator-min-microvolt = <0x7a120>;
					regulator-name = "vdram1";
				};

				buck_vgpu {
					phandle = <0x7a>;
					regulator-enable-ramp-delay = <0xc8>;
					regulator-max-microvolt = <0x13bdb6>;
					regulator-min-microvolt = <0x7a120>;
					regulator-name = "vgpu";
				};

				buck_vmodem {
					phandle = <0x7c>;
					regulator-enable-ramp-delay = <0x384>;
					regulator-max-microvolt = <0x13bdb6>;
					regulator-min-microvolt = <0x7a120>;
					regulator-name = "vmodem";
				};

				buck_vpa {
					phandle = <0x77>;
					regulator-enable-ramp-delay = <0xfa>;
					regulator-max-microvolt = <0x37b1d0>;
					regulator-min-microvolt = <0x7a120>;
					regulator-name = "vpa";
				};

				buck_vproc11 {
					phandle = <0x78>;
					regulator-enable-ramp-delay = <0xc8>;
					regulator-max-microvolt = <0x13bdb6>;
					regulator-min-microvolt = <0x7a120>;
					regulator-name = "vproc11";
				};

				buck_vproc12 {
					phandle = <0x79>;
					regulator-enable-ramp-delay = <0xc8>;
					regulator-max-microvolt = <0x13bdb6>;
					regulator-min-microvolt = <0x7a120>;
					regulator-name = "vproc12";
				};

				buck_vs1 {
					phandle = <0x7d>;
					regulator-enable-ramp-delay = <0x0>;
					regulator-max-microvolt = <0x277b6c>;
					regulator-min-microvolt = <0xf4240>;
					regulator-name = "vs1";
				};

				buck_vs2 {
					phandle = <0x7b>;
					regulator-enable-ramp-delay = <0x0>;
					regulator-max-microvolt = <0x1fda4c>;
					regulator-min-microvolt = <0x7a120>;
					regulator-name = "vs2";
				};

				ldo_va09 {
					compatible = "regulator-fixed";
					phandle = <0x9a>;
					regulator-boot-on;
					regulator-enable-ramp-delay = <0x108>;
					regulator-max-microvolt = <0xdbba0>;
					regulator-min-microvolt = <0xdbba0>;
					regulator-name = "va09";
				};

				ldo_va12 {
					compatible = "regulator-fixed";
					phandle = <0x93>;
					regulator-enable-ramp-delay = <0x10e>;
					regulator-max-microvolt = <0x124f80>;
					regulator-min-microvolt = <0x124f80>;
					regulator-name = "va12";
				};

				ldo_vaud28 {
					compatible = "regulator-fixed";
					phandle = <0x98>;
					regulator-enable-ramp-delay = <0x10e>;
					regulator-max-microvolt = <0x2ab980>;
					regulator-min-microvolt = <0x2ab980>;
					regulator-name = "vaud28";
				};

				ldo_vaux18 {
					compatible = "regulator-fixed";
					phandle = <0x8e>;
					regulator-enable-ramp-delay = <0x10e>;
					regulator-max-microvolt = <0x1b7740>;
					regulator-min-microvolt = <0x1b7740>;
					regulator-name = "vaux18";
				};

				ldo_vbif28 {
					compatible = "regulator-fixed";
					phandle = <0x8f>;
					regulator-enable-ramp-delay = <0x10e>;
					regulator-max-microvolt = <0x2ab980>;
					regulator-min-microvolt = <0x2ab980>;
					regulator-name = "vbif28";
				};

				ldo_vcama1 {
					phandle = <0x91>;
					regulator-enable-ramp-delay = <0x10e>;
					regulator-max-microvolt = <0x2dc6c0>;
					regulator-min-microvolt = <0x1b7740>;
					regulator-name = "vcama1";
				};

				ldo_vcama2 {
					phandle = <0x97>;
					regulator-enable-ramp-delay = <0x10e>;
					regulator-max-microvolt = <0x2dc6c0>;
					regulator-min-microvolt = <0x1b7740>;
					regulator-name = "vcama2";
				};

				ldo_vcamd {
					phandle = <0x85>;
					regulator-enable-ramp-delay = <0x10e>;
					regulator-max-microvolt = <0x1b7740>;
					regulator-min-microvolt = <0xdbba0>;
					regulator-name = "vcamd";
				};

				ldo_vcamio {
					compatible = "regulator-fixed";
					phandle = <0x84>;
					regulator-enable-ramp-delay = <0x10e>;
					regulator-max-microvolt = <0x1b7740>;
					regulator-min-microvolt = <0x1b7740>;
					regulator-name = "vcamio";
				};

				ldo_vcn18 {
					compatible = "regulator-fixed";
					phandle = <0x86>;
					regulator-enable-ramp-delay = <0x10e>;
					regulator-max-microvolt = <0x1b7740>;
					regulator-min-microvolt = <0x1b7740>;
					regulator-name = "vcn18";
				};

				ldo_vcn28 {
					compatible = "regulator-fixed";
					phandle = <0x89>;
					regulator-enable-ramp-delay = <0x10e>;
					regulator-max-microvolt = <0x2ab980>;
					regulator-min-microvolt = <0x2ab980>;
					regulator-name = "vcn28";
				};

				ldo_vcn33_bt {
					phandle = <0x95>;
					regulator-enable-ramp-delay = <0x10e>;
					regulator-max-microvolt = <0x3567e0>;
					regulator-min-microvolt = <0x325aa0>;
					regulator-name = "vcn33_bt";
				};

				ldo_vcn33_wifi {
					phandle = <0x96>;
					regulator-enable-ramp-delay = <0x10e>;
					regulator-max-microvolt = <0x3567e0>;
					regulator-min-microvolt = <0x325aa0>;
					regulator-name = "vcn33_wifi";
				};

				ldo_vdram2 {
					phandle = <0x7e>;
					regulator-enable-ramp-delay = <0xce4>;
					regulator-max-microvolt = <0x1b7740>;
					regulator-min-microvolt = <0x927c0>;
					regulator-name = "vdram2";
				};

				ldo_vefuse {
					phandle = <0x8d>;
					regulator-enable-ramp-delay = <0x10e>;
					regulator-max-microvolt = <0x1cfde0>;
					regulator-min-microvolt = <0x19f0a0>;
					regulator-name = "vefuse";
				};

				ldo_vemc {
					phandle = <0x36>;
					regulator-enable-ramp-delay = <0x3c>;
					regulator-max-microvolt = <0x325aa0>;
					regulator-min-microvolt = <0x2c4020>;
					regulator-name = "vemc";
				};

				ldo_vfe28 {
					compatible = "regulator-fixed";
					phandle = <0x87>;
					regulator-enable-ramp-delay = <0x10e>;
					regulator-max-microvolt = <0x2ab980>;
					regulator-min-microvolt = <0x2ab980>;
					regulator-name = "vfe28";
				};

				ldo_vibr {
					phandle = <0x80>;
					regulator-enable-ramp-delay = <0x3c>;
					regulator-max-microvolt = <0x325aa0>;
					regulator-min-microvolt = <0x124f80>;
					regulator-name = "vibr";
				};

				ldo_vio18 {
					compatible = "regulator-fixed";
					phandle = <0x82>;
					regulator-enable-ramp-delay = <0xa8c>;
					regulator-max-microvolt = <0x1b7740>;
					regulator-min-microvolt = <0x1b7740>;
					regulator-name = "vio18";
				};

				ldo_vio28 {
					compatible = "regulator-fixed";
					phandle = <0x92>;
					regulator-always-on;
					regulator-boot-on;
					regulator-enable-ramp-delay = <0x10e>;
					regulator-max-microvolt = <0x2ab980>;
					regulator-min-microvolt = <0x2ab980>;
					regulator-name = "vio28";
				};

				ldo_vldo28 {
					phandle = <0x66>;
					regulator-enable-ramp-delay = <0x10e>;
					regulator-max-microvolt = <0x2dc6c0>;
					regulator-min-microvolt = <0x2ab980>;
					regulator-name = "vldo28";
				};

				ldo_vmc {
					phandle = <0x3d>;
					regulator-enable-ramp-delay = <0x3c>;
					regulator-max-microvolt = <0x325aa0>;
					regulator-min-microvolt = <0x1b7740>;
					regulator-name = "vmc";
				};

				ldo_vmch {
					phandle = <0x3c>;
					regulator-enable-ramp-delay = <0x3c>;
					regulator-max-microvolt = <0x325aa0>;
					regulator-min-microvolt = <0x2c4020>;
					regulator-name = "vmch";
				};

				ldo_vrf12 {
					compatible = "regulator-fixed";
					phandle = <0x81>;
					regulator-enable-ramp-delay = <0x78>;
					regulator-max-microvolt = <0x124f80>;
					regulator-min-microvolt = <0x124f80>;
					regulator-name = "vrf12";
				};

				ldo_vrf18 {
					compatible = "regulator-fixed";
					phandle = <0x94>;
					regulator-enable-ramp-delay = <0x78>;
					regulator-max-microvolt = <0x1b7740>;
					regulator-min-microvolt = <0x1b7740>;
					regulator-name = "vrf18";
				};

				ldo_vsim1 {
					phandle = <0x7f>;
					regulator-enable-ramp-delay = <0x21c>;
					regulator-max-microvolt = <0x2f4d60>;
					regulator-min-microvolt = <0x19f0a0>;
					regulator-name = "vsim1";
				};

				ldo_vsim2 {
					phandle = <0x99>;
					regulator-enable-ramp-delay = <0x21c>;
					regulator-max-microvolt = <0x2f4d60>;
					regulator-min-microvolt = <0x19f0a0>;
					regulator-name = "vsim2";
				};

				ldo_vsram_gpu {
					phandle = <0x8b>;
					regulator-enable-ramp-delay = <0xf0>;
					regulator-max-microvolt = <0x13bdb6>;
					regulator-min-microvolt = <0x7a120>;
					regulator-name = "vsram_gpu";
				};

				ldo_vsram_others {
					phandle = <0x8a>;
					regulator-enable-ramp-delay = <0xf0>;
					regulator-max-microvolt = <0x13bdb6>;
					regulator-min-microvolt = <0x7a120>;
					regulator-name = "vsram_others";
				};

				ldo_vsram_proc11 {
					phandle = <0x88>;
					regulator-enable-ramp-delay = <0xf0>;
					regulator-max-microvolt = <0x13bdb6>;
					regulator-min-microvolt = <0x7a120>;
					regulator-name = "vsram_proc11";
				};

				ldo_vsram_proc12 {
					phandle = <0x90>;
					regulator-enable-ramp-delay = <0xf0>;
					regulator-max-microvolt = <0x13bdb6>;
					regulator-min-microvolt = <0x7a120>;
					regulator-name = "vsram_proc12";
				};

				ldo_vusb {
					phandle = <0x83>;
					regulator-enable-ramp-delay = <0x10e>;
					regulator-max-microvolt = <0x2f4d60>;
					regulator-min-microvolt = <0x2dc6c0>;
					regulator-name = "vusb";
				};

				ldo_vxo22 {
					compatible = "regulator-fixed";
					phandle = <0x8c>;
					regulator-enable-ramp-delay = <0x78>;
					regulator-max-microvolt = <0x2191c0>;
					regulator-min-microvolt = <0x2191c0>;
					regulator-name = "vxo22";
				};
			};

			mt635x-auxadc {
				#io-channel-cells = <0x1>;
				compatible = "mediatek,mt6358-auxadc";
				phandle = <0x73>;

				accdet {
					channel = <0x9>;
				};

				bat_temp {
					channel = <0x3>;
					resistance-ratio = <0x2 0x1>;
				};

				batadc {
					avg-num = <0x80>;
					channel = <0x0>;
					resistance-ratio = <0x3 0x1>;
				};

				chip_temp {
					channel = <0x5>;
				};

				dcxo_temp {
					avg-num = <0x10>;
					channel = <0xd>;
				};

				dcxo_volt {
					channel = <0xa>;
					resistance-ratio = <0x3 0x2>;
				};

				hpofs_cal {
					avg-num = <0x100>;
					channel = <0xc>;
				};

				tsx_temp {
					avg-num = <0x80>;
					channel = <0xb>;
				};

				vbif {
					channel = <0xe>;
					resistance-ratio = <0x2 0x1>;
				};

				vcdt {
					channel = <0x2>;
				};

				vcore_temp {
					channel = <0x6>;
				};

				vgpu_temp {
					channel = <0x8>;
				};

				vproc_temp {
					channel = <0x7>;
				};
			};
		};
	};

	pwrap_md32@10448000 {
		compatible = "mediatek,pwrap_md32";
		reg = <0x0 0x10448000 0x0 0x1000>;
	};

	pwrap_mpu@1000d000 {
		compatible = "mediatek,pwrap_mpu";
		reg = <0x0 0x1000d000 0x0 0x1000>;
	};

	pwrap_p2p@1005cb000 {
		compatible = "mediatek,pwrap_p2p";
		reg = <0x0 0x105cb000 0x0 0x1000>;
	};

	pwraphal@ {
		compatible = "mediatek,pwraph";
		mediatek,pwrap-regmap = <0x20>;
		phandle = <0x9d>;
	};

	radio_md_cfg {
		compatible = "mediatek,radio_md_cfg";
		phandle = <0xd2>;
	};

	reserve@16030000 {
		compatible = "mediatek,reserve";
		reg = <0x0 0x16030000 0x0 0x10000>;
	};

	reserved-memory {
		#address-cells = <0x2>;
		#size-cells = <0x2>;
		phandle = <0x6a>;
		ranges;

		consys-reserve-memory {
			alignment = <0x0 0x1000000>;
			alloc-ranges = <0x0 0x40000000 0x0 0x80000000>;
			compatible = "mediatek,consys-reserve-memory";
			no-map;
			size = <0x0 0x400000>;
		};

		ion-carveout-heap {
			alignment = <0x0 0x1000>;
			alloc-ranges = <0x0 0xc0000000 0x4 0x0>;
			compatible = "mediatek,ion-carveout-heap";
			no-map;
			size = <0x0 0x9000>;
		};

		reserve-memory-scp_share {
			alignment = <0x0 0x1000000>;
			alloc-ranges = <0x0 0x40000000 0x0 0x50000000>;
			compatible = "mediatek,reserve-memory-scp_share";
			no-map;
			size = <0x0 0x300000>;
		};

		reserve-memory-sspm_share {
			alignment = <0x0 0x10000>;
			alloc-ranges = <0x0 0x40000000 0x0 0x60000000>;
			compatible = "mediatek,reserve-memory-sspm_share";
			no-map;
			size = <0x0 0x510000>;
			status = "okay";
		};

		soter-shared-mem {
			alignment = <0x0 0x1000000>;
			alloc-ranges = <0x0 0x40000000 0x0 0x50000000>;
			compatible = "microtrust,shared_mem";
			no-map;
			size = <0x0 0x800000>;
		};

		wifi-reserve-memory {
			alignment = <0x0 0x1000000>;
			alloc-ranges = <0x0 0x40000000 0x0 0x80000000>;
			compatible = "shared-dma-pool";
			no-map;
			phandle = <0x5e>;
			size = <0x0 0x300000>;
		};

		zmc-default {
			alignment = <0x0 0x1000000>;
			alloc-ranges = <0x0 0xc0000000 0x4 0x0>;
			compatible = "mediatek,zone_movable_cma";
			size = <0x0 0x2d000000>;
		};
	};

	scp@10500000 {
		compatible = "mediatek,scp";
		core_1 = "enable";
		interrupts = <0x0 0xcd 0x4>;
		reg = <0x0 0x10500000 0x0 0x80000 0x0 0x105c0000 0x0 0x3000 0x0 0x105c4000 0x0 0x1000 0x0 0x105d4000 0x0 0x6000>;
		scp_sramSize = <0x80000>;
		status = "okay";
	};

	scp_dvfs {
		clock-names = "clk_mux", "clk_pll_0", "clk_pll_1", "clk_pll_2", "clk_pll_3", "clk_pll_4", "clk_pll_5", "clk_pll_6";
		clocks = <0x12 0x53 0x13 0x12 0xe 0x12 0x1a 0x12 0x2 0x12 0x17 0x12 0x6 0x12 0x19>;
		compatible = "mediatek,scp_dvfs";
	};

	scpsys@10001000 {
		#clock-cells = <0x1>;
		compatible = "mediatek,scpsys", "syscon";
		phandle = <0x22>;
		reg = <0x0 0x10001000 0x0 0x1000 0x0 0x10006000 0x0 0x1000 0x0 0x14002000 0x0 0x1000 0x0 0x1020e000 0x0 0x1000 0x0 0x18004000 0x0 0x1000 0x0 0x18002000 0x0 0x1000 0x0 0x10000000 0x0 0x1000 0x0 0x16000000 0x0 0x1000 0x0 0x16025000 0x0 0x1000>;
	};

	security_ao@1001a000 {
		compatible = "mediatek,security_ao";
		reg = <0x0 0x1001a000 0x0 0x1000>;
	};

	seninf1@1a040000 {
		compatible = "mediatek,seninf1";
		reg = <0x0 0x1a040000 0x0 0x1000>;
	};

	seninf2@1a041000 {
		compatible = "mediatek,seninf2";
		reg = <0x0 0x1a041000 0x0 0x1000>;
	};

	seninf3@1a042000 {
		compatible = "mediatek,seninf3";
		reg = <0x0 0x1a042000 0x0 0x1000>;
	};

	seninf4@1a043000 {
		compatible = "mediatek,seninf4";
		reg = <0x0 0x1a043000 0x0 0x1000>;
	};

	serial@11002000 {
		clock-names = "baud", "bus";
		clocks = <0x13 0x21 0x16>;
		compatible = "mediatek,mt6577-uart";
		dma-names = "tx", "rx";
		dmas = <0x31 0x0 0x31 0x1>;
		interrupts = <0x0 0x70 0x8>;
		phandle = <0xac>;
		reg = <0x0 0x11002000 0x0 0x1000>;
	};

	serial@11003000 {
		clock-names = "baud", "bus";
		clocks = <0x13 0x21 0x17>;
		compatible = "mediatek,mt6577-uart";
		dma-names = "tx", "rx";
		dmas = <0x31 0x2 0x31 0x3>;
		interrupts = <0x0 0x71 0x8>;
		phandle = <0xad>;
		reg = <0x0 0x11003000 0x0 0x1000>;
	};

	sleep@10006000 {
		compatible = "mediatek,sleep";
		interrupts = <0x0 0xc3 0x8>;
		phandle = <0x6f>;
		reg = <0x0 0x10006000 0x0 0x1000>;
	};

	sleep_reg_md@1000f000 {
		compatible = "mediatek,sleep_reg_md";
		reg = <0x0 0x1000f000 0x0 0x1000>;
	};

	smart_pa {
		phandle = <0xde>;
	};

	smi_common@14002000 {
		clock-names = "scp-dis", "mm-comm0", "mm-comm1", "mm-common";
		clocks = <0x22 0x3 0x24 0x15 0x24 0x16 0x24 0x13>;
		compatible = "mediatek,smi_common";
		mediatek,smi-id = <0x5>;
		mmsys_config = <0x24>;
		reg = <0x0 0x14002000 0x0 0x1000>;
	};

	smi_larb0@14003000 {
		clock-names = "scp-dis", "mm-larb0";
		clocks = <0x22 0x3 0x24 0x14>;
		compatible = "mediatek,smi_larb0", "mediatek,smi_larb";
		mediatek,smi-id = <0x0>;
		phandle = <0x56>;
		reg = <0x0 0x14003000 0x0 0x1000>;
	};

	smi_larb1@16010000 {
		clock-names = "scp-vdec", "mm-vdec", "vdec-larb1";
		clocks = <0x22 0xc 0x24 0x1b 0x5b 0x3>;
		compatible = "mediatek,smi_larb1", "mediatek,smi_larb";
		interrupts = <0x0 0xf7 0x8>;
		mediatek,smi-id = <0x1>;
		phandle = <0x59>;
		reg = <0x0 0x16010000 0x0 0x1000>;
	};

	smi_larb2@15021000 {
		clock-names = "scp-isp", "mm-img", "img-larb2";
		clocks = <0x22 0x5 0x24 0x18 0x57 0x0>;
		compatible = "mediatek,smi_larb2", "mediatek,smi_larb";
		mediatek,smi-id = <0x2>;
		phandle = <0xc9>;
		reg = <0x0 0x15021000 0x0 0x1000>;
	};

	smi_larb3@1a002000 {
		clock-names = "scp-cam", "mm-cam", "cam-larb3";
		clocks = <0x22 0xa 0x24 0x19 0x58 0x0>;
		compatible = "mediatek,smi_larb3", "mediatek,smi_larb";
		mediatek,smi-id = <0x3>;
		phandle = <0xca>;
		reg = <0x0 0x1a002000 0x0 0x1000>;
	};

	smi_larb4@17010000 {
		clock-names = "scp-venc", "mm-venc", "venc-venc", "venc-jpgenc";
		clocks = <0x22 0xb 0x24 0x1a 0x5d 0x1 0x5d 0x2>;
		compatible = "mediatek,smi_larb4", "mediatek,smi_larb";
		mediatek,smi-id = <0x4>;
		phandle = <0x5c>;
		reg = <0x0 0x17010000 0x0 0x1000>;
	};

	snd_scp_spk {
		compatible = "mediatek,snd_scp_spk";
		phandle = <0xc6>;
	};

	sound {
		compatible = "mediatek,mt6768-mt6358-sound";
		mediatek,audio-codec = <0x52>;
		mediatek,platform = <0x53>;
		mtk_spk_i2s_in = <0x0>;
		mtk_spk_i2s_out = <0x3>;
		phandle = <0xc5>;

		mediatek,speaker-codec {
			sound-dai = <0x54>;
		};
	};

	spi0@1100a000 {
		clock-names = "parent-clk", "sel-clk", "spi-clk";
		clocks = <0x12 0xb 0x12 0x5b 0x21 0x1b>;
		compatible = "mediatek,mt6765-spi";
		interrupts = <0x0 0x8a 0x8>;
		mediatek,pad-select = <0x0>;
		phandle = <0xb8>;
		reg = <0x0 0x1100a000 0x0 0x1000>;
	};

	spi1@11010000 {
		clock-names = "parent-clk", "sel-clk", "spi-clk";
		clocks = <0x12 0xb 0x12 0x5b 0x21 0x34>;
		compatible = "mediatek,mt6765-spi";
		interrupts = <0x0 0x8b 0x8>;
		mediatek,pad-select = <0x0>;
		phandle = <0xbe>;
		reg = <0x0 0x11010000 0x0 0x1000>;
	};

	spi2@11012000 {
		clock-names = "parent-clk", "sel-clk", "spi-clk";
		clocks = <0x12 0xb 0x12 0x5b 0x21 0x37>;
		compatible = "mediatek,mt6765-spi";
		interrupts = <0x0 0x91 0x8>;
		mediatek,pad-select = <0x0>;
		phandle = <0xbf>;
		reg = <0x0 0x11012000 0x0 0x1000>;
	};

	spi3@11013000 {
		clock-names = "parent-clk", "sel-clk", "spi-clk";
		clocks = <0x12 0xb 0x12 0x5b 0x21 0x38>;
		compatible = "mediatek,mt6765-spi";
		interrupts = <0x0 0x92 0x8>;
		mediatek,pad-select = <0x0>;
		phandle = <0xc0>;
		reg = <0x0 0x11013000 0x0 0x1000>;
	};

	spi4@11014000 {
		clock-names = "parent-clk", "sel-clk", "spi-clk";
		clocks = <0x12 0xb 0x12 0x5b 0x21 0x41>;
		compatible = "mediatek,mt6765-spi";
		interrupts = <0x0 0x74 0x8>;
		mediatek,pad-select = <0x0>;
		phandle = <0xc1>;
		reg = <0x0 0x11014000 0x0 0x1000>;
	};

	spi5@11015000 {
		clock-names = "parent-clk", "sel-clk", "spi-clk";
		clocks = <0x12 0xb 0x12 0x5b 0x21 0x42>;
		compatible = "mediatek,mt6765-spi";
		interrupts = <0x0 0x75 0x8>;
		mediatek,pad-select = <0x0>;
		phandle = <0xc2>;
		reg = <0x0 0x11015000 0x0 0x1000>;
	};

	sramrom@10214000 {
		compatible = "mediatek,sramrom";
		reg = <0x0 0x10214000 0x0 0x1000>;
	};

	sspm@10440000 {
		compatible = "mediatek,sspm";
		interrupt-names = "ipc", "mbox0", "mbox1", "mbox2", "mbox3", "mbox4";
		interrupts = <0x0 0xd7 0x4 0x0 0xda 0x4 0x0 0xdb 0x4 0x0 0xdc 0x4 0x0 0xdd 0x4 0x0 0xde 0x4>;
		reg = <0x0 0x10440000 0x0 0x10000 0x0 0x10450000 0x0 0x100 0x0 0x10451000 0x0 0x8 0x0 0x10460000 0x0 0x100 0x0 0x10461000 0x0 0x8 0x0 0x10470000 0x0 0x100 0x0 0x10471000 0x0 0x8 0x0 0x10480000 0x0 0x100 0x0 0x10481000 0x0 0x8 0x0 0x10490000 0x0 0x100 0x0 0x10491000 0x0 0x8>;
		reg-names = "cfgreg", "mbox0_base", "mbox0_ctrl", "mbox1_base", "mbox1_ctrl", "mbox2_base", "mbox2_ctrl", "mbox3_base", "mbox3_ctrl", "mbox4_base", "mbox4_ctrl";
	};

	sys_cirq@10204000 {
		compatible = "mediatek,sys_cirq";
		interrupts = <0x0 0x127 0x8>;
		mediatek,cirq_num = <0xe8>;
		mediatek,spi_start_offset = <0x40>;
		reg = <0x0 0x10204000 0x0 0x1000>;
	};

	sys_timer@10017000 {
		clocks = <0x12 0x86>;
		compatible = "mediatek,sys_timer";
		interrupts = <0x0 0xcf 0x4>;
		reg = <0x0 0x10017000 0x0 0x1000>;
		reg-names = "sys_timer_base";
	};

	tee_sanity {
		compatible = "mediatek,tee_sanity";
		interrupts = <0x0 0x12a 0x1>;
	};

	therm_ctrl@1100b000 {
		clock-names = "therm-main";
		clocks = <0x21 0xa>;
		compatible = "mediatek,therm_ctrl";
		interrupts = <0x0 0x63 0x8>;
		reg = <0x0 0x1100b000 0x0 0x1000>;
	};

	thermal-sensor1 {
		compatible = "mediatek,mtboard-thermistor1";
		io-channel-names = "thermistor-ch0";
		io-channels = <0x23 0x0>;
		phandle = <0xba>;
	};

	thermal-sensor2 {
		compatible = "mediatek,mtboard-thermistor2";
		io-channel-names = "thermistor-ch1";
		io-channels = <0x23 0x1>;
		phandle = <0xbb>;
	};

	timer {
		clock-frequency = <0xc65d40>;
		compatible = "arm,armv8-timer";
		interrupt-parent = <0x11>;
		interrupts = <0x1 0xd 0x8 0x1 0xe 0x8 0x1 0xb 0x8 0x1 0xa 0x8>;
		phandle = <0x6c>;
	};

	topckgen@10000000 {
		#clock-cells = <0x1>;
		compatible = "mediatek,topckgen", "syscon";
		phandle = <0x12>;
		reg = <0x0 0x10000000 0x0 0x1000>;
	};

	topckgen_ao@1001b000 {
		compatible = "mediatek,topckgen_ao";
		reg = <0x0 0x1001b000 0x0 0x1000>;
	};

	topmisc@10011000 {
		compatible = "mediatek,topmisc";
		reg = <0x0 0x10011000 0x0 0x1000>;
	};

	toprgu@10007000 {
		compatible = "mediatek,toprgu";
		interrupts = <0x0 0x9c 0x8>;
		phandle = <0x70>;
		reg = <0x0 0x10007000 0x0 0x1000>;
	};

	touch {
		compatible = "goodix,touch";
		phandle = <0xdb>;
	};

	tran_battery {
		compatible = "tran,chg_fun";
		enable_pcb_tml;
		jeita_above_t4_chg_cur = <0x0>;
		jeita_above_t4_input_cur = <0xf4240>;
		jeita_below_t0_chg_cur = <0x0>;
		jeita_below_t0_input_cur = <0x16e360>;
		jeita_t0_to_t1_chg_cur = <0xf4240>;
		jeita_t0_to_t1_input_cur = <0x16e360>;
		jeita_t2_to_t3_chg_cur = <0x1e8480>;
		jeita_t2_to_t3_input_cur = <0x1e8480>;
		jeita_t3_to_t4_chg_cur = <0x1e8480>;
		jeita_t3_to_t4_input_cur = <0x1e8480>;
		pcb_cur_step_one = <0x1f4>;
		pcb_cur_step_two = <0x1f4>;
		pcb_min_chg_cur = <0xf4240>;
		pcb_temp_step_one = <0x9858>;
		pcb_temp_step_two = <0xabe0>;
		phandle = <0xd4>;
	};

	tran_battery_aging {
		battery_aging_module0 = <0x0>;
		battery_aging_module1 = <0x0>;
		battery_aging_module2 = <0x0>;
		battery_aging_module3 = <0x0>;
		compatible = "tran,chg_aging";
		phandle = <0xd5>;
	};

	trng@1020f000 {
		compatible = "mediatek,trng";
		interrupts = <0x0 0xb0 0x8>;
		reg = <0x0 0x1020f000 0x0 0x1000>;
	};

	trusty {
		#address-cells = <0x2>;
		#size-cells = <0x2>;
		compatible = "android,trusty-smc-v1";
		ranges;
		tee-id = <0x0>;
		tee-name = "trusty";

		gz-main {
			compatible = "mediatek,trusty-gz";
		};

		mtee {
			compatible = "mediatek,trusty-mtee-v1";
		};

		trusty-gz-log {
			compatible = "android,trusty-gz-log-v1";
		};

		trusty-irq {
			compatible = "android,trusty-irq-v1";
			ppi-interrupt-parent = <0x11>;
		};

		trusty-virtio {
			compatible = "android,trusty-virtio-v1";
		};
	};

	type_c_port0 {
		mt-tcpc,name = "type_c_port0";
		mt-tcpc,notifier_supply_num = <0x3>;
		mt-tcpc,role_def = <0x4>;
		mt-tcpc,rp_level = <0x1>;
		mt-tcpc,vconn_supply = <0x1>;
		mt6370pd,intr_gpio = <0x1e 0x18 0x0>;
		mt6370pd,intr_gpio_num = <0x18>;
		phandle = <0xe3>;
		tcpc-dual,supported_modes = <0x0>;

		displayport {
			1st_connection = "dfp_d";
			2nd_connection = "dfp_d";
			signal,dp_v13;
			typec,receptacle;
			usbr20_not_used;

			dfp_d {
				pin_assignment,mode_c;
				pin_assignment,mode_d;
				pin_assignment,mode_e;
				pin_assignment,mode_f;
			};

			ufp_d {
			};
		};

		dpm_caps {
			attemp_discover_cable;
			attemp_discover_id;
			attemp_enter_dp_mode;
			dr_check = <0x0>;
			local_dr_data;
			local_dr_power;
			local_no_suspend;
			local_usb_comm;
			local_vconn_supply;
			pr_check = <0x0>;
		};

		pd-data {
			bat,nr = <0x1>;
			pd,charging_policy = <0x31>;
			pd,country_nr = <0x0>;
			pd,id-vdo-data = <0xd10029cf 0x0 0x50810000>;
			pd,id-vdo-size = <0x3>;
			pd,mfrs = "RichtekTCPC";
			pd,pid = <0x5081>;
			pd,sink-pdo-data = <0x190c8>;
			pd,sink-pdo-size = <0x1>;
			pd,source-cap-ext = <0x508129cf 0x0 0x0 0x0 0x0 0x7000000>;
			pd,source-pdo-data = <0x19096>;
			pd,source-pdo-size = <0x1>;
			pd,vid = <0x29cf>;

			bat-info0 {
				bat,design_cap = <0xbb8>;
				bat,mfrs = "bat1";
				bat,pid = <0x5081>;
				bat,vid = <0x29cf>;
			};
		};
	};

	usb0@11200000 {
		clock-names = "usb0", "usb0_clk_top_sel", "usb0_clk_univpll3_d4";
		clocks = <0x21 0x8 0x12 0x66 0x12 0x20>;
		compatible = "mediatek,mt6768-usb20";
		interrupts = <0x0 0x61 0x8>;
		mode = <0x2>;
		multipoint = <0x1>;
		num_eps = <0x10>;
		reg = <0x0 0x11200000 0x0 0x10000 0x0 0x11cc0000 0x0 0x10000>;
	};

	usb1p_sif@11210000 {
		compatible = "mediatek,usb1p_sif";
		reg = <0x0 0x11210000 0x0 0x10000>;
	};

	utos {
		compatible = "microtrust,utos";
		interrupts = <0x0 0x12b 0x1 0x0 0x12c 0x1>;
	};

	utos_tester {
		compatible = "microtrust,tester-v1";
	};

	vcu@16000000 {
		compatible = "mediatek-vcu";
		gce-event-names = "venc_eof", "venc_cmdq_pause_done", "venc_mb_done", "venc_128B_cnt_done";
		gce-events = <0x2e 0x121 0x2e 0x122 0x2e 0x124 0x2e 0x125>;
		mboxes = <0x2e 0x1 0x0 0x1 0x2e 0x5 0x0 0x1>;
		mediatek,mailbox-gce = <0x2e>;
		mediatek,vcuid = <0x0>;
		mediatek,vcuname = "vcu";
		phandle = <0x5a>;
		reg = <0x0 0x16000000 0x0 0x40000 0x0 0x17020000 0x0 0x10000 0x0 0x19002000 0x0 0x1000>;
	};

	vdec@16020000 {
		compatible = "mediatek,vdec";
		interrupts = <0x0 0xf6 0x8>;
		reg = <0x0 0x16020000 0x0 0x10000>;
	};

	vdec_gcon@16000000 {
		#clock-cells = <0x1>;
		clock-names = "MT_SCP_SYS_DIS", "MT_SCP_SYS_VDE", "MT_CG_VDEC";
		clocks = <0x22 0x3 0x22 0xc 0x5b 0x0>;
		compatible = "mediatek,vdec_gcon", "syscon";
		interrupts = <0x0 0xf6 0x8>;
		mediatek,larb = <0x59>;
		mediatek,vcu = <0x5a>;
		phandle = <0x5b>;
		reg = <0x0 0x16000000 0x0 0x1000 0x0 0x16020000 0x0 0x400 0x0 0x16025000 0x0 0x1000>;
	};

	vdec_mbist_ctrl@16001000 {
		compatible = "mediatek,vdec_mbist_ctrl";
		reg = <0x0 0x16001000 0x0 0x1000>;
	};

	venc@17020000 {
		compatible = "mediatek,venc";
		interrupts = <0x0 0xf3 0x8>;
		reg = <0x0 0x17020000 0x0 0x10000>;
	};

	venc_gcon@17000000 {
		#clock-cells = <0x1>;
		clock-names = "MT_SCP_SYS_DIS", "MT_SCP_SYS_VEN", "MT_CG_VENC";
		clocks = <0x22 0x3 0x22 0xb 0x5d 0x1>;
		compatible = "mediatek,venc_gcon", "syscon";
		interrupts = <0x0 0xf3 0x8>;
		mediatek,larb = <0x5c>;
		mediatek,vcu = <0x5a>;
		phandle = <0x5d>;
		reg = <0x0 0x17000000 0x0 0x1000 0x0 0x17020000 0x0 0x1000>;
	};

	venc_jpg@17030000 {
		clock-names = "MT_CG_VENC_JPGENC";
		clocks = <0x5d 0x2>;
		compatible = "mediatek,venc_jpg";
		interrupts = <0x0 0xf5 0x8>;
		reg = <0x0 0x17030000 0x0 0x10000>;
	};

	wifi@18000000 {
		compatible = "mediatek,wifi";
		interrupts = <0x0 0x11d 0x8>;
		memory-region = <0x5e>;
		reg = <0x0 0x18000000 0x0 0x100000>;
	};
};
