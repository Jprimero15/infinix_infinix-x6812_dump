/dts-v1/;

/ {

	__fixups__ {
		accdet = "/fragment@6:target:0";
		auxadc = "/fragment@22:target:0", "/fragment@23/__overlay__:io-channels:0";
		chosen = "/fragment@1:target:0";
		consys = "/fragment@10:target:0";
		dsi_te = "/fragment@39:target:0";
		flashlights_aw36515 = "/fragment@55:target:0";
		flashlights_ocp81375 = "/fragment@57:target:0";
		gpio = "/fragment@35:target:0";
		gpio_usage_mapping = "/fragment@34:target:0";
		i2c0 = "/fragment@25:target:0";
		i2c1 = "/fragment@26:target:0";
		i2c2 = "/fragment@5:target:0", "/fragment@27:target:0";
		i2c3 = "/fragment@28:target:0";
		i2c4 = "/fragment@29:target:0";
		i2c5 = "/fragment@30:target:0";
		i2c6 = "/fragment@31:target:0";
		i2c7 = "/fragment@32:target:0";
		i2c8 = "/fragment@33:target:0";
		irtx_pwm = "/fragment@11:target:0";
		kd_camera_hw1 = "/fragment@49:target:0", "/fragment@53:target:0";
		keypad = "/fragment@51:target:0";
		main_pmic = "/fragment@40:target:0";
		md1_sim1_hot_plug_eint = "/fragment@41:target:0";
		md_auxadc = "/fragment@23:target:0";
		mt6370_pmu = "/fragment@7:target:0";
		mt6370_typec = "/fragment@8:target:0";
		mt_pmic_vcama1_ldo_reg = "/fragment@42:target:0";
		mt_pmic_vcama2_ldo_reg = "/fragment@43:target:0", "/fragment@49/__overlay__:vcama_main2-supply:0", "/fragment@49/__overlay__:vcama_sub2-supply:0", "/fragment@53/__overlay__:cam2_vcama-supply:0", "/fragment@53/__overlay__:cam3_vcama-supply:0";
		mt_pmic_vcamd_ldo_reg = "/fragment@46:target:0", "/fragment@49/__overlay__:vcamd_sub-supply:0", "/fragment@53/__overlay__:cam1_vcamd-supply:0";
		mt_pmic_vcamio_ldo_reg = "/fragment@47:target:0", "/fragment@49/__overlay__:vcamio-supply:0", "/fragment@49/__overlay__:vcamio_sub-supply:0", "/fragment@49/__overlay__:vcamio_main2-supply:0", "/fragment@53/__overlay__:cam0_vcamio-supply:0", "/fragment@53/__overlay__:cam1_vcamio-supply:0", "/fragment@53/__overlay__:cam2_vcamio-supply:0";
		mt_pmic_vldo28_ldo_reg = "/fragment@48:target:0", "/fragment@49/__overlay__:vcamaf-supply:0", "/fragment@50/__overlay__:vtouch-supply:0", "/fragment@53/__overlay__:cam0_vcamaf-supply:0";
		mt_pmic_vsim1_ldo_reg = "/fragment@44:target:0";
		mt_pmic_vsim2_ldo_reg = "/fragment@45:target:0";
		mtkfb = "/fragment@14:target:0";
		odm = "/fragment@2:target:0";
		otg_iddig = "/fragment@38:target:0";
		pio = "/fragment@2/__overlay__/tran_audio:extamp_gpio:0", "/fragment@2/__overlay__/tran_audio:dual_speaker_gpio:0", "/fragment@2/__overlay__/tran_audio:amp_type_gpio:0", "/fragment@2/__overlay__/fingerprint:interrupt-parent:0", "/fragment@3/__overlay__/fingerprint@0:interrupt-parent:0", "/fragment@3/__overlay__/fingerprint@0:irq-gpio-std:0", "/fragment@3/__overlay__/fingerprint@0:reset-gpio-std:0", "/fragment@4:target:0", "/fragment@7/__overlay__:mt6370,intr_gpio:0", "/fragment@8/__overlay__:mt6370pd,intr_gpio:0", "/fragment@9:target:0", "/fragment@12:target:0", "/fragment@13:target:0", "/fragment@16:target:0", "/fragment@18:target:0", "/fragment@20:target:0", "/fragment@34/__overlay__:GPIO_SIM1_HOT_PLUG:0", "/fragment@34/__overlay__:GPIO_FDD_BAND_SUPPORT_DETECT_2ND_PIN:0", "/fragment@34/__overlay__:GPIO_FDD_BAND_SUPPORT_DETECT_3RD_PIN:0", "/fragment@34/__overlay__:GPIO_FDD_BAND_SUPPORT_DETECT_1ST_PIN:0", "/fragment@34/__overlay__:GPIO_SIM2_SIO:0", "/fragment@34/__overlay__:GPIO_SIM2_SRST:0", "/fragment@34/__overlay__:GPIO_SIM2_SCLK:0", "/fragment@34/__overlay__:GPIO_SIM1_SCLK:0", "/fragment@34/__overlay__:GPIO_SIM1_SRST:0", "/fragment@34/__overlay__:GPIO_SIM1_SIO:0", "/fragment@36/__overlay__:interrupt-parent:0", "/fragment@37/__overlay__:interrupt-parent:0", "/fragment@38/__overlay__:interrupt-parent:0", "/fragment@39/__overlay__:interrupt-parent:0", "/fragment@40/__overlay__:interrupt-parent:0", "/fragment@52:target:0", "/fragment@54:target:0", "/fragment@56:target:0";
		pmic_clock_buffer_ctrl = "/fragment@24:target:0";
		reserved_memory = "/fragment@0:target:0";
		smart_pa = "/fragment@37:target:0";
		spi0 = "/fragment@3:target:0";
		spi2 = "/fragment@21:target:0";
		spi4 = "/fragment@15:target:0";
		touch = "/fragment@19:target:0", "/fragment@36:target:0", "/fragment@50:target:0";
		tran_battery = "/fragment@17:target:0";
	};

	__local_fixups__ {

		fragment@10 {

			__overlay__ {
				pinctrl-0 = <0x0>;
				pinctrl-1 = <0x0>;
				pinctrl-2 = <0x0>;
				pinctrl-3 = <0x0>;
				pinctrl-4 = <0x0>;
				pinctrl-5 = <0x0>;
			};
		};

		fragment@11 {

			__overlay__ {
				pinctrl-0 = <0x0>;
				pinctrl-1 = <0x0>;
			};
		};

		fragment@14 {

			__overlay__ {
				pinctrl-0 = <0x0>;
				pinctrl-1 = <0x0>;
				pinctrl-2 = <0x0>;
				pinctrl-3 = <0x0>;
				pinctrl-4 = <0x0>;
				pinctrl-5 = <0x0>;
				pinctrl-6 = <0x0>;
				pinctrl-7 = <0x0>;
				pinctrl-8 = <0x0>;
			};
		};

		fragment@15 {

			__overlay__ {
				pinctrl-0 = <0x0>;
			};
		};

		fragment@17 {

			__overlay__ {
				pinctrl-0 = <0x0>;
				pinctrl-1 = <0x0>;
				pinctrl-2 = <0x0>;
				pinctrl-3 = <0x0>;
				pinctrl-4 = <0x0>;
				pinctrl-5 = <0x0>;
			};
		};

		fragment@19 {

			__overlay__ {
				pinctrl-0 = <0x0>;
				pinctrl-1 = <0x0>;
				pinctrl-2 = <0x0>;
				pinctrl-3 = <0x0>;
				pinctrl-4 = <0x0>;
				pinctrl-5 = <0x0>;
			};
		};

		fragment@2 {

			__overlay__ {

				fingerprint {
					pinctrl-0 = <0x0>;
					pinctrl-1 = <0x0>;
					pinctrl-2 = <0x0>;
					pinctrl-3 = <0x0>;
					pinctrl-4 = <0x0>;
				};
			};
		};

		fragment@3 {

			__overlay__ {

				fingerprint@0 {
					pinctrl-0 = <0x0>;
					pinctrl-1 = <0x0>;
					pinctrl-2 = <0x0>;
					pinctrl-3 = <0x0>;
					pinctrl-4 = <0x0>;
				};
			};
		};

		fragment@53 {

			__overlay__ {
				pinctrl-0 = <0x0>;
				pinctrl-1 = <0x0>;
				pinctrl-10 = <0x0>;
				pinctrl-11 = <0x0>;
				pinctrl-12 = <0x0>;
				pinctrl-13 = <0x0>;
				pinctrl-14 = <0x0>;
				pinctrl-15 = <0x0>;
				pinctrl-16 = <0x0>;
				pinctrl-17 = <0x0>;
				pinctrl-18 = <0x0>;
				pinctrl-19 = <0x0>;
				pinctrl-2 = <0x0>;
				pinctrl-20 = <0x0>;
				pinctrl-21 = <0x0>;
				pinctrl-22 = <0x0>;
				pinctrl-23 = <0x0>;
				pinctrl-24 = <0x0>;
				pinctrl-25 = <0x0>;
				pinctrl-26 = <0x0>;
				pinctrl-27 = <0x0>;
				pinctrl-28 = <0x0>;
				pinctrl-29 = <0x0>;
				pinctrl-3 = <0x0>;
				pinctrl-30 = <0x0>;
				pinctrl-31 = <0x0>;
				pinctrl-32 = <0x0>;
				pinctrl-33 = <0x0>;
				pinctrl-34 = <0x0>;
				pinctrl-35 = <0x0>;
				pinctrl-36 = <0x0>;
				pinctrl-37 = <0x0>;
				pinctrl-38 = <0x0>;
				pinctrl-39 = <0x0>;
				pinctrl-4 = <0x0>;
				pinctrl-40 = <0x0>;
				pinctrl-41 = <0x0>;
				pinctrl-42 = <0x0>;
				pinctrl-5 = <0x0>;
				pinctrl-6 = <0x0>;
				pinctrl-7 = <0x0>;
				pinctrl-8 = <0x0>;
				pinctrl-9 = <0x0>;
			};
		};

		fragment@55 {

			__overlay__ {
				pinctrl-0 = <0x0>;
				pinctrl-1 = <0x0>;
				pinctrl-2 = <0x0>;
			};
		};

		fragment@57 {

			__overlay__ {
				pinctrl-0 = <0x0>;
				pinctrl-1 = <0x0>;
				pinctrl-2 = <0x0>;
			};
		};
	};

	__symbols__ {
		camera0_mclk_2mA = "/fragment@52/__overlay__/camera0_mclk_2mA@gpio100";
		camera0_mclk_4mA = "/fragment@52/__overlay__/camera0_mclk_4mA@gpio100";
		camera0_mclk_6mA = "/fragment@52/__overlay__/camera0_mclk_6mA@gpio100";
		camera0_mclk_8mA = "/fragment@52/__overlay__/camera0_mclk_8mA@gpio100";
		camera0_mclk_off = "/fragment@52/__overlay__/camera0_mclk_gpio_mode@gpio100";
		camera0_pdn_high = "/fragment@52/__overlay__/camera0_pdn_output_high@gpio98";
		camera0_pdn_low = "/fragment@52/__overlay__/camera0_pdn_output_low@gpio98";
		camera0_rst_high = "/fragment@52/__overlay__/camera0_rst_output_high@gpio102";
		camera0_rst_low = "/fragment@52/__overlay__/camera0_rst_output_low@gpio102";
		camera0_vcama_off = "/fragment@52/__overlay__/camera0_vcama_output_low@gpio23";
		camera0_vcama_on = "/fragment@52/__overlay__/camera0_vcama_output_high@gpio23";
		camera0_vcamd_off = "/fragment@52/__overlay__/camera0_vcama_output_low@gpio40";
		camera0_vcamd_on = "/fragment@52/__overlay__/camera0_vcama_output_high@gpio40";
		camera1_mclk_2mA = "/fragment@52/__overlay__/camera1_mclk_2mA@gpio99";
		camera1_mclk_4mA = "/fragment@52/__overlay__/camera1_mclk_4mA@gpio99";
		camera1_mclk_6mA = "/fragment@52/__overlay__/camera1_mclk_6mA@gpio99";
		camera1_mclk_8mA = "/fragment@52/__overlay__/camera1_mclk_8mA@gpio99";
		camera1_mclk_off = "/fragment@52/__overlay__/camera1_mclk_gpio_mode@gpio99";
		camera1_pdn_high = "/fragment@52/__overlay__/camera1_pdn_output_high@gpio97";
		camera1_pdn_low = "/fragment@52/__overlay__/camera1_pdn_output_low@gpio97";
		camera1_rst_high = "/fragment@52/__overlay__/camera1_rst_output_high@gpio101";
		camera1_rst_low = "/fragment@52/__overlay__/camera1_rst_output_low@gpio101";
		camera1_vcama_off = "/fragment@52/__overlay__/camera1_vcama_output_low@gpio23";
		camera1_vcama_on = "/fragment@52/__overlay__/camera1_vcama_output_high@gpio23";
		camera2_mclk_2mA = "/fragment@52/__overlay__/camera2_mclk_2mA@gpio111";
		camera2_mclk_4mA = "/fragment@52/__overlay__/camera2_mclk_4mA@gpio111";
		camera2_mclk_6mA = "/fragment@52/__overlay__/camera2_mclk_6mA@gpio111";
		camera2_mclk_8mA = "/fragment@52/__overlay__/camera2_mclk_8mA@gpio111";
		camera2_mclk_off = "/fragment@52/__overlay__/camera2_mclk_gpio_mode@gpio111";
		camera2_pdn_high = "/fragment@52/__overlay__/camera2_pdn_output_high@gpio110";
		camera2_pdn_low = "/fragment@52/__overlay__/camera2_pdn_output_low@gpio110";
		camera2_rst_high = "/fragment@52/__overlay__/camera2_rst_output_high@gpio112";
		camera2_rst_low = "/fragment@52/__overlay__/camera2_rst_output_low@gpio112";
		camera2_vcamd_off = "/fragment@52/__overlay__/camera2_vcama_output_low@gpio46";
		camera2_vcamd_on = "/fragment@52/__overlay__/camera2_vcama_output_high@gpio46";
		camera3_mclk_2mA = "/fragment@52/__overlay__/camera3_mclk_2mA@gpio111";
		camera3_mclk_4mA = "/fragment@52/__overlay__/camera3_mclk_4mA@gpio111";
		camera3_mclk_6mA = "/fragment@52/__overlay__/camera3_mclk_6mA@gpio111";
		camera3_mclk_8mA = "/fragment@52/__overlay__/camera3_mclk_8mA@gpio111";
		camera3_mclk_off = "/fragment@52/__overlay__/camera3_mclk_gpio_mode@gpio111";
		camera3_pdn_high = "/fragment@52/__overlay__/camera3_pdn_output_high@gpio36";
		camera3_pdn_low = "/fragment@52/__overlay__/camera3_pdn_output_low@gpio36";
		camera_main_af_mtk = "/fragment@29/__overlay__/camera_main_af@0c";
		camera_main_eeprom_mtk = "/fragment@29/__overlay__/camera_main_eeprom@50";
		camera_main_mtk = "/fragment@29/__overlay__/camera_main@10";
		camera_main_two_mtk = "/fragment@27/__overlay__/camera_main_two@10";
		camera_pins_default = "/fragment@52/__overlay__/camdefault";
		camera_sub_eeprom_mtk = "/fragment@27/__overlay__/camera_sub_eeprom@51";
		camera_sub_mtk = "/fragment@27/__overlay__/camera_sub@36";
		camera_sub_two_mtk = "/fragment@28/__overlay__/camera_sub_two@40";
		ccu_sensor_i2c_2_hw_mtk = "/fragment@27/__overlay__/ccu_sensor_i2c_2_hw@11";
		ccu_sensor_i2c_4_hw_mtk = "/fragment@29/__overlay__/ccu_sensor_i2c_4_hw@12";
		consys_pins_default = "/fragment@9/__overlay__/consys_default";
		ctp_pins_default = "/fragment@20/__overlay__/eint0default";
		ctp_pins_eint_as_int = "/fragment@20/__overlay__/eint@0";
		ctp_pins_eint_output0 = "/fragment@20/__overlay__/eintoutput0";
		ctp_pins_eint_output1 = "/fragment@20/__overlay__/eintoutput1";
		ctp_pins_rst_output0 = "/fragment@20/__overlay__/rstoutput0";
		ctp_pins_rst_output1 = "/fragment@20/__overlay__/rstoutput1";
		fingerprint = "/fragment@2/__overlay__/fingerprint";
		fingerprint_default = "/fragment@4/__overlay__/fingerprint_default";
		fingerprint_eint = "/fragment@4/__overlay__/gpio7_eint";
		fingerprint_eint_pull_down = "/fragment@4/__overlay__/gpio7_eint_pull_down";
		fingerprint_rst_one = "/fragment@4/__overlay__/rst_out_one";
		fingerprint_rst_zero = "/fragment@4/__overlay__/rst_out_zero";
		flashlights_aw36515_pins_default = "/fragment@54/__overlay__/aw36515default";
		flashlights_aw36515_pins_hwen_high = "/fragment@54/__overlay__/aw36515hwen_high";
		flashlights_aw36515_pins_hwen_low = "/fragment@54/__overlay__/aw36515hwen_low";
		flashlights_ocp81375_pins_default = "/fragment@56/__overlay__/ocp81375default";
		flashlights_ocp81375_pins_hwen_high = "/fragment@56/__overlay__/ocp81375hwen_high";
		flashlights_ocp81375_pins_hwen_low = "/fragment@56/__overlay__/ocp81375hwen_low";
		fmgpio_pins_0 = "/fragment@9/__overlay__/fmgpio@4";
		fmgpio_pins_1 = "/fragment@9/__overlay__/fmgpio@3";
		gpio178_otg = "/fragment@18/__overlay__/otg_init";
		gpio178_otg_high = "/fragment@18/__overlay__/otg_high";
		gpio178_otg_low = "/fragment@18/__overlay__/otg_low";
		gpio8_meta = "/fragment@18/__overlay__/meta_init";
		gpio8_meta_high = "/fragment@18/__overlay__/meta_high";
		gpio8_meta_low = "/fragment@18/__overlay__/meta_low";
		gpslna_pins_init = "/fragment@9/__overlay__/gpslna@0";
		gpslna_pins_oh = "/fragment@9/__overlay__/gpslna@1";
		gpslna_pins_ol = "/fragment@9/__overlay__/gpslna@2";
		i2c_lcd_bias_mtk = "/fragment@31/__overlay__/i2c_lcd_bias@3e";
		irtx_gpio_led_default = "/fragment@12/__overlay__/irtx_gpio_led_def@gpio12";
		irtx_gpio_led_set = "/fragment@12/__overlay__/irtx_gpio_led_set@gpio12";
		led0 = "/fragment@2/__overlay__/led@0";
		led1 = "/fragment@2/__overlay__/led@1";
		led2 = "/fragment@2/__overlay__/led@2";
		led3 = "/fragment@2/__overlay__/led@3";
		led4 = "/fragment@2/__overlay__/led@4";
		led5 = "/fragment@2/__overlay__/led@5";
		led6 = "/fragment@2/__overlay__/led@6";
		mtkfb_pins_6382_rst_out0_gpio = "/fragment@13/__overlay__/6382_rst_out0_gpio";
		mtkfb_pins_6382_rst_out1_gpio = "/fragment@13/__overlay__/6382_rst_out1_gpio";
		mtkfb_pins_lcd_bias_enn0 = "/fragment@13/__overlay__/lcd_bias_enn0_gpio";
		mtkfb_pins_lcd_bias_enn1 = "/fragment@13/__overlay__/lcd_bias_enn1_gpio";
		mtkfb_pins_lcd_bias_enp0 = "/fragment@13/__overlay__/lcd_bias_enp0_gpio";
		mtkfb_pins_lcd_bias_enp1 = "/fragment@13/__overlay__/lcd_bias_enp1_gpio";
		mtkfb_pins_lcm_dsi_te = "/fragment@13/__overlay__/lcm_dsi_te";
		mtkfb_pins_lcm_rst_out0_gpio = "/fragment@13/__overlay__/lcm_rst_out0_gpio";
		mtkfb_pins_lcm_rst_out1_gpio = "/fragment@13/__overlay__/lcm_rst_out1_gpio";
		nfc_mtk = "/fragment@28/__overlay__/nfc@08";
		spislv_pins_default = "/fragment@16/__overlay__/spislv_mode_default";
		strobe_main_mtk = "/fragment@31/__overlay__/strobe_main@63";
		tran_audio = "/fragment@2/__overlay__/tran_audio";
		tran_touch = "/fragment@21/__overlay__/touch@0";
		vibrator0 = "/fragment@2/__overlay__/vibrator@0";
	};

	fragment@0 {
		target = <0xffffffff>;

		__overlay__ {

			reserve-memory-scp_share {
				alignment = <0x0 0x1000000>;
				alloc-ranges = <0x0 0x40000000 0x0 0x50000000>;
				compatible = "mediatek,reserve-memory-scp_share";
				no-map;
				size = <0x0 0xd00000>;
			};
		};
	};

	fragment@1 {
		target = <0xffffffff>;

		__overlay__ {
			atag,videolfb-fb_base_h = <0x0>;
			atag,videolfb-fb_base_l = "~`P";
			atag,videolfb-fps = <0x1770>;
			atag,videolfb-islcm_inited = <0x0>;
			atag,videolfb-islcmfound = <0x1>;
			atag,videolfb-lcmname = "nt36672c_fhdp_dsi_vdo_60hz_wo_dsc_shenchao_lcm_drv";
			atag,videolfb-vramSize = <0x17e8000>;
		};
	};

	fragment@10 {
		target = <0xffffffff>;

		__overlay__ {
			pinctrl-0 = <0x6>;
			pinctrl-1 = <0x7>;
			pinctrl-2 = <0x8>;
			pinctrl-3 = <0x9>;
			pinctrl-4 = <0xa>;
			pinctrl-5 = <0xb>;
			pinctrl-names = "default", "gps_lna_state_init", "gps_lna_state_oh", "gps_lna_state_ol", "fm_gpio_func_1", "fm_gpio_func_0";
			status = "okay";
		};
	};

	fragment@11 {
		target = <0xffffffff>;

		__overlay__ {
			pinctrl-0 = <0xc>;
			pinctrl-1 = <0xd>;
			pinctrl-names = "irtx_gpio_led_default", "irtx_gpio_led_set";
			status = "okay";
		};
	};

	fragment@12 {
		target = <0xffffffff>;

		__overlay__ {

			irtx_gpio_led_def@gpio12 {
				phandle = <0xc>;

				pins_cmd_dat {
					bias-disable;
					input-schmitt-enable = <0x0>;
					output-low;
					pinmux = <0xc00>;
					slew-rate = <0x1>;
				};
			};

			irtx_gpio_led_set@gpio12 {
				phandle = <0xd>;

				pins_cmd_dat {
					output-high;
					pinmux = <0xc01>;
					slew-rate = <0x1>;
				};
			};
		};
	};

	fragment@13 {
		target = <0xffffffff>;

		__overlay__ {

			6382_rst_out0_gpio {
				phandle = <0x12>;

				pins_cmd_dat {
					output-low;
					pinmux = <0x2500>;
					slew-rate = <0x1>;
				};
			};

			6382_rst_out1_gpio {
				phandle = <0x11>;

				pins_cmd_dat {
					output-high;
					pinmux = <0x2500>;
					slew-rate = <0x1>;
				};
			};

			lcd_bias_enn0_gpio {
				phandle = <0x16>;

				pins_cmd_dat {
					output-low;
					pinmux = <0x9800>;
					slew-rate = <0x1>;
				};
			};

			lcd_bias_enn1_gpio {
				phandle = <0x15>;

				pins_cmd_dat {
					output-high;
					pinmux = <0x9800>;
					slew-rate = <0x1>;
				};
			};

			lcd_bias_enp0_gpio {
				phandle = <0x14>;

				pins_cmd_dat {
					output-low;
					pinmux = <0x9900>;
					slew-rate = <0x1>;
				};
			};

			lcd_bias_enp1_gpio {
				phandle = <0x13>;

				pins_cmd_dat {
					output-high;
					pinmux = <0x9900>;
					slew-rate = <0x1>;
				};
			};

			lcm_dsi_te {
				phandle = <0x10>;

				pins_cmd_dat {
					pinmux = <0x2c01>;
				};
			};

			lcm_rst_out0_gpio {
				phandle = <0xf>;

				pins_cmd_dat {
					output-low;
					pinmux = <0x2d00>;
					slew-rate = <0x1>;
				};
			};

			lcm_rst_out1_gpio {
				phandle = <0xe>;

				pins_cmd_dat {
					output-high;
					pinmux = <0x2d00>;
					slew-rate = <0x1>;
				};
			};
		};
	};

	fragment@14 {
		target = <0xffffffff>;

		__overlay__ {
			pinctrl-0 = <0xe>;
			pinctrl-1 = <0xf>;
			pinctrl-2 = <0x10>;
			pinctrl-3 = <0x11>;
			pinctrl-4 = <0x12>;
			pinctrl-5 = <0x13>;
			pinctrl-6 = <0x14>;
			pinctrl-7 = <0x15>;
			pinctrl-8 = <0x16>;
			pinctrl-names = "lcm_rst_out1_gpio", "lcm_rst_out0_gpio", "mode_te_te", "6382_rst_out1_gpio", "6382_rst_out0_gpio", "lcd_bias_enp1_gpio", "lcd_bias_enp0_gpio", "lcd_bias_enn1_gpio", "lcd_bias_enn0_gpio";
			status = "okay";
		};
	};

	fragment@15 {
		target = <0xffffffff>;

		__overlay__ {
			#address-cells = <0x1>;
			#size-cells = <0x0>;
			pinctrl-0 = <0x17>;
			pinctrl-names = "default";
			status = "okay";

			spislv@0 {
				compatible = "mediatek,spi_slave";
				high-speed-early-trans = [01];
				high-speed-tick-delay = [01];
				low-speed-early-trans = [00];
				low-speed-tick-delay = [01];
				reg = <0x0>;
				slave-drive-strength = [03];
				spi-max-frequency = <0x3473bc0>;
				spi-rx-bus-width = <0x1>;
				spi-tx-bus-width = <0x1>;
			};
		};
	};

	fragment@16 {
		target = <0xffffffff>;

		__overlay__ {

			spislv_mode_default {
				phandle = <0x17>;

				pins_cmd_dat {
					drive-strength = <0x3>;
					pinmux = <0x1102 0x1202 0x1302 0x1402>;
				};
			};
		};
	};

	fragment@17 {
		target = <0xffffffff>;

		__overlay__ {
			pinctrl-0 = <0x18>;
			pinctrl-1 = <0x19>;
			pinctrl-2 = <0x1a>;
			pinctrl-3 = <0x1b>;
			pinctrl-4 = <0x1c>;
			pinctrl-5 = <0x1d>;
			pinctrl-names = "otg_gpio_init", "otg_gpio_low", "otg_gpio_high", "meta_gpio_init", "meta_gpio_low", "meta_gpio_high";
			status = "okay";
		};
	};

	fragment@18 {
		target = <0xffffffff>;

		__overlay__ {

			meta_high {
				phandle = <0x1d>;

				pins_cmd_dat {
					output-high;
					pinmux = <0x800>;
					slew-rate = <0x1>;
				};
			};

			meta_init {
				phandle = <0x1b>;

				pins_cmd_dat {
					pinmux = <0x800>;
					slew-rate = <0x1>;
				};
			};

			meta_low {
				phandle = <0x1c>;

				pins_cmd_dat {
					output-low;
					pinmux = <0x800>;
					slew-rate = <0x1>;
				};
			};

			otg_high {
				phandle = <0x1a>;

				pins_cmd_dat {
					output-high;
					pinmux = <0xb200>;
					slew-rate = <0x1>;
				};
			};

			otg_init {
				phandle = <0x18>;

				pins_cmd_dat {
					pinmux = <0xb200>;
					slew-rate = <0x1>;
				};
			};

			otg_low {
				phandle = <0x19>;

				pins_cmd_dat {
					output-low;
					pinmux = <0xb200>;
					slew-rate = <0x1>;
				};
			};
		};
	};

	fragment@19 {
		target = <0xffffffff>;

		__overlay__ {
			compatible = "mediatek,touch";
			pinctrl-0 = <0x1e>;
			pinctrl-1 = <0x1f>;
			pinctrl-2 = <0x20>;
			pinctrl-3 = <0x21>;
			pinctrl-4 = <0x22>;
			pinctrl-5 = <0x23>;
			pinctrl-names = "default", "state_eint_as_int", "state_eint_output0", "state_eint_output1", "state_rst_output0", "state_rst_output1";
			status = "okay";
			tpd-filter-custom-prameters = <0x0 0x0 0x0 0x0 0x0 0x0 0x0 0x0 0x0 0x0 0x0 0x0>;
			tpd-filter-custom-speed = <0x0 0x0 0x0>;
			tpd-filter-enable = <0x0>;
			tpd-filter-pixel-density = <0xa8>;
			tpd-key-dim-local = <0x5a 0x373 0x64 0x28 0xe6 0x373 0x64 0x28 0x172 0x373 0x64 0x28 0x0 0x0 0x0 0x0>;
			tpd-key-local = <0x8b 0xac 0x9e 0x0>;
			tpd-key-num = <0x3>;
			tpd-max-touch-num = <0xa>;
			tpd-resolution = <0x438 0x99c>;
			use-tpd-button = <0x0>;
		};
	};

	fragment@2 {
		target = <0xffffffff>;

		__overlay__ {

			fingerprint {
				compatible = "tran_fp";
				debounce = <0x7 0x0>;
				interrupt-parent = <0xffffffff>;
				interrupts = <0x7 0x1 0x7 0x0>;
				phandle = <0x5e>;
				pinctrl-0 = <0x1>;
				pinctrl-1 = <0x2>;
				pinctrl-2 = <0x3>;
				pinctrl-3 = <0x4>;
				pinctrl-4 = <0x5>;
				pinctrl-names = "tran_fp_default", "tran_fp_pin_irq", "tran_fp_irq_pull_down", "tran_fp_reset_high", "tran_fp_reset_low";
				status = "okay";
			};

			led@0 {
				compatible = "mediatek,red";
				data = <0x1>;
				led_mode = <0x0>;
				phandle = <0x55>;
				pwm_config = <0x0 0x0 0x0 0x0 0x0>;
			};

			led@1 {
				compatible = "mediatek,green";
				data = <0x1>;
				led_mode = <0x0>;
				phandle = <0x56>;
				pwm_config = <0x0 0x0 0x0 0x0 0x0>;
			};

			led@2 {
				compatible = "mediatek,blue";
				data = <0x2>;
				led_mode = <0x3>;
				phandle = <0x57>;
				pwm_config = <0x0 0x0 0x0 0x0 0x0>;
			};

			led@3 {
				compatible = "mediatek,jogball-backlight";
				data = <0x1>;
				led_mode = <0x0>;
				phandle = <0x58>;
				pwm_config = <0x0 0x0 0x0 0x0 0x0>;
			};

			led@4 {
				compatible = "mediatek,keyboard-backlight";
				data = <0x1>;
				led_mode = <0x0>;
				phandle = <0x59>;
				pwm_config = <0x0 0x0 0x0 0x0 0x0>;
			};

			led@5 {
				compatible = "mediatek,button-backlight";
				data = <0x1>;
				led_mode = <0x0>;
				phandle = <0x5a>;
				pwm_config = <0x0 0x0 0x0 0x0 0x0>;
			};

			led@6 {
				compatible = "mediatek,lcd-backlight";
				data = <0x1>;
				led_mode = <0x5>;
				phandle = <0x5b>;
				pwm_config = <0x1 0x0 0x0 0x0 0x0>;
			};

			tran_audio {
				amp_type_gpio = <0xffffffff 0x50 0x0>;
				compatible = "tran_audio,audio";
				dual_speaker_gpio = <0xffffffff 0x97 0x0>;
				extamp_gpio = <0xffffffff 0xa6 0x0>;
				extamp_mode = <0x2>;
				extamp_speech_mode = <0x2>;
				fs_extamp_mode = <0x6>;
				fs_extamp_speech_mode = <0x6>;
				fs_receiver_mode = <0x3>;
				phandle = <0x5d>;
				receiver_mode = <0x6>;
			};

			vibrator@0 {
				compatible = "mediatek,vibrator";
				phandle = <0x5c>;
				vib_limit = <0x9>;
				vib_timer = <0x19>;
				vib_vol = <0xb>;
			};
		};
	};

	fragment@20 {
		target = <0xffffffff>;

		__overlay__ {

			eint0default {
				phandle = <0x1e>;
			};

			eint@0 {
				phandle = <0x1f>;

				pins_cmd_dat {
					bias-disable;
					pinmux = <0x100>;
					slew-rate = <0x0>;
				};
			};

			eintoutput0 {
				phandle = <0x20>;

				pins_cmd_dat {
					output-low;
					pinmux = <0x100>;
					slew-rate = <0x1>;
				};
			};

			eintoutput1 {
				phandle = <0x21>;

				pins_cmd_dat {
					output-high;
					pinmux = <0x100>;
					slew-rate = <0x1>;
				};
			};

			rstoutput0 {
				phandle = <0x22>;

				pins_cmd_dat {
					output-low;
					pinmux = <0x0>;
					slew-rate = <0x1>;
				};
			};

			rstoutput1 {
				phandle = <0x23>;

				pins_cmd_dat {
					output-high;
					pinmux = <0x0>;
					slew-rate = <0x1>;
				};
			};
		};
	};

	fragment@21 {
		target = <0xffffffff>;

		__overlay__ {

			touch@0 {
				compatible = "novatek,NVT-ts-spi";
				novatek,mp-support-dt;
				novatek,spi-rd-fast-addr = <0x3f310>;
				novatek,swrst-n8-addr = <0x3f0fe>;
				phandle = <0x5f>;
				reg = <0x0>;
				spi-max-frequency = <0x7a1200>;
				status = "okay";

				novatek-mp-criteria-6256@0 {
					#address-cells = <0x1>;
					#size-cells = <0x0>;
					AIN_KEY = <0x0 0x1 0x2 0xff>;
					AIN_X = <0x0 0x1 0x2 0x3 0x4 0x5 0x6 0x7 0x8 0x9 0xa 0xb 0xc 0xd 0xe 0xf 0x10 0x11>;
					AIN_Y = <0x0 0x1 0x2 0x3 0x4 0x5 0x6 0x7 0x8 0x9 0xa 0xb 0xc 0xd 0xe 0xf 0x10 0x11 0x12 0x13 0x14 0x15 0x16 0x17 0x18 0x19 0x1a 0x1b 0x1c 0x1d 0x1e 0x1f 0x20 0x21 0x22 0x23>;
					IC_KEY_CFG_SIZE = <0x4>;
					IC_X_CFG_SIZE = <0x12>;
					IC_Y_CFG_SIZE = <0x24>;
					PS_Config_Diff_Test_Frame = <0x32>;
					PS_Config_Lmt_FW_CC_N = <0x11 0x11 0x12 0x12 0x13 0x13 0x12 0x12 0x13 0x13 0x11 0x11 0x12 0x12 0x12 0x11 0x11 0x11 0x12 0x12 0x12 0x12 0x11 0x11 0x11 0x11 0x12 0x12 0x11 0x11 0x11 0x11 0x12 0x12 0x12 0x13 0x13 0x13 0x13 0x13 0x13 0x13 0x13 0x13 0x13 0x13 0x13 0x12 0x12 0x12 0x12 0x12 0x12 0x13 0x12 0x12 0x12 0x11 0x12 0x11 0x11 0x12 0x13 0x13 0x12 0x12 0x12 0x11 0x12 0x12 0x12 0x13 0x13 0x13 0x13 0x13 0x13 0x12 0x13 0x13 0x13 0x13 0x13 0x12 0x12 0x12 0x13 0x13 0x13 0x13 0x13 0x12 0x12 0x11 0x11 0x11 0x11 0x11 0x13 0x13 0x12 0x11 0x12 0x11 0x12 0x12 0x12 0x13 0x13 0x13 0x13 0x12 0x12 0x12 0x12 0x13 0x13 0x13 0x13 0x11 0x12 0x11 0x12 0x12 0x12 0x13 0x13 0x13 0x12 0x12 0x12 0x12 0x12 0x12 0x13 0x13 0x13 0x13 0x13 0x12 0x13 0x13 0x13 0x13 0x13 0x13 0x12 0x12 0x12 0x12 0x12 0x13 0x13 0x13 0x13 0x12 0x13 0x12 0x13 0x13 0x13 0x13 0x13 0x12 0x12 0x12 0x12 0x12 0x12 0x12 0x13 0x13 0x12 0x11 0x12 0x11 0x12 0x12 0x13 0x13 0x13 0x13 0x13 0x13 0x12 0x12 0x13 0x13 0x13 0x13 0x13 0x13 0x13 0x12 0x13 0x13 0x13 0x13 0x13 0x12 0x12 0x12 0x12 0x12 0x12 0x13 0x13 0x13 0x12 0x12 0x12 0x12 0x12 0x12 0x12 0x13 0x13 0x13 0x13 0x13 0x12 0x12 0x13 0x13 0x13 0x13 0x12 0x12 0x12 0x12 0x12 0x12 0x12 0x13 0x13 0x12 0x11 0x12 0x11 0x11 0x12 0x12 0x12 0x13 0x12 0x12 0x13 0x12 0x13 0x13 0x13 0x13 0x13 0x13 0x13 0x13 0x12 0x12 0x13 0x13 0x13 0x13 0x12 0x11 0x12 0x12 0x12 0x12 0x12 0x13 0x13 0x11 0x11 0x11 0x11 0x11 0x12 0x12 0x12 0x13 0x13 0x12 0x12 0x12 0x13 0x12 0x12 0x13 0x13 0x13 0x12 0x12 0x12 0x13 0x13 0x13 0x13 0x13 0x13 0x12 0x12 0x12 0x13 0x12 0x12 0x13 0x13 0x11 0x11 0x11 0x11 0x11 0x11 0x11 0x11 0x13 0x13 0x12 0x11 0x12 0x12 0x12 0x12 0x13 0x13 0x13 0x13 0x13 0x13 0x13 0x13 0x13 0x14 0x13 0x13 0x13 0x13 0x13 0x13 0x12 0x13 0x13 0x13 0x13 0x13 0x13 0x13 0x13 0x13 0x13 0x13 0x13 0x13 0x13 0x13 0x13 0x13 0x12 0x12 0x13 0x13 0x13 0x13 0x13 0x13 0x13 0x13 0x13 0x14 0x13 0x13 0x13 0x13 0x13 0x13 0x13 0x13 0x13 0x13 0x12 0x13 0x13 0x13 0x13 0x13 0x13 0x13 0x13 0x13 0x13 0x13 0x13 0x12 0x12 0x12 0x13 0x13 0x13 0x13 0x13 0x13 0x13 0x13 0x13 0x13 0x13 0x13 0x13 0x13 0x13 0x13 0x12 0x12 0x13 0x13 0x13 0x13 0x13 0x13 0x13 0x13 0x13 0x13 0x13 0x13 0x13 0x13 0x13 0x13 0x13 0x13 0x13 0x13 0x13 0x13 0x13 0x13 0x13 0x13 0x13 0x13 0x13 0x13 0x13 0x13 0x13 0x13 0x13 0x13 0x13 0x13 0x13 0x13 0x13 0x13 0x13 0x13 0x13 0x13 0x13 0x13 0x13 0x13 0x13 0x13 0x13 0x13 0x13 0x13 0x13 0x13 0x13 0x13 0x13 0x13 0x13 0x13 0x13 0x13 0x13 0x13 0x13 0x13 0x13 0x13 0x13 0x13 0x13 0x13 0x13 0x13 0x13 0x13 0x13 0x13 0x13 0x13 0x13 0x13 0x13 0x13 0x13 0x13 0x13 0x13 0x13 0x13 0x13 0x13 0x13 0x13 0x13 0x13 0x13 0x13 0x13 0x13 0x13 0x13 0x13 0x13 0x13 0x13 0x13 0x13 0x13 0x13 0x13 0x13 0x13 0x13 0x13 0x13 0x13 0x13 0x13 0x13 0x13 0x13 0x13 0x13 0x13 0x13 0x13 0x13 0x13 0x13 0x13 0x13 0x13 0x13 0x13 0x13 0x13 0x13 0x13 0x13 0x13 0x13 0x13 0x13 0x13 0x13 0x13 0x13 0x13 0x13 0x13 0x13 0x13 0x13 0x13 0x13 0x13 0x13 0x13 0x13 0x13 0x13 0x13 0x13 0x13 0x13 0x13 0x13 0x13 0x13 0x13 0x13 0x13 0x13 0x13 0x13 0x13 0x13 0x12 0x13 0x13 0x13 0x13 0x13 0x13 0x13 0x13 0x13 0x13 0x13 0x13 0x13 0x13 0x13 0x13 0x13 0x13 0x13 0x13 0x13 0x13 0x13 0x13 0x14 0x13 0x13 0x13 0x13 0x13 0x13 0x13 0x13 0x13 0x13 0x13 0x13 0x13 0x13 0x13 0x13 0x13 0x13 0x13 0x13 0x13 0x13 0x13 0x13 0x13 0x13 0x13>;
					PS_Config_Lmt_FW_CC_P = <0x27 0x27 0x28 0x28 0x29 0x29 0x28 0x28 0x29 0x29 0x27 0x27 0x28 0x28 0x28 0x27 0x27 0x27 0x28 0x28 0x28 0x28 0x27 0x27 0x27 0x27 0x28 0x28 0x27 0x27 0x27 0x27 0x28 0x28 0x28 0x29 0x29 0x29 0x29 0x29 0x29 0x29 0x29 0x29 0x29 0x29 0x29 0x28 0x28 0x28 0x28 0x28 0x28 0x29 0x28 0x28 0x28 0x27 0x28 0x27 0x27 0x28 0x29 0x29 0x28 0x28 0x28 0x27 0x28 0x28 0x28 0x29 0x29 0x29 0x29 0x29 0x29 0x28 0x29 0x29 0x29 0x29 0x29 0x28 0x28 0x28 0x29 0x29 0x29 0x29 0x29 0x28 0x28 0x27 0x27 0x27 0x27 0x27 0x29 0x29 0x28 0x27 0x28 0x27 0x28 0x28 0x28 0x29 0x29 0x29 0x29 0x28 0x28 0x28 0x28 0x29 0x29 0x29 0x29 0x27 0x28 0x27 0x28 0x28 0x28 0x29 0x29 0x29 0x28 0x28 0x28 0x28 0x28 0x28 0x29 0x29 0x29 0x29 0x29 0x28 0x29 0x29 0x29 0x29 0x29 0x29 0x28 0x28 0x28 0x28 0x28 0x29 0x29 0x29 0x29 0x28 0x29 0x28 0x29 0x29 0x29 0x29 0x29 0x28 0x28 0x28 0x28 0x28 0x28 0x28 0x29 0x29 0x28 0x27 0x28 0x27 0x28 0x28 0x29 0x29 0x29 0x29 0x29 0x29 0x28 0x28 0x29 0x29 0x29 0x29 0x29 0x29 0x29 0x28 0x29 0x29 0x29 0x29 0x29 0x28 0x28 0x28 0x28 0x28 0x28 0x29 0x29 0x29 0x28 0x28 0x28 0x28 0x28 0x28 0x28 0x29 0x29 0x29 0x29 0x29 0x28 0x28 0x29 0x29 0x29 0x29 0x28 0x28 0x28 0x28 0x28 0x28 0x28 0x29 0x29 0x28 0x27 0x28 0x27 0x27 0x28 0x28 0x28 0x29 0x28 0x28 0x29 0x28 0x29 0x29 0x29 0x29 0x29 0x29 0x29 0x29 0x28 0x28 0x29 0x29 0x29 0x29 0x28 0x27 0x28 0x28 0x28 0x28 0x28 0x29 0x29 0x27 0x27 0x27 0x27 0x27 0x28 0x28 0x28 0x29 0x29 0x28 0x28 0x28 0x29 0x28 0x28 0x29 0x29 0x29 0x28 0x28 0x28 0x29 0x29 0x29 0x29 0x2b 0x29 0x28 0x28 0x28 0x29 0x28 0x28 0x29 0x29 0x27 0x27 0x27 0x27 0x27 0x27 0x27 0x27 0x29 0x29 0x28 0x27 0x28 0x28 0x28 0x28 0x29 0x29 0x29 0x29 0x29 0x29 0x29 0x29 0x29 0x2c 0x29 0x29 0x29 0x29 0x29 0x29 0x28 0x29 0x29 0x29 0x29 0x29 0x29 0x29 0x29 0x29 0x29 0x2b 0x29 0x29 0x29 0x29 0x29 0x29 0x28 0x28 0x29 0x29 0x29 0x29 0x29 0x29 0x29 0x29 0x29 0x2c 0x29 0x29 0x29 0x29 0x29 0x29 0x29 0x29 0x29 0x29 0x28 0x29 0x29 0x29 0x29 0x29 0x29 0x29 0x29 0x29 0x29 0x29 0x29 0x28 0x28 0x28 0x29 0x29 0x29 0x29 0x29 0x29 0x29 0x29 0x29 0x2b 0x29 0x29 0x29 0x29 0x29 0x29 0x28 0x28 0x29 0x29 0x29 0x29 0x29 0x29 0x29 0x29 0x29 0x2b 0x29 0x29 0x29 0x29 0x29 0x29 0x29 0x29 0x29 0x29 0x29 0x29 0x29 0x29 0x29 0x29 0x29 0x2b 0x2b 0x29 0x29 0x29 0x29 0x29 0x29 0x29 0x29 0x29 0x29 0x29 0x29 0x29 0x29 0x29 0x29 0x29 0x29 0x29 0x29 0x29 0x29 0x29 0x29 0x29 0x29 0x29 0x29 0x29 0x29 0x29 0x29 0x29 0x29 0x2b 0x2b 0x29 0x29 0x29 0x29 0x29 0x29 0x29 0x29 0x29 0x29 0x29 0x29 0x29 0x29 0x29 0x29 0x29 0x29 0x29 0x29 0x29 0x29 0x29 0x29 0x29 0x29 0x29 0x29 0x29 0x29 0x29 0x29 0x29 0x29 0x2b 0x29 0x29 0x29 0x29 0x29 0x29 0x29 0x29 0x29 0x29 0x29 0x29 0x29 0x29 0x29 0x29 0x29 0x29 0x29 0x29 0x29 0x29 0x29 0x29 0x29 0x29 0x29 0x29 0x29 0x29 0x29 0x29 0x29 0x29 0x29 0x2b 0x29 0x29 0x29 0x29 0x29 0x29 0x29 0x29 0x29 0x29 0x29 0x29 0x29 0x29 0x29 0x29 0x29 0x29 0x29 0x29 0x29 0x29 0x29 0x29 0x29 0x29 0x29 0x29 0x29 0x29 0x29 0x29 0x29 0x29 0x29 0x2b 0x29 0x29 0x29 0x29 0x29 0x29 0x29 0x29 0x29 0x29 0x28 0x29 0x29 0x29 0x29 0x29 0x29 0x2b 0x29 0x29 0x29 0x29 0x29 0x29 0x29 0x29 0x29 0x29 0x29 0x29 0x29 0x29 0x29 0x29 0x29 0x2c 0x29 0x29 0x29 0x29 0x29 0x29 0x29 0x29 0x29 0x29 0x29 0x29 0x29 0x29 0x29 0x29 0x29 0x2b 0x2b 0x29 0x29 0x29 0x29 0x29 0x29 0x29 0x29>;
					PS_Config_Lmt_FW_Diff_N = <0xffffffce 0xffffffce 0xffffffce 0xffffffce 0xffffffce 0xffffffce 0xffffffce 0xffffffce 0xffffffce 0xffffffce 0xffffffce 0xffffffce 0xffffffce 0xffffffce 0xffffffce 0xffffffce 0xffffffce 0xffffffce 0xffffffce 0xffffffce 0xffffffce 0xffffffce 0xffffffce 0xffffffce 0xffffffce 0xffffffce 0xffffffce 0xffffffce 0xffffffce 0xffffffce 0xffffffce 0xffffffce 0xffffffce 0xffffffce 0xffffffce 0xffffffce 0xffffffce 0xffffffce 0xffffffce 0xffffffce 0xffffffce 0xffffffce 0xffffffce 0xffffffce 0xffffffce 0xffffffce 0xffffffce 0xffffffce 0xffffffce 0xffffffce 0xffffffce 0xffffffce 0xffffffce 0xffffffce 0xffffffce 0xffffffce 0xffffffce 0xffffffce 0xffffffce 0xffffffce 0xffffffce 0xffffffce 0xffffffce 0xffffffce 0xffffffce 0xffffffce 0xffffffce 0xffffffce 0xffffffce 0xffffffce 0xffffffce 0xffffffce 0xffffffce 0xffffffce 0xffffffce 0xffffffce 0xffffffce 0xffffffce 0xffffffce 0xffffffce 0xffffffce 0xffffffce 0xffffffce 0xffffffce 0xffffffce 0xffffffce 0xffffffce 0xffffffce 0xffffffce 0xffffffce 0xffffffce 0xffffffce 0xffffffce 0xffffffce 0xffffffce 0xffffffce 0xffffffce 0xffffffce 0xffffffce 0xffffffce 0xffffffce 0xffffffce 0xffffffce 0xffffffce 0xffffffce 0xffffffce 0xffffffce 0xffffffce 0xffffffce 0xffffffce 0xffffffce 0xffffffce 0xffffffce 0xffffffce 0xffffffce 0xffffffce 0xffffffce 0xffffffce 0xffffffce 0xffffffce 0xffffffce 0xffffffce 0xffffffce 0xffffffce 0xffffffce 0xffffffce 0xffffffce 0xffffffce 0xffffffce 0xffffffce 0xffffffce 0xffffffce 0xffffffce 0xffffffce 0xffffffce 0xffffffce 0xffffffce 0xffffffce 0xffffffce 0xffffffce 0xffffffce 0xffffffce 0xffffffce 0xffffffce 0xffffffce 0xffffffce 0xffffffce 0xffffffce 0xffffffce 0xffffffce 0xffffffce 0xffffffce 0xffffffce 0xffffffce 0xffffffce 0xffffffce 0xffffffce 0xffffffce 0xffffffce 0xffffffce 0xffffffce 0xffffffce 0xffffffce 0xffffffce 0xffffffce 0xffffffce 0xffffffce 0xffffffce 0xffffffce 0xffffffce 0xffffffce 0xffffffce 0xffffffce 0xffffffce 0xffffffce 0xffffffce 0xffffffce 0xffffffce 0xffffffce 0xffffffce 0xffffffce 0xffffffce 0xffffffce 0xffffffce 0xffffffce 0xffffffce 0xffffffce 0xffffffce 0xffffffce 0xffffffce 0xffffffce 0xffffffce 0xffffffce 0xffffffce 0xffffffce 0xffffffce 0xffffffce 0xffffffce 0xffffffce 0xffffffce 0xffffffce 0xffffffce 0xffffffce 0xffffffce 0xffffffce 0xffffffce 0xffffffce 0xffffffce 0xffffffce 0xffffffce 0xffffffce 0xffffffce 0xffffffce 0xffffffce 0xffffffce 0xffffffce 0xffffffce 0xffffffce 0xffffffce 0xffffffce 0xffffffce 0xffffffce 0xffffffce 0xffffffce 0xffffffce 0xffffffce 0xffffffce 0xffffffce 0xffffffce 0xffffffce 0xffffffce 0xffffffce 0xffffffce 0xffffffce 0xffffffce 0xffffffce 0xffffffce 0xffffffce 0xffffffce 0xffffffce 0xffffffce 0xffffffce 0xffffffce 0xffffffce 0xffffffce 0xffffffce 0xffffffce 0xffffffce 0xffffffce 0xffffffce 0xffffffce 0xffffffce 0xffffffce 0xffffffce 0xffffffce 0xffffffce 0xffffffce 0xffffffce 0xffffffce 0xffffffce 0xffffffce 0xffffffce 0xffffffce 0xffffffce 0xffffffce 0xffffffce 0xffffffce 0xffffffce 0xffffffce 0xffffffce 0xffffffce 0xffffffce 0xffffffce 0xffffffce 0xffffffce 0xffffffce 0xffffffce 0xffffffce 0xffffffce 0xffffffce 0xffffffce 0xffffffce 0xffffffce 0xffffffce 0xffffffce 0xffffffce 0xffffffce 0xffffffce 0xffffffce 0xffffffce 0xffffffce 0xffffffce 0xffffffce 0xffffffce 0xffffffce 0xffffffce 0xffffffce 0xffffffce 0xffffffce 0xffffffce 0xffffffce 0xffffffce 0xffffffce 0xffffffce 0xffffffce 0xffffffce 0xffffffce 0xffffffce 0xffffffce 0xffffffce 0xffffffce 0xffffffce 0xffffffce 0xffffffce 0xffffffce 0xffffffce 0xffffffce 0xffffffce 0xffffffce 0xffffffce 0xffffffce 0xffffffce 0xffffffce 0xffffffce 0xffffffce 0xffffffce 0xffffffce 0xffffffce 0xffffffce 0xffffffce 0xffffffce 0xffffffce 0xffffffce 0xffffffce 0xffffffce 0xffffffce 0xffffffce 0xffffffce 0xffffffce 0xffffffce 0xffffffce 0xffffffce 0xffffffce 0xffffffce 0xffffffce 0xffffffce 0xffffffce 0xffffffce 0xffffffce 0xffffffce 0xffffffce 0xffffffce 0xffffffce 0xffffffce 0xffffffce 0xffffffce 0xffffffce 0xffffffce 0xffffffce 0xffffffce 0xffffffce 0xffffffce 0xffffffce 0xffffffce 0xffffffce 0xffffffce 0xffffffce 0xffffffce 0xffffffce 0xffffffce 0xffffffce 0xffffffce 0xffffffce 0xffffffce 0xffffffce 0xffffffce 0xffffffce 0xffffffce 0xffffffce 0xffffffce 0xffffffce 0xffffffce 0xffffffce 0xffffffce 0xffffffce 0xffffffce 0xffffffce 0xffffffce 0xffffffce 0xffffffce 0xffffffce 0xffffffce 0xffffffce 0xffffffce 0xffffffce 0xffffffce 0xffffffce 0xffffffce 0xffffffce 0xffffffce 0xffffffce 0xffffffce 0xffffffce 0xffffffce 0xffffffce 0xffffffce 0xffffffce 0xffffffce 0xffffffce 0xffffffce 0xffffffce 0xffffffce 0xffffffce 0xffffffce 0xffffffce 0xffffffce 0xffffffce 0xffffffce 0xffffffce 0xffffffce 0xffffffce 0xffffffce 0xffffffce 0xffffffce 0xffffffce 0xffffffce 0xffffffce 0xffffffce 0xffffffce 0xffffffce 0xffffffce 0xffffffce 0xffffffce 0xffffffce 0xffffffce 0xffffffce 0xffffffce 0xffffffce 0xffffffce 0xffffffce 0xffffffce 0xffffffce 0xffffffce 0xffffffce 0xffffffce 0xffffffce 0xffffffce 0xffffffce 0xffffffce 0xffffffce 0xffffffce 0xffffffce 0xffffffce 0xffffffce 0xffffffce 0xffffffce 0xffffffce 0xffffffce 0xffffffce 0xffffffce 0xffffffce 0xffffffce 0xffffffce 0xffffffce 0xffffffce 0xffffffce 0xffffffce 0xffffffce 0xffffffce 0xffffffce 0xffffffce 0xffffffce 0xffffffce 0xffffffce 0xffffffce 0xffffffce 0xffffffce 0xffffffce 0xffffffce 0xffffffce 0xffffffce 0xffffffce 0xffffffce 0xffffffce 0xffffffce 0xffffffce 0xffffffce 0xffffffce 0xffffffce 0xffffffce 0xffffffce 0xffffffce 0xffffffce 0xffffffce 0xffffffce 0xffffffce 0xffffffce 0xffffffce 0xffffffce 0xffffffce 0xffffffce 0xffffffce 0xffffffce 0xffffffce 0xffffffce 0xffffffce 0xffffffce 0xffffffce 0xffffffce 0xffffffce 0xffffffce 0xffffffce 0xffffffce 0xffffffce 0xffffffce 0xffffffce 0xffffffce 0xffffffce 0xffffffce 0xffffffce 0xffffffce 0xffffffce 0xffffffce 0xffffffce 0xffffffce 0xffffffce 0xffffffce 0xffffffce 0xffffffce 0xffffffce 0xffffffce 0xffffffce 0xffffffce 0xffffffce 0xffffffce 0xffffffce 0xffffffce 0xffffffce 0xffffffce 0xffffffce 0xffffffce 0xffffffce 0xffffffce 0xffffffce 0xffffffce 0xffffffce 0xffffffce 0xffffffce 0xffffffce 0xffffffce 0xffffffce 0xffffffce 0xffffffce 0xffffffce 0xffffffce 0xffffffce 0xffffffce 0xffffffce 0xffffffce 0xffffffce 0xffffffce 0xffffffce 0xffffffce 0xffffffce 0xffffffce 0xffffffce 0xffffffce 0xffffffce 0xffffffce 0xffffffce 0xffffffce 0xffffffce 0xffffffce 0xffffffce 0xffffffce 0xffffffce 0xffffffce 0xffffffce 0xffffffce 0xffffffce 0xffffffce 0xffffffce 0xffffffce 0xffffffce 0xffffffce 0xffffffce 0xffffffce 0xffffffce 0xffffffce 0xffffffce 0xffffffce 0xffffffce 0xffffffce 0xffffffce 0xffffffce 0xffffffce 0xffffffce 0xffffffce 0xffffffce 0xffffffce 0xffffffce 0xffffffce 0xffffffce 0xffffffce 0xffffffce 0xffffffce 0xffffffce 0xffffffce 0xffffffce 0xffffffce 0xffffffce 0xffffffce 0xffffffce 0xffffffce 0xffffffce 0xffffffce 0xffffffce 0xffffffce 0xffffffce 0xffffffce 0xffffffce 0xffffffce 0xffffffce 0xffffffce 0xffffffce 0xffffffce 0xffffffce 0xffffffce 0xffffffce 0xffffffce 0xffffffce 0xffffffce 0xffffffce 0xffffffce 0xffffffce 0xffffffce 0xffffffce 0xffffffce 0xffffffce 0xffffffce 0xffffffce 0xffffffce 0xffffffce 0xffffffce 0xffffffce 0xffffffce 0xffffffce 0xffffffce>;
					PS_Config_Lmt_FW_Diff_P = <0x32 0x32 0x32 0x32 0x32 0x32 0x32 0x32 0x32 0x32 0x32 0x32 0x32 0x32 0x32 0x32 0x32 0x32 0x32 0x32 0x32 0x32 0x32 0x32 0x32 0x32 0x32 0x32 0x32 0x32 0x32 0x32 0x32 0x32 0x32 0x32 0x32 0x32 0x32 0x32 0x32 0x32 0x32 0x32 0x32 0x32 0x32 0x32 0x32 0x32 0x32 0x32 0x32 0x32 0x32 0x32 0x32 0x32 0x32 0x32 0x32 0x32 0x32 0x32 0x32 0x32 0x32 0x32 0x32 0x32 0x32 0x32 0x32 0x32 0x32 0x32 0x32 0x32 0x32 0x32 0x32 0x32 0x32 0x32 0x32 0x32 0x32 0x32 0x32 0x32 0x32 0x32 0x32 0x32 0x32 0x32 0x32 0x32 0x32 0x32 0x32 0x32 0x32 0x32 0x32 0x32 0x32 0x32 0x32 0x32 0x32 0x32 0x32 0x32 0x32 0x32 0x32 0x32 0x32 0x32 0x32 0x32 0x32 0x32 0x32 0x32 0x32 0x32 0x32 0x32 0x32 0x32 0x32 0x32 0x32 0x32 0x32 0x32 0x32 0x32 0x32 0x32 0x32 0x32 0x32 0x32 0x32 0x32 0x32 0x32 0x32 0x32 0x32 0x32 0x32 0x32 0x32 0x32 0x32 0x32 0x32 0x32 0x32 0x32 0x32 0x32 0x32 0x32 0x32 0x32 0x32 0x32 0x32 0x32 0x32 0x32 0x32 0x32 0x32 0x32 0x32 0x32 0x32 0x32 0x32 0x32 0x32 0x32 0x32 0x32 0x32 0x32 0x32 0x32 0x32 0x32 0x32 0x32 0x32 0x32 0x32 0x32 0x32 0x32 0x32 0x32 0x32 0x32 0x32 0x32 0x32 0x32 0x32 0x32 0x32 0x32 0x32 0x32 0x32 0x32 0x32 0x32 0x32 0x32 0x32 0x32 0x32 0x32 0x32 0x32 0x32 0x32 0x32 0x32 0x32 0x32 0x32 0x32 0x32 0x32 0x32 0x32 0x32 0x32 0x32 0x32 0x32 0x32 0x32 0x32 0x32 0x32 0x32 0x32 0x32 0x32 0x32 0x32 0x32 0x32 0x32 0x32 0x32 0x32 0x32 0x32 0x32 0x32 0x32 0x32 0x32 0x32 0x32 0x32 0x32 0x32 0x32 0x32 0x32 0x32 0x32 0x32 0x32 0x32 0x32 0x32 0x32 0x32 0x32 0x32 0x32 0x32 0x32 0x32 0x32 0x32 0x32 0x32 0x32 0x32 0x32 0x32 0x32 0x32 0x32 0x32 0x32 0x32 0x32 0x32 0x32 0x32 0x32 0x32 0x32 0x32 0x32 0x32 0x32 0x32 0x32 0x32 0x32 0x32 0x32 0x32 0x32 0x32 0x32 0x32 0x32 0x32 0x32 0x32 0x32 0x32 0x32 0x32 0x32 0x32 0x32 0x32 0x32 0x32 0x32 0x32 0x32 0x32 0x32 0x32 0x32 0x32 0x32 0x32 0x32 0x32 0x32 0x32 0x32 0x32 0x32 0x32 0x32 0x32 0x32 0x32 0x32 0x32 0x32 0x32 0x32 0x32 0x32 0x32 0x32 0x32 0x32 0x32 0x32 0x32 0x32 0x32 0x32 0x32 0x32 0x32 0x32 0x32 0x32 0x32 0x32 0x32 0x32 0x32 0x32 0x32 0x32 0x32 0x32 0x32 0x32 0x32 0x32 0x32 0x32 0x32 0x32 0x32 0x32 0x32 0x32 0x32 0x32 0x32 0x32 0x32 0x32 0x32 0x32 0x32 0x32 0x32 0x32 0x32 0x32 0x32 0x32 0x32 0x32 0x32 0x32 0x32 0x32 0x32 0x32 0x32 0x32 0x32 0x32 0x32 0x32 0x32 0x32 0x32 0x32 0x32 0x32 0x32 0x32 0x32 0x32 0x32 0x32 0x32 0x32 0x32 0x32 0x32 0x32 0x32 0x32 0x32 0x32 0x32 0x32 0x32 0x32 0x32 0x32 0x32 0x32 0x32 0x32 0x32 0x32 0x32 0x32 0x32 0x32 0x32 0x32 0x32 0x32 0x32 0x32 0x32 0x32 0x32 0x32 0x32 0x32 0x32 0x32 0x32 0x32 0x32 0x32 0x32 0x32 0x32 0x32 0x32 0x32 0x32 0x32 0x32 0x32 0x32 0x32 0x32 0x32 0x32 0x32 0x32 0x32 0x32 0x32 0x32 0x32 0x32 0x32 0x32 0x32 0x32 0x32 0x32 0x32 0x32 0x32 0x32 0x32 0x32 0x32 0x32 0x32 0x32 0x32 0x32 0x32 0x32 0x32 0x32 0x32 0x32 0x32 0x32 0x32 0x32 0x32 0x32 0x32 0x32 0x32 0x32 0x32 0x32 0x32 0x32 0x32 0x32 0x32 0x32 0x32 0x32 0x32 0x32 0x32 0x32 0x32 0x32 0x32 0x32 0x32 0x32 0x32 0x32 0x32 0x32 0x32 0x32 0x32 0x32 0x32 0x32 0x32 0x32 0x32 0x32 0x32 0x32 0x32 0x32 0x32 0x32 0x32 0x32 0x32 0x32 0x32 0x32 0x32 0x32 0x32 0x32 0x32 0x32 0x32 0x32 0x32 0x32 0x32 0x32 0x32 0x32 0x32 0x32 0x32 0x32 0x32 0x32 0x32 0x32 0x32 0x32 0x32 0x32 0x32 0x32 0x32 0x32 0x32 0x32 0x32 0x32 0x32 0x32 0x32 0x32 0x32 0x32 0x32 0x32 0x32 0x32 0x32 0x32 0x32 0x32>;
					PS_Config_Lmt_FW_Rawdata_N = <0x1cf 0x1d2 0x1ca 0x1cc 0x1d3 0x1d5 0x1d2 0x1cc 0x1db 0x1c9 0x1f3 0x1fa 0x1dc 0x1df 0x1e1 0x1f9 0x1f5 0x1fa 0x1d5 0x1ce 0x1d6 0x1d5 0x1da 0x1df 0x1e8 0x1e9 0x1c8 0x1c9 0x1eb 0x1eb 0x1f6 0x1ee 0x1d2 0x1d0 0x1cf 0x1cf 0x1e0 0x1cb 0x1cf 0x1c5 0x1c1 0x1c4 0x1c8 0x1d3 0x1d4 0x1d8 0x1d3 0x1d5 0x1d6 0x1d2 0x1d8 0x1d9 0x1db 0x1d5 0x1de 0x1f0 0x1f0 0x1ee 0x1ee 0x1ec 0x1ee 0x1e9 0x1cc 0x1d9 0x1d0 0x1e2 0x1df 0x1f0 0x1d0 0x1d3 0x1d5 0x1c0 0x1d8 0x1ca 0x1ca 0x1c8 0x1c7 0x1c8 0x1c6 0x1ca 0x1e1 0x1e0 0x1c6 0x1d5 0x1d7 0x1e1 0x1ca 0x1cd 0x1ce 0x1ca 0x1ca 0x1df 0x1e0 0x1f0 0x1f1 0x1f0 0x1f0 0x1ee 0x1c7 0x1d3 0x1d9 0x1e9 0x1e2 0x1ea 0x1e1 0x1cf 0x1c3 0x1c8 0x1d1 0x1c1 0x1c0 0x1c6 0x1d1 0x1cc 0x1cb 0x1c3 0x1de 0x1d1 0x1cc 0x1ef 0x1e2 0x1f0 0x1e0 0x1db 0x1d3 0x1c7 0x1ce 0x1cc 0x1d5 0x1da 0x1d9 0x1d9 0x1dd 0x1d5 0x1d0 0x1e1 0x1c1 0x1c4 0x1c4 0x1ca 0x1c1 0x1c3 0x1c7 0x1ca 0x1d3 0x1d8 0x1d9 0x1d6 0x1d3 0x1d6 0x1d6 0x1d5 0x1d5 0x1d9 0x1d0 0x1cd 0x1cb 0x1d5 0x1ca 0x1c9 0x1c6 0x1d8 0x1e2 0x1d9 0x1d6 0x1d6 0x1d1 0x1d2 0x1d6 0x1db 0x1d8 0x1d8 0x1c3 0x1ea 0x1c9 0x1f9 0x1d9 0x1d5 0x1c0 0x1bb 0x1df 0x1c4 0x1ca 0x1cc 0x1c9 0x1ca 0x1cc 0x1c5 0x1e9 0x1e3 0x1cf 0x1c4 0x1c9 0x1d0 0x1ca 0x1cd 0x1ce 0x1da 0x1d6 0x1d2 0x1d6 0x1d6 0x1d6 0x1d5 0x1cf 0x1c9 0x1dc 0x1d7 0x1d9 0x1e0 0x1d0 0x1e0 0x1d3 0x1ce 0x1d3 0x1ca 0x1db 0x1c1 0x1c3 0x1c3 0x1c3 0x1c0 0x1c0 0x1bf 0x1d6 0x1d0 0x1d7 0x1db 0x1d6 0x1da 0x1d5 0x1d5 0x1d9 0x1e1 0x1d7 0x1e5 0x1e5 0x1e4 0x1e4 0x1e7 0x1e4 0x1de 0x1de 0x1e3 0x1d5 0x1d9 0x1d6 0x1db 0x1d8 0x1d8 0x1d8 0x1d9 0x1d5 0x1db 0x1d5 0x1d4 0x1d5 0x1d6 0x1dd 0x1dd 0x1cd 0x1ea 0x1c9 0x1ec 0x1cf 0x1e7 0x1c9 0x1cd 0x1ca 0x1c9 0x1cf 0x1d7 0x1e8 0x1d9 0x1f0 0x1d9 0x1d8 0x1d7 0x1d9 0x1e1 0x1c9 0x1cc 0x1c9 0x1d3 0x1cd 0x1ce 0x1cf 0x1cf 0x1db 0x1c1 0x1cc 0x1c9 0x1df 0x1c3 0x1c1 0x1c0 0x1ce 0x1cf 0x1d8 0x1d2 0x1cc 0x1d3 0x1cf 0x1cd 0x1d0 0x1e5 0x1d6 0x1e7 0x1e6 0x1e3 0x1e5 0x1e6 0x1e9 0x1e7 0x1e9 0x1dc 0x1be 0x1d8 0x1dc 0x1d6 0x1be 0x1c0 0x1c0 0x1d3 0x1db 0x1d5 0x1d3 0x1d6 0x1d4 0x1d5 0x1d6 0x1e2 0x1e7 0x1ea 0x1e2 0x1e8 0x1e5 0x1d0 0x1ca 0x1cc 0x1c8 0x1ee 0x1cd 0x1d0 0x1c7 0x1cd 0x1d0 0x1d0 0x1d2 0x1ce 0x1e7 0x1cd 0x1c7 0x1c9 0x1cb 0x1cc 0x1d0 0x1d8 0x1da 0x1c3 0x1d8 0x1c1 0x1ce 0x1d2 0x1d1 0x1db 0x1d4 0x1e4 0x1d9 0x1dd 0x1e8 0x1e9 0x1e4 0x1df 0x1d8 0x1cc 0x1cc 0x1e8 0x1c9 0x1d6 0x1c2 0x1c8 0x1c8 0x1d4 0x1c7 0x1cf 0x1e5 0x1d2 0x1d1 0x1d0 0x1cf 0x1cd 0x1d3 0x1da 0x1e1 0x1d2 0x1d0 0x1de 0x1dc 0x1d0 0x1d0 0x1c8 0x1ce 0x1c5 0x1f4 0x1d5 0x1d1 0x1cf 0x1cb 0x1cf 0x1ce 0x1e3 0x1e5 0x1c7 0x1cd 0x1de 0x1da 0x1cb 0x1d0 0x1d0 0x1cd 0x1cb 0x1e7 0x1d2 0x1d9 0x1d8 0x1d8 0x1d8 0x1d7 0x1ce 0x1cc 0x1d3 0x1c6 0x1df 0x1de 0x1c8 0x1cb 0x1c9 0x1c6 0x1c8 0x1f2 0x1dc 0x1dc 0x1da 0x1d3 0x1d3 0x1d2 0x1cc 0x1d3 0x1d9 0x1d0 0x1d2 0x1d7 0x1d0 0x1d0 0x1d6 0x1d2 0x1d3 0x1d9 0x1e4 0x1ce 0x1cc 0x1c6 0x1c6 0x1c8 0x1c9 0x1c7 0x1ca 0x1cb 0x1c6 0x1c9 0x1c7 0x1c5 0x1cf 0x1c9 0x1df 0x1d6 0x1df 0x1ca 0x1cd 0x1d2 0x1d2 0x1d3 0x1d5 0x1d3 0x1d5 0x1ca 0x1cb 0x1cc 0x1ca 0x1cd 0x1c9 0x1c7 0x1ce 0x1e2 0x1dc 0x1d3 0x1d8 0x1d4 0x1d4 0x1d3 0x1d0 0x1cc 0x1d1 0x1d5 0x1d1 0x1d4 0x1d5 0x1d5 0x1d5 0x1d0 0x1d5 0x1e0 0x1e8 0x1cb 0x1cd 0x1cc 0x1ca 0x1ca 0x1c9 0x1ca 0x1d5 0x1cb 0x1ca 0x1ca 0x1c9 0x1c7 0x1c3 0x1c1 0x1c6 0x1de 0x1cf 0x1d7 0x1d9 0x1d8 0x1dc 0x1d6 0x1dd 0x1de 0x1d8 0x1e2 0x1d2 0x1dc 0x1e7 0x1e0 0x1e8 0x1e2 0x1e6 0x1d6 0x1d2 0x1e2 0x1e3 0x1df 0x1e1 0x1e2 0x1e2 0x1de 0x1e5 0x1c2 0x1cf 0x1d1 0x1c9 0x1d3 0x1ca 0x1cd 0x1ca 0x1de 0x1d5 0x1db 0x1df 0x1d9 0x1e3 0x1d9 0x1d5 0x1d3 0x1dc 0x1d6 0x1cd 0x1cd 0x1d1 0x1cd 0x1d0 0x1d2 0x1d7 0x1e1 0x1ea 0x1d6 0x1cd 0x1c7 0x1cd 0x1ca 0x1c4 0x1bf 0x1d5 0x1e7 0x1db 0x1df 0x1e5 0x1e0 0x1e5 0x1e7 0x1ea 0x1dc 0x1db 0x1d6 0x1d2 0x1cd 0x1cd 0x1ce 0x1ce 0x1d0 0x1d7 0x1d2 0x1c5 0x1c6 0x1c1 0x1c4 0x1c4 0x1c7 0x1d3 0x1e8 0x1e2 0x1da 0x1d3 0x1d2 0x1d1 0x1d3 0x1d4 0x1d5 0x1d6 0x1dc 0x1d5 0x1d3 0x1da 0x1d7 0x1d3 0x1d6 0x1d8 0x1da 0x1db 0x1e5 0x1e9 0x1e9 0x1dc 0x1e0 0x1da 0x1dc 0x1e4>;
					PS_Config_Lmt_FW_Rawdata_P = <0x439 0x440 0x42c 0x432 0x441 0x447 0x440 0x430 0x453 0x42b 0x48d 0x49e 0x456 0x45d 0x461 0x49b 0x491 0x49e 0x445 0x436 0x448 0x445 0x452 0x45d 0x472 0x475 0x428 0x42b 0x479 0x47b 0x492 0x482 0x440 0x43a 0x439 0x437 0x460 0x42f 0x437 0x421 0x419 0x420 0x428 0x441 0x444 0x44c 0x441 0x447 0x44a 0x43e 0x44e 0x44f 0x453 0x445 0x45c 0x486 0x484 0x480 0x480 0x47c 0x480 0x475 0x432 0x451 0x43a 0x466 0x45d 0x484 0x43a 0x443 0x447 0x416 0x44c 0x42e 0x42e 0x428 0x425 0x428 0x422 0x42c 0x463 0x460 0x424 0x447 0x44b 0x461 0x42c 0x433 0x436 0x42c 0x42c 0x45d 0x460 0x486 0x489 0x486 0x486 0x482 0x425 0x443 0x44f 0x475 0x464 0x476 0x461 0x437 0x41d 0x428 0x43d 0x417 0x414 0x422 0x43d 0x432 0x42f 0x41d 0x45c 0x43d 0x430 0x483 0x466 0x484 0x460 0x453 0x441 0x425 0x436 0x432 0x447 0x452 0x451 0x451 0x459 0x445 0x43c 0x461 0x417 0x420 0x41e 0x42e 0x419 0x41d 0x425 0x42e 0x443 0x44e 0x44f 0x448 0x443 0x44a 0x448 0x447 0x447 0x451 0x43a 0x433 0x42f 0x447 0x42e 0x42b 0x424 0x44c 0x466 0x44f 0x448 0x448 0x43d 0x440 0x448 0x453 0x44e 0x44e 0x41b 0x476 0x42b 0x499 0x451 0x445 0x416 0x409 0x45f 0x41e 0x42e 0x432 0x429 0x42c 0x432 0x421 0x475 0x467 0x439 0x41e 0x42b 0x43a 0x42e 0x433 0x436 0x452 0x44a 0x43e 0x448 0x448 0x448 0x445 0x439 0x42b 0x458 0x44b 0x451 0x460 0x43c 0x460 0x441 0x436 0x441 0x42c 0x453 0x419 0x41d 0x41d 0x41b 0x416 0x416 0x413 0x44a 0x43c 0x44b 0x455 0x44a 0x452 0x447 0x447 0x44f 0x461 0x44b 0x46d 0x46d 0x468 0x46a 0x46f 0x468 0x45c 0x45a 0x467 0x447 0x44f 0x44a 0x455 0x44e 0x44e 0x44c 0x44f 0x447 0x455 0x445 0x444 0x447 0x448 0x459 0x459 0x435 0x478 0x42b 0x47c 0x439 0x471 0x429 0x433 0x42c 0x429 0x439 0x44b 0x472 0x44f 0x486 0x44f 0x44e 0x44b 0x451 0x463 0x429 0x432 0x42b 0x441 0x435 0x436 0x437 0x439 0x455 0x417 0x432 0x42b 0x45d 0x41b 0x417 0x416 0x436 0x439 0x44c 0x440 0x432 0x441 0x437 0x435 0x43a 0x46d 0x44a 0x471 0x46e 0x467 0x46b 0x46e 0x475 0x471 0x475 0x456 0x410 0x44e 0x456 0x448 0x412 0x414 0x414 0x441 0x453 0x447 0x443 0x448 0x444 0x447 0x44a 0x464 0x46f 0x476 0x466 0x474 0x46d 0x43c 0x42c 0x430 0x428 0x482 0x433 0x43a 0x427 0x433 0x43a 0x43c 0x43e 0x436 0x46f 0x435 0x425 0x42b 0x42f 0x432 0x43a 0x44c 0x452 0x41d 0x44c 0x419 0x436 0x43e 0x43d 0x453 0x444 0x46a 0x451 0x459 0x474 0x475 0x46a 0x45d 0x44e 0x432 0x430 0x474 0x42b 0x448 0x41a 0x428 0x428 0x444 0x427 0x437 0x46b 0x43e 0x43d 0x43a 0x439 0x433 0x441 0x452 0x463 0x440 0x43c 0x45c 0x456 0x43a 0x43c 0x428 0x436 0x421 0x490 0x445 0x43d 0x439 0x42f 0x437 0x436 0x467 0x46d 0x427 0x435 0x45a 0x452 0x42f 0x43a 0x43c 0x435 0x42f 0x471 0x43e 0x44f 0x44c 0x44c 0x44c 0x44b 0x436 0x430 0x441 0x422 0x45d 0x45a 0x428 0x42f 0x429 0x422 0x428 0x48a 0x456 0x456 0x452 0x441 0x441 0x43e 0x432 0x441 0x451 0x43a 0x43e 0x44b 0x43a 0x43a 0x44a 0x440 0x441 0x451 0x468 0x436 0x430 0x424 0x422 0x428 0x42b 0x427 0x42e 0x42f 0x424 0x42b 0x427 0x421 0x437 0x429 0x45d 0x44a 0x45f 0x42e 0x433 0x440 0x43e 0x441 0x447 0x443 0x447 0x42c 0x42f 0x432 0x42e 0x433 0x42b 0x427 0x436 0x464 0x458 0x441 0x44c 0x444 0x444 0x443 0x43c 0x430 0x43d 0x447 0x43d 0x444 0x447 0x445 0x447 0x43a 0x445 0x460 0x472 0x42f 0x433 0x432 0x42e 0x42e 0x42b 0x42c 0x445 0x42f 0x42c 0x42e 0x429 0x427 0x41b 0x417 0x422 0x45c 0x437 0x44b 0x451 0x44c 0x456 0x448 0x459 0x45a 0x44e 0x466 0x43e 0x458 0x46f 0x460 0x474 0x466 0x46e 0x44a 0x440 0x464 0x467 0x45d 0x461 0x464 0x466 0x45c 0x46b 0x41a 0x439 0x43d 0x429 0x441 0x42c 0x435 0x42e 0x45a 0x445 0x453 0x45d 0x451 0x467 0x451 0x447 0x441 0x458 0x448 0x435 0x435 0x43d 0x435 0x43a 0x440 0x44b 0x461 0x476 0x44a 0x433 0x427 0x433 0x42e 0x41e 0x413 0x445 0x471 0x455 0x45f 0x46d 0x460 0x46d 0x46f 0x478 0x456 0x453 0x448 0x43e 0x433 0x435 0x436 0x436 0x43a 0x44b 0x440 0x421 0x422 0x417 0x41e 0x420 0x425 0x441 0x472 0x464 0x452 0x443 0x440 0x43d 0x443 0x444 0x447 0x448 0x456 0x447 0x441 0x452 0x44b 0x441 0x44a 0x44e 0x452 0x453 0x46b 0x475 0x475 0x456 0x460 0x452 0x456 0x46a>;
					PS_Config_Lmt_Open_Rawdata_N = <0x532 0x547 0x54d 0x542 0x535 0x52f 0x536 0x523 0x550 0x51d 0x504 0x518 0x51c 0x524 0x539 0x544 0x537 0x520 0x54a 0x55c 0x562 0x54d 0x53b 0x530 0x537 0x524 0x527 0x515 0x516 0x522 0x520 0x530 0x544 0x55c 0x552 0x540 0x554 0x55f 0x566 0x553 0x53e 0x535 0x540 0x535 0x532 0x522 0x526 0x523 0x526 0x52a 0x53f 0x54e 0x54e 0x539 0x558 0x565 0x566 0x551 0x53f 0x536 0x541 0x534 0x52f 0x52a 0x52b 0x529 0x531 0x534 0x54d 0x55a 0x55e 0x547 0x54b 0x55e 0x557 0x542 0x530 0x52c 0x531 0x527 0x528 0x522 0x525 0x527 0x530 0x532 0x54a 0x55d 0x562 0x551 0x55f 0x571 0x564 0x551 0x53c 0x533 0x53e 0x533 0x532 0x524 0x527 0x529 0x537 0x536 0x54d 0x562 0x565 0x556 0x562 0x56f 0x559 0x54d 0x536 0x52a 0x539 0x52e 0x52c 0x51d 0x521 0x51e 0x526 0x52f 0x545 0x555 0x565 0x556 0x571 0x581 0x568 0x559 0x545 0x53a 0x545 0x53b 0x53b 0x529 0x52a 0x528 0x532 0x53d 0x550 0x560 0x573 0x563 0x56e 0x575 0x564 0x54a 0x53d 0x52e 0x53a 0x52d 0x52f 0x521 0x51f 0x51b 0x52b 0x530 0x547 0x558 0x56c 0x562 0x572 0x579 0x566 0x54e 0x541 0x530 0x53e 0x533 0x52c 0x529 0x527 0x522 0x535 0x539 0x553 0x560 0x577 0x56e 0x575 0x57b 0x562 0x54b 0x53d 0x534 0x536 0x52e 0x524 0x526 0x528 0x525 0x533 0x53a 0x550 0x562 0x571 0x575 0x57d 0x580 0x568 0x551 0x541 0x534 0x539 0x52d 0x520 0x517 0x512 0x51b 0x529 0x530 0x546 0x55a 0x568 0x574 0x581 0x57b 0x563 0x54f 0x53d 0x52d 0x536 0x529 0x51d 0x520 0x518 0x524 0x534 0x53c 0x550 0x55f 0x571 0x580 0x58a 0x582 0x569 0x550 0x547 0x536 0x53c 0x52f 0x527 0x520 0x515 0x51e 0x532 0x53e 0x551 0x563 0x574 0x587 0x584 0x573 0x562 0x547 0x538 0x52b 0x535 0x526 0x51d 0x517 0x50c 0x515 0x52f 0x530 0x548 0x560 0x571 0x589 0x584 0x572 0x55f 0x547 0x539 0x52f 0x535 0x52c 0x523 0x517 0x514 0x519 0x52c 0x52d 0x546 0x562 0x578 0x58d 0x57a 0x561 0x54e 0x539 0x528 0x520 0x525 0x521 0x518 0x512 0x50e 0x518 0x523 0x524 0x53f 0x55a 0x571 0x597 0x59a 0x565 0x559 0x543 0x52f 0x528 0x52f 0x527 0x523 0x50a 0x508 0x517 0x51b 0x51b 0x535 0x553 0x56c 0x592 0x585 0x595 0x59c 0x5b4 0x5e0 0x5dd 0x5d4 0x5cb 0x5c9 0x5d5 0x5d1 0x5db 0x5cf 0x5da 0x5a5 0x58f 0x56f 0x575 0x599 0x5a7 0x5b4 0x5cb 0x5f5 0x5f2 0x5e4 0x5da 0x5dc 0x5d2 0x5d2 0x5db 0x5ce 0x5de 0x5a7 0x590 0x578 0x566 0x590 0x59c 0x5b3 0x5c8 0x5ee 0x5e4 0x5d6 0x5cc 0x5cf 0x5c3 0x5ca 0x5cf 0x5c9 0x5d6 0x5a5 0x58d 0x57d 0x562 0x583 0x58e 0x5a6 0x5be 0x5e1 0x5de 0x5c5 0x5b8 0x5c1 0x5bb 0x5c3 0x5cb 0x5c0 0x5cf 0x5a5 0x58b 0x57e 0x562 0x58f 0x59c 0x5b7 0x5cd 0x5ed 0x5ea 0x5c9 0x5c3 0x5c8 0x5b9 0x5bd 0x5cb 0x5c6 0x5d2 0x5a5 0x596 0x581 0x56a 0x58f 0x599 0x5b1 0x5cc 0x5ea 0x5e6 0x5cf 0x5c2 0x5c3 0x5ad 0x5b7 0x5c5 0x5c2 0x5c9 0x5aa 0x597 0x583 0x56b 0x57e 0x58e 0x59f 0x5c0 0x5d1 0x5cb 0x5b6 0x5b4 0x5b0 0x5aa 0x5af 0x5bf 0x5b4 0x5c6 0x5a9 0x595 0x581 0x56c 0x58a 0x598 0x5ae 0x5cf 0x5db 0x5d7 0x5c2 0x5c8 0x5c0 0x5aa 0x5ad 0x5bc 0x5b0 0x5c0 0x5a2 0x590 0x57b 0x568 0x580 0x586 0x59f 0x5ba 0x5c5 0x5ba 0x5ae 0x5a8 0x5aa 0x5a7 0x5ae 0x5b2 0x5a8 0x5b2 0x5a3 0x589 0x57a 0x562 0x586 0x591 0x5aa 0x5c2 0x5cc 0x5c2 0x5b6 0x5b6 0x5b4 0x5aa 0x5ab 0x5ae 0x5aa 0x5b1 0x5a7 0x58c 0x57f 0x565 0x571 0x57e 0x59b 0x5af 0x5b1 0x5ae 0x59c 0x59e 0x595 0x59b 0x599 0x5a2 0x59a 0x59e 0x59d 0x584 0x574 0x55e 0x573 0x57f 0x598 0x5b1 0x5ac 0x5a7 0x59a 0x59a 0x58e 0x594 0x597 0x5a2 0x59a 0x59d 0x5a2 0x58a 0x577 0x565 0x575 0x582 0x592 0x5b3 0x5a9 0x5a2 0x597 0x597 0x58d 0x593 0x593 0x59f 0x58f 0x59a 0x5a5 0x587 0x57b 0x565 0x571 0x581 0x592 0x5b1 0x5a2 0x599 0x593 0x591 0x587 0x584 0x581 0x58c 0x580 0x589 0x596 0x57a 0x569 0x555 0x565 0x571 0x588 0x5a3 0x58f 0x584 0x584 0x57f 0x57a 0x571 0x578 0x580 0x579 0x57d 0x591 0x576 0x568 0x550 0x541 0x578 0x58d 0x5a7 0x596 0x58c 0x58d 0x588 0x580 0x57d 0x588 0x58c 0x586 0x58b 0x5a4 0x585 0x57b 0x539 0x54b 0x588 0x59b 0x5ab 0x598 0x595 0x593 0x590 0x582 0x56e 0x578 0x581 0x579 0x57b 0x590 0x582 0x56e 0x533 0x530 0x571 0x585 0x595 0x57e 0x57d 0x582 0x578 0x56b 0x567 0x571 0x57e 0x574 0x577 0x58f 0x583 0x56c 0x52a>;
					PS_Config_Lmt_Open_Rawdata_P = <0xc20 0xc4f 0xc5d 0xc44 0xc27 0xc19 0xc2a 0xbfb 0xc64 0xbed 0xbb4 0xbe4 0xbec 0xbfe 0xc31 0xc4a 0xc2b 0xbf6 0xc58 0xc80 0xc90 0xc5f 0xc33 0xc1c 0xc2b 0xc00 0xc05 0xbdb 0xbde 0xbfa 0xbf6 0xc1c 0xc48 0xc80 0xc6a 0xc40 0xc70 0xc89 0xc9a 0xc6d 0xc3a 0xc27 0xc40 0xc25 0xc1e 0xbfa 0xc02 0xbfd 0xc04 0xc0e 0xc3f 0xc62 0xc62 0xc31 0xc78 0xc97 0xc98 0xc67 0xc3f 0xc2a 0xc43 0xc24 0xc19 0xc0c 0xc0f 0xc09 0xc1d 0xc24 0xc5f 0xc7e 0xc86 0xc51 0xc5b 0xc86 0xc75 0xc46 0xc1a 0xc12 0xc1d 0xc05 0xc08 0xbfa 0xc01 0xc07 0xc1a 0xc1e 0xc58 0xc83 0xc90 0xc67 0xc87 0xcb1 0xc94 0xc67 0xc38 0xc23 0xc3c 0xc23 0xc1e 0xc00 0xc05 0xc09 0xc2b 0xc2a 0xc5f 0xc8e 0xc97 0xc74 0xc90 0xcaf 0xc7b 0xc5d 0xc2a 0xc0c 0xc2f 0xc16 0xc12 0xbef 0xbf7 0xbf0 0xc02 0xc17 0xc4d 0xc71 0xc97 0xc72 0xcb1 0xcd9 0xc9e 0xc7b 0xc4b 0xc32 0xc4b 0xc35 0xc35 0xc09 0xc0c 0xc08 0xc1e 0xc39 0xc66 0xc8c 0xcb7 0xc93 0xcaa 0xcbd 0xc94 0xc56 0xc39 0xc16 0xc32 0xc15 0xc17 0xbf7 0xbf3 0xbe9 0xc0f 0xc1c 0xc4f 0xc78 0xca6 0xc8e 0xcb4 0xcc5 0xc9a 0xc60 0xc41 0xc1c 0xc3a 0xc21 0xc12 0xc0b 0xc05 0xbfa 0xc27 0xc31 0xc6d 0xc8c 0xcbf 0xcaa 0xcbb 0xccb 0xc8e 0xc59 0xc39 0xc24 0xc2a 0xc16 0xc00 0xc04 0xc08 0xc01 0xc23 0xc32 0xc64 0xc90 0xcb3 0xcbd 0xccd 0xcd4 0xc9c 0xc69 0xc43 0xc24 0xc2f 0xc13 0xbf6 0xbdf 0xbd6 0xbeb 0xc0b 0xc1a 0xc4e 0xc7e 0xc9c 0xcb8 0xcd7 0xccb 0xc91 0xc63 0xc39 0xc15 0xc2a 0xc09 0xbed 0xbf6 0xbe4 0xbfe 0xc24 0xc36 0xc66 0xc87 0xcb1 0xcd4 0xcee 0xcda 0xca1 0xc66 0xc51 0xc28 0xc38 0xc17 0xc05 0xbf4 0xbdb 0xbf2 0xc20 0xc3a 0xc67 0xc91 0xcb8 0xce7 0xcde 0xcb7 0xc8e 0xc4f 0xc2e 0xc0f 0xc25 0xc04 0xbef 0xbdf 0xbc8 0xbdb 0xc17 0xc1a 0xc52 0xc8a 0xcb1 0xce9 0xce0 0xcb6 0xc89 0xc51 0xc2f 0xc17 0xc25 0xc10 0xbfd 0xbdf 0xbda 0xbe5 0xc12 0xc15 0xc4e 0xc90 0xcc2 0xcf3 0xcc8 0xc8d 0xc60 0xc31 0xc08 0xbf4 0xc01 0xbf7 0xbe4 0xbd6 0xbca 0xbe4 0xbfd 0xbfe 0xc3f 0xc7c 0xcb3 0xd0b 0xd12 0xc97 0xc79 0xc47 0xc19 0xc08 0xc19 0xc05 0xbfb 0xbc2 0xbbe 0xbdf 0xbe9 0xbeb 0xc27 0xc6b 0xca8 0xd00 0xce1 0xd07 0xd16 0xd50 0xdb4 0xdad 0xd9a 0xd83 0xd81 0xd9b 0xd93 0xdab 0xd8f 0xda8 0xd2b 0xcf7 0xcaf 0xcbd 0xd11 0xd31 0xd4e 0xd85 0xde5 0xdde 0xdc0 0xda8 0xdac 0xd96 0xd96 0xdab 0xd8c 0xdb2 0xd31 0xcfc 0xcc2 0xc9a 0xcfc 0xd18 0xd4b 0xd7c 0xdd6 0xdc0 0xd9e 0xd88 0xd8f 0xd73 0xd82 0xd8f 0xd81 0xd9e 0xd2b 0xcf3 0xccd 0xc8e 0xcdd 0xcf6 0xd2e 0xd66 0xdb9 0xdb0 0xd77 0xd58 0xd6d 0xd5f 0xd71 0xd83 0xd6c 0xd8f 0xd2b 0xcef 0xcd0 0xc8e 0xcf9 0xd18 0xd55 0xd89 0xdd5 0xdce 0xd81 0xd71 0xd7c 0xd5b 0xd65 0xd83 0xd7a 0xd94 0xd2b 0xd08 0xcd9 0xca2 0xcf9 0xd0f 0xd49 0xd88 0xdce 0xdc2 0xd8f 0xd70 0xd71 0xd3f 0xd57 0xd77 0xd70 0xd81 0xd38 0xd0b 0xcdd 0xca5 0xcd2 0xcf6 0xd1d 0xd6c 0xd93 0xd85 0xd54 0xd4e 0xd46 0xd36 0xd43 0xd69 0xd50 0xd7a 0xd35 0xd05 0xcd7 0xca6 0xcec 0xd0e 0xd40 0xd8d 0xdab 0xd9f 0xd70 0xd7c 0xd6a 0xd38 0xd3f 0xd62 0xd44 0xd6a 0xd26 0xcfa 0xccb 0xc9c 0xcd4 0xce2 0xd1d 0xd5c 0xd75 0xd5c 0xd40 0xd34 0xd36 0xd2f 0xd40 0xd4a 0xd32 0xd4a 0xd27 0xceb 0xcc8 0xc8e 0xce4 0xcfd 0xd38 0xd6e 0xd88 0xd70 0xd52 0xd52 0xd4e 0xd36 0xd3b 0xd42 0xd36 0xd49 0xd2f 0xcf2 0xcd3 0xc97 0xcb1 0xcd0 0xd13 0xd43 0xd49 0xd40 0xd18 0xd1a 0xd05 0xd13 0xd11 0xd24 0xd12 0xd1c 0xd19 0xce0 0xcba 0xc86 0xcb7 0xcd3 0xd0c 0xd49 0xd3c 0xd2f 0xd12 0xd12 0xcf6 0xd04 0xd0b 0xd24 0xd12 0xd19 0xd24 0xcee 0xcc1 0xc95 0xcbb 0xcda 0xd00 0xd4d 0xd35 0xd24 0xd0b 0xd0b 0xcf3 0xd01 0xd03 0xd1d 0xcf7 0xd12 0xd2d 0xce7 0xcc9 0xc97 0xcb3 0xcd9 0xcfe 0xd47 0xd26 0xd0f 0xd01 0xcfd 0xce5 0xce0 0xcd7 0xcf2 0xcd6 0xceb 0xd0a 0xcc6 0xc9f 0xc71 0xc97 0xcb3 0xce8 0xd27 0xcf9 0xcde 0xce0 0xcd3 0xcc6 0xcb1 0xcc4 0xcd4 0xcc5 0xccf 0xcfd 0xcbe 0xc9e 0xc64 0xc43 0xcc2 0xcf3 0xd2f 0xd0a 0xcf2 0xcf5 0xce8 0xcd6 0xccf 0xce8 0xcf0 0xce4 0xcef 0xd2a 0xce1 0xcc9 0xc31 0xc5b 0xce8 0xd15 0xd39 0xd0c 0xd05 0xd03 0xcfa 0xcda 0xcaa 0xcc2 0xcd9 0xcc5 0xccb 0xcfa 0xcda 0xcac 0xc21 0xc1c 0xcb1 0xce1 0xd07 0xcd2 0xccf 0xcda 0xcc2 0xca5 0xc9b 0xcb1 0xcd0 0xcb8 0xcc1 0xcf9 0xcdb 0xca6 0xc0e>;
					PS_Config_Lmt_Short_Rawdata_N = <0x2774 0x2774 0x2774 0x2774 0x2774 0x2774 0x2774 0x2774 0x2774 0x2774 0x2774 0x2774 0x2774 0x2774 0x2774 0x2774 0x2774 0x2774 0x2774 0x2774 0x2774 0x2774 0x2774 0x2774 0x2774 0x2774 0x2774 0x2774 0x2774 0x2774 0x2774 0x2774 0x2774 0x2774 0x2774 0x2774 0x2774 0x2774 0x2774 0x2774 0x2774 0x2774 0x2774 0x2774 0x2774 0x2774 0x2774 0x2774 0x2774 0x2774 0x2774 0x2774 0x2774 0x2774 0x2774 0x2774 0x2774 0x2774 0x2774 0x2774 0x2774 0x2774 0x2774 0x2774 0x2774 0x2774 0x2774 0x2774 0x2774 0x2774 0x2774 0x2774 0x2774 0x2774 0x2774 0x2774 0x2774 0x2774 0x2774 0x2774 0x2774 0x2774 0x2774 0x2774 0x2774 0x2774 0x2774 0x2774 0x2774 0x2774 0x2774 0x2774 0x2774 0x2774 0x2774 0x2774 0x2774 0x2774 0x2774 0x2774 0x2774 0x2774 0x2774 0x2774 0x2774 0x2774 0x2774 0x2774 0x2774 0x2774 0x2774 0x2774 0x2774 0x2774 0x2774 0x2774 0x2774 0x2774 0x2774 0x2774 0x2774 0x2774 0x2774 0x2774 0x2774 0x2774 0x2774 0x2774 0x2774 0x2774 0x2774 0x2774 0x2774 0x2774 0x2774 0x2774 0x2774 0x2774 0x2774 0x2774 0x2774 0x2774 0x2774 0x2774 0x2774 0x2774 0x2774 0x2774 0x2774 0x2774 0x2774 0x2774 0x2774 0x2774 0x2774 0x2774 0x2774 0x2774 0x2774 0x2774 0x2774 0x2774 0x2774 0x2774 0x2774 0x2774 0x2774 0x2774 0x2774 0x2774 0x2774 0x2774 0x2774 0x2774 0x2774 0x2774 0x2774 0x2774 0x2774 0x2774 0x2774 0x2774 0x2774 0x2774 0x2774 0x2774 0x2774 0x2774 0x2774 0x2774 0x2774 0x2774 0x2774 0x2774 0x2774 0x2774 0x2774 0x2774 0x2774 0x2774 0x2774 0x2774 0x2774 0x2774 0x2774 0x2774 0x2774 0x2774 0x2774 0x2774 0x2774 0x2774 0x2774 0x2774 0x2774 0x2774 0x2774 0x2774 0x2774 0x2774 0x2774 0x2774 0x2774 0x2774 0x2774 0x2774 0x2774 0x2774 0x2774 0x2774 0x2774 0x2774 0x2774 0x2774 0x2774 0x2774 0x2774 0x2774 0x2774 0x2774 0x2774 0x2774 0x2774 0x2774 0x2774 0x2774 0x2774 0x2774 0x2774 0x2774 0x2774 0x2774 0x2774 0x2774 0x2774 0x2774 0x2774 0x2774 0x2774 0x2774 0x2774 0x2774 0x2774 0x2774 0x2774 0x2774 0x2774 0x2774 0x2774 0x2774 0x2774 0x2774 0x2774 0x2774 0x2774 0x2774 0x2774 0x2774 0x2774 0x2774 0x2774 0x2774 0x2774 0x2774 0x2774 0x2774 0x2774 0x2774 0x2774 0x2774 0x2774 0x2774 0x2774 0x2774 0x2774 0x2774 0x2774 0x2774 0x2774 0x2774 0x2774 0x2774 0x2774 0x2774 0x2774 0x2774 0x2774 0x2774 0x2774 0x2774 0x2774 0x2774 0x2774 0x2774 0x2774 0x2774 0x2774 0x2774 0x2774 0x2774 0x2774 0x2774 0x2774 0x2774 0x2774 0x2774 0x2774 0x2774 0x2774 0x2774 0x2774 0x2774 0x2774 0x2774 0x2774 0x2774 0x2774 0x2774 0x2774 0x2774 0x2774 0x2774 0x2774 0x2774 0x2774 0x2774 0x2774 0x2774 0x2774 0x2774 0x2774 0x2774 0x2774 0x2774 0x2774 0x2774 0x2774 0x2774 0x2774 0x2774 0x2774 0x2774 0x2774 0x2774 0x2774 0x2774 0x2774 0x2774 0x2774 0x2774 0x2774 0x2774 0x2774 0x2774 0x2774 0x2774 0x2774 0x2774 0x2774 0x2774 0x2774 0x2774 0x2774 0x2774 0x2774 0x2774 0x2774 0x2774 0x2774 0x2774 0x2774 0x2774 0x2774 0x2774 0x2774 0x2774 0x2774 0x2774 0x2774 0x2774 0x2774 0x2774 0x2774 0x2774 0x2774 0x2774 0x2774 0x2774 0x2774 0x2774 0x2774 0x2774 0x2774 0x2774 0x2774 0x2774 0x2774 0x2774 0x2774 0x2774 0x2774 0x2774 0x2774 0x2774 0x2774 0x2774 0x2774 0x2774 0x2774 0x2774 0x2774 0x2774 0x2774 0x2774 0x2774 0x2774 0x2774 0x2774 0x2774 0x2774 0x2774 0x2774 0x2774 0x2774 0x2774 0x2774 0x2774 0x2774 0x2774 0x2774 0x2774 0x2774 0x2774 0x2774 0x2774 0x2774 0x2774 0x2774 0x2774 0x2774 0x2774 0x2774 0x2774 0x2774 0x2774 0x2774 0x2774 0x2774 0x2774 0x2774 0x2774 0x2774 0x2774 0x2774 0x2774 0x2774 0x2774 0x2774 0x2774 0x2774 0x2774 0x2774 0x2774 0x2774 0x2774 0x2774 0x2774 0x2774 0x2774 0x2774 0x2774 0x2774 0x2774 0x2774 0x2774 0x2774 0x2774 0x2774 0x2774 0x2774 0x2774 0x2774 0x2774 0x2774 0x2774 0x2774 0x2774 0x2774 0x2774 0x2774 0x2774 0x2774 0x2774 0x2774 0x2774 0x2774 0x2774 0x2774 0x2774 0x2774 0x2774 0x2774 0x2774 0x2774 0x2774 0x2774 0x2774 0x2774 0x2774 0x2774 0x2774 0x2774 0x2774 0x2774 0x2774 0x2774 0x2774 0x2774 0x2774 0x2774 0x2774 0x2774 0x2774 0x2774 0x2774 0x2774 0x2774 0x2774 0x2774 0x2774 0x2774 0x2774 0x2774 0x2774 0x2774 0x2774 0x2774 0x2774 0x2774 0x2774 0x2774 0x2774 0x2774 0x2774 0x2774 0x2774 0x2774 0x2774 0x2774 0x2774 0x2774 0x2774 0x2774 0x2774 0x2774 0x2774 0x2774 0x2774 0x2774 0x2774 0x2774 0x2774 0x2774 0x2774 0x2774 0x2774 0x2774 0x2774 0x2774 0x2774 0x2774 0x2774 0x2774 0x2774 0x2774 0x2774 0x2774 0x2774 0x2774 0x2774 0x2774 0x2774 0x2774 0x2774 0x2774 0x2774 0x2774 0x2774 0x2774 0x2774 0x2774 0x2774 0x2774 0x2774 0x2774 0x2774 0x2774 0x2774 0x2774 0x2774 0x2774 0x2774 0x2774 0x2774 0x2774 0x2774 0x2774 0x2774 0x2774 0x2774 0x2774 0x2774 0x2774 0x2774 0x2774 0x2774 0x2774 0x2774 0x2774 0x2774 0x2774 0x2774 0x2774 0x2774 0x2774 0x2774 0x2774 0x2774>;
					PS_Config_Lmt_Short_Rawdata_P = <0x36b8 0x36b8 0x36b8 0x36b8 0x36b8 0x36b8 0x36b8 0x36b8 0x36b8 0x36b8 0x36b8 0x36b8 0x36b8 0x36b8 0x36b8 0x36b8 0x36b8 0x36b8 0x36b8 0x36b8 0x36b8 0x36b8 0x36b8 0x36b8 0x36b8 0x36b8 0x36b8 0x36b8 0x36b8 0x36b8 0x36b8 0x36b8 0x36b8 0x36b8 0x36b8 0x36b8 0x36b8 0x36b8 0x36b8 0x36b8 0x36b8 0x36b8 0x36b8 0x36b8 0x36b8 0x36b8 0x36b8 0x36b8 0x36b8 0x36b8 0x36b8 0x36b8 0x36b8 0x36b8 0x36b8 0x36b8 0x36b8 0x36b8 0x36b8 0x36b8 0x36b8 0x36b8 0x36b8 0x36b8 0x36b8 0x36b8 0x36b8 0x36b8 0x36b8 0x36b8 0x36b8 0x36b8 0x36b8 0x36b8 0x36b8 0x36b8 0x36b8 0x36b8 0x36b8 0x36b8 0x36b8 0x36b8 0x36b8 0x36b8 0x36b8 0x36b8 0x36b8 0x36b8 0x36b8 0x36b8 0x36b8 0x36b8 0x36b8 0x36b8 0x36b8 0x36b8 0x36b8 0x36b8 0x36b8 0x36b8 0x36b8 0x36b8 0x36b8 0x36b8 0x36b8 0x36b8 0x36b8 0x36b8 0x36b8 0x36b8 0x36b8 0x36b8 0x36b8 0x36b8 0x36b8 0x36b8 0x36b8 0x36b8 0x36b8 0x36b8 0x36b8 0x36b8 0x36b8 0x36b8 0x36b8 0x36b8 0x36b8 0x36b8 0x36b8 0x36b8 0x36b8 0x36b8 0x36b8 0x36b8 0x36b8 0x36b8 0x36b8 0x36b8 0x36b8 0x36b8 0x36b8 0x36b8 0x36b8 0x36b8 0x36b8 0x36b8 0x36b8 0x36b8 0x36b8 0x36b8 0x36b8 0x36b8 0x36b8 0x36b8 0x36b8 0x36b8 0x36b8 0x36b8 0x36b8 0x36b8 0x36b8 0x36b8 0x36b8 0x36b8 0x36b8 0x36b8 0x36b8 0x36b8 0x36b8 0x36b8 0x36b8 0x36b8 0x36b8 0x36b8 0x36b8 0x36b8 0x36b8 0x36b8 0x36b8 0x36b8 0x36b8 0x36b8 0x36b8 0x36b8 0x36b8 0x36b8 0x36b8 0x36b8 0x36b8 0x36b8 0x36b8 0x36b8 0x36b8 0x36b8 0x36b8 0x36b8 0x36b8 0x36b8 0x36b8 0x36b8 0x36b8 0x36b8 0x36b8 0x36b8 0x36b8 0x36b8 0x36b8 0x36b8 0x36b8 0x36b8 0x36b8 0x36b8 0x36b8 0x36b8 0x36b8 0x36b8 0x36b8 0x36b8 0x36b8 0x36b8 0x36b8 0x36b8 0x36b8 0x36b8 0x36b8 0x36b8 0x36b8 0x36b8 0x36b8 0x36b8 0x36b8 0x36b8 0x36b8 0x36b8 0x36b8 0x36b8 0x36b8 0x36b8 0x36b8 0x36b8 0x36b8 0x36b8 0x36b8 0x36b8 0x36b8 0x36b8 0x36b8 0x36b8 0x36b8 0x36b8 0x36b8 0x36b8 0x36b8 0x36b8 0x36b8 0x36b8 0x36b8 0x36b8 0x36b8 0x36b8 0x36b8 0x36b8 0x36b8 0x36b8 0x36b8 0x36b8 0x36b8 0x36b8 0x36b8 0x36b8 0x36b8 0x36b8 0x36b8 0x36b8 0x36b8 0x36b8 0x36b8 0x36b8 0x36b8 0x36b8 0x36b8 0x36b8 0x36b8 0x36b8 0x36b8 0x36b8 0x36b8 0x36b8 0x36b8 0x36b8 0x36b8 0x36b8 0x36b8 0x36b8 0x36b8 0x36b8 0x36b8 0x36b8 0x36b8 0x36b8 0x36b8 0x36b8 0x36b8 0x36b8 0x36b8 0x36b8 0x36b8 0x36b8 0x36b8 0x36b8 0x36b8 0x36b8 0x36b8 0x36b8 0x36b8 0x36b8 0x36b8 0x36b8 0x36b8 0x36b8 0x36b8 0x36b8 0x36b8 0x36b8 0x36b8 0x36b8 0x36b8 0x36b8 0x36b8 0x36b8 0x36b8 0x36b8 0x36b8 0x36b8 0x36b8 0x36b8 0x36b8 0x36b8 0x36b8 0x36b8 0x36b8 0x36b8 0x36b8 0x36b8 0x36b8 0x36b8 0x36b8 0x36b8 0x36b8 0x36b8 0x36b8 0x36b8 0x36b8 0x36b8 0x36b8 0x36b8 0x36b8 0x36b8 0x36b8 0x36b8 0x36b8 0x36b8 0x36b8 0x36b8 0x36b8 0x36b8 0x36b8 0x36b8 0x36b8 0x36b8 0x36b8 0x36b8 0x36b8 0x36b8 0x36b8 0x36b8 0x36b8 0x36b8 0x36b8 0x36b8 0x36b8 0x36b8 0x36b8 0x36b8 0x36b8 0x36b8 0x36b8 0x36b8 0x36b8 0x36b8 0x36b8 0x36b8 0x36b8 0x36b8 0x36b8 0x36b8 0x36b8 0x36b8 0x36b8 0x36b8 0x36b8 0x36b8 0x36b8 0x36b8 0x36b8 0x36b8 0x36b8 0x36b8 0x36b8 0x36b8 0x36b8 0x36b8 0x36b8 0x36b8 0x36b8 0x36b8 0x36b8 0x36b8 0x36b8 0x36b8 0x36b8 0x36b8 0x36b8 0x36b8 0x36b8 0x36b8 0x36b8 0x36b8 0x36b8 0x36b8 0x36b8 0x36b8 0x36b8 0x36b8 0x36b8 0x36b8 0x36b8 0x36b8 0x36b8 0x36b8 0x36b8 0x36b8 0x36b8 0x36b8 0x36b8 0x36b8 0x36b8 0x36b8 0x36b8 0x36b8 0x36b8 0x36b8 0x36b8 0x36b8 0x36b8 0x36b8 0x36b8 0x36b8 0x36b8 0x36b8 0x36b8 0x36b8 0x36b8 0x36b8 0x36b8 0x36b8 0x36b8 0x36b8 0x36b8 0x36b8 0x36b8 0x36b8 0x36b8 0x36b8 0x36b8 0x36b8 0x36b8 0x36b8 0x36b8 0x36b8 0x36b8 0x36b8 0x36b8 0x36b8 0x36b8 0x36b8 0x36b8 0x36b8 0x36b8 0x36b8 0x36b8 0x36b8 0x36b8 0x36b8 0x36b8 0x36b8 0x36b8 0x36b8 0x36b8 0x36b8 0x36b8 0x36b8 0x36b8 0x36b8 0x36b8 0x36b8 0x36b8 0x36b8 0x36b8 0x36b8 0x36b8 0x36b8 0x36b8 0x36b8 0x36b8 0x36b8 0x36b8 0x36b8 0x36b8 0x36b8 0x36b8 0x36b8 0x36b8 0x36b8 0x36b8 0x36b8 0x36b8 0x36b8 0x36b8 0x36b8 0x36b8 0x36b8 0x36b8 0x36b8 0x36b8 0x36b8 0x36b8 0x36b8 0x36b8 0x36b8 0x36b8 0x36b8 0x36b8 0x36b8 0x36b8 0x36b8 0x36b8 0x36b8 0x36b8 0x36b8 0x36b8 0x36b8 0x36b8 0x36b8 0x36b8 0x36b8 0x36b8 0x36b8 0x36b8 0x36b8 0x36b8 0x36b8 0x36b8 0x36b8 0x36b8 0x36b8 0x36b8 0x36b8 0x36b8 0x36b8 0x36b8 0x36b8 0x36b8 0x36b8 0x36b8 0x36b8 0x36b8 0x36b8 0x36b8 0x36b8 0x36b8 0x36b8 0x36b8 0x36b8 0x36b8 0x36b8 0x36b8 0x36b8 0x36b8 0x36b8 0x36b8 0x36b8 0x36b8 0x36b8 0x36b8 0x36b8 0x36b8 0x36b8 0x36b8 0x36b8 0x36b8 0x36b8 0x36b8 0x36b8 0x36b8 0x36b8 0x36b8 0x36b8 0x36b8 0x36b8 0x36b8 0x36b8 0x36b8 0x36b8 0x36b8 0x36b8 0x36b8 0x36b8 0x36b8 0x36b8 0x36b8 0x36b8 0x36b8 0x36b8 0x36b8 0x36b8 0x36b8 0x36b8 0x36b8 0x36b8 0x36b8 0x36b8 0x36b8 0x36b8 0x36b8 0x36b8 0x36b8 0x36b8 0x36b8 0x36b8 0x36b8 0x36b8 0x36b8 0x36b8 0x36b8 0x36b8 0x36b8 0x36b8 0x36b8 0x36b8 0x36b8>;
					X_Channel = <0x12>;
					Y_Channel = <0x24>;
					compatible = "novatek-mp-criteria-6256";
				};

				novatek-mp-criteria-625B@0 {
					#address-cells = <0x1>;
					#size-cells = <0x0>;
					AIN_KEY = <0x0 0x1 0x2 0xff>;
					AIN_X = <0x0 0x1 0x2 0x3 0x4 0x5 0x6 0x7 0x8 0x9 0xa 0xb 0xc 0xd 0xe 0xf>;
					AIN_Y = <0x0 0x1 0x2 0x3 0x4 0x5 0x6 0x7 0x8 0x9 0xa 0xb 0xc 0xd 0xe 0xf 0x10 0x11 0x12 0x13 0x14 0x15 0x16 0x17 0x18 0x19 0x1a 0x1b 0x1c 0x1d 0x1e 0x1f 0x20 0x21 0x22 0x23>;
					IC_KEY_CFG_SIZE = <0x4>;
					IC_X_CFG_SIZE = <0x10>;
					IC_Y_CFG_SIZE = <0x24>;
					PS_Config_Diff_Test_Frame = <0x32>;
					PS_Config_Lmt_FW_CC_N = <0x13 0x13 0x13 0x13 0x13 0x13 0x13 0x13 0x12 0x13 0x13 0x12 0x13 0x13 0x12 0x12 0x12 0x12 0x12 0x12 0x12 0x12 0x12 0x13 0x12 0x12 0x12 0x12 0x12 0x12 0x12 0x12 0x12 0x12 0x12 0x12 0x12 0x12 0x12 0x12 0x12 0x12 0x12 0x12 0x12 0x12 0x12 0x12 0x13 0x13 0x13 0x13 0x13 0x13 0x13 0x13 0x12 0x12 0x12 0x12 0x12 0x12 0x12 0x12 0x13 0x12 0x12 0x12 0x12 0x12 0x12 0x12 0x12 0x12 0x12 0x12 0x12 0x12 0x12 0x12 0x13 0x13 0x13 0x13 0x13 0x13 0x13 0x13 0x12 0x12 0x12 0x12 0x12 0x12 0x12 0x13 0x12 0x12 0x12 0x12 0x12 0x12 0x12 0x12 0x12 0x12 0x12 0x12 0x12 0x12 0x12 0x12 0x13 0x13 0x13 0x13 0x13 0x13 0x13 0x13 0x12 0x12 0x12 0x12 0x12 0x12 0x12 0x12 0x12 0x12 0x12 0x12 0x12 0x12 0x12 0x12 0x13 0x12 0x12 0x12 0x12 0x12 0x12 0x13 0x13 0x13 0x13 0x13 0x13 0x13 0x13 0x13 0x13 0x13 0x12 0x12 0x12 0x12 0x12 0x13 0x12 0x12 0x12 0x12 0x12 0x12 0x12 0x13 0x13 0x13 0x12 0x13 0x13 0x12 0x12 0x13 0x13 0x13 0x13 0x13 0x13 0x13 0x13 0x13 0x13 0x13 0x13 0x13 0x13 0x13 0x13 0x13 0x13 0x12 0x12 0x13 0x12 0x13 0x13 0x13 0x13 0x13 0x13 0x13 0x13 0x13 0x12 0x13 0x13 0x13 0x13 0x13 0x13 0x13 0x13 0x13 0x13 0x13 0x12 0x12 0x12 0x12 0x12 0x13 0x12 0x12 0x12 0x12 0x12 0x12 0x12 0x12 0x12 0x12 0x12 0x12 0x12 0x12 0x12 0x13 0x13 0x12 0x12 0x13 0x13 0x13 0x13 0x13 0x13 0x13 0x12 0x12 0x12 0x12 0x12 0x13 0x13 0x12 0x12 0x12 0x13 0x13 0x13 0x13 0x13 0x13 0x13 0x13 0x13 0x13 0x12 0x13 0x12 0x12 0x12 0x12 0x12 0x13 0x13 0x13 0x12 0x13 0x13 0x12 0x12 0x12 0x12 0x13 0x13 0x12 0x12 0x12 0x12 0x13 0x12 0x12 0x12 0x12 0x12 0x12 0x12 0x12 0x12 0x12 0x13 0x13 0x13 0x13 0x12 0x13 0x13 0x13 0x12 0x12 0x12 0x12 0x12 0x12 0x12 0x12 0x12 0x12 0x12 0x12 0x12 0x12 0x12 0x12 0x13 0x13 0x13 0x13 0x13 0x13 0x13 0x13 0x13 0x12 0x12 0x12 0x12 0x12 0x12 0x12 0x13 0x12 0x12 0x12 0x12 0x12 0x12 0x13 0x13 0x12 0x12 0x12 0x12 0x12 0x12 0x12 0x12 0x12 0x12 0x12 0x12 0x12 0x12 0x13 0x13 0x13 0x13 0x13 0x13 0x13 0x13 0x13 0x13 0x12 0x12 0x12 0x12 0x12 0x12 0x13 0x13 0x13 0x13 0x13 0x13 0x12 0x13 0x13 0x12 0x12 0x12 0x12 0x12 0x12 0x12 0x12 0x13 0x12 0x12 0x13 0x12 0x12 0x13 0x13 0x13 0x12 0x12 0x12 0x12 0x13 0x13 0x13 0x13 0x12 0x12 0x12 0x12 0x12 0x12 0x12 0x12 0x12 0x12 0x12 0x12 0x12 0x12 0x13 0x13 0x13 0x13 0x13 0x13 0x13 0x13 0x13 0x12 0x12 0x12 0x12 0x12 0x12 0x12 0x12 0x12 0x12 0x12 0x12 0x12 0x12 0x12 0x12 0x12 0x12 0x12 0x12 0x12 0x12 0x12 0x12 0x13 0x13 0x13 0x12 0x12 0x12 0x13 0x13 0x12 0x12 0x12 0x12 0x12 0x12 0x12 0x13 0x13 0x12 0x12 0x12 0x12 0x12 0x12 0x12 0x12 0x12 0x12 0x12 0x12 0x12 0x12 0x13 0x13 0x12 0x12 0x12 0x12 0x12 0x12 0x12 0x12 0x12 0x12 0x12 0x12 0x12 0x12 0x13 0x12 0x12 0x12 0x12 0x12 0x12 0x12 0x12 0x12 0x12 0x12 0x12 0x12 0x12 0x12 0x12 0x13 0x12 0x12 0x12 0x12 0x12 0x12 0x12 0x12 0x12 0x12 0x12 0x12 0x12 0x12 0x12 0x12 0x12 0x12 0x12 0x12 0x12 0x12 0x12 0x12 0x12 0x12 0x12 0x12 0x12 0x12 0x12 0x12 0x12 0x12 0x12 0x12 0x12 0x13 0x13 0x13 0x12 0x12 0x12 0x12 0x12 0x12 0x12 0x0 0x0 0x0>;
					PS_Config_Lmt_FW_CC_P = <0x2a 0x2a 0x2a 0x2a 0x2a 0x2a 0x2a 0x2a 0x29 0x2a 0x2a 0x29 0x2a 0x2a 0x29 0x29 0x29 0x29 0x29 0x29 0x29 0x29 0x29 0x2a 0x29 0x29 0x29 0x29 0x29 0x29 0x29 0x29 0x29 0x29 0x29 0x29 0x29 0x29 0x29 0x29 0x29 0x29 0x29 0x29 0x29 0x29 0x29 0x29 0x2c 0x2c 0x2c 0x2c 0x2a 0x2c 0x2c 0x2c 0x29 0x29 0x29 0x29 0x29 0x29 0x29 0x29 0x2a 0x29 0x29 0x29 0x29 0x29 0x29 0x29 0x29 0x29 0x29 0x29 0x29 0x29 0x29 0x29 0x2a 0x2a 0x2a 0x2a 0x2a 0x2a 0x2a 0x2a 0x29 0x29 0x29 0x29 0x29 0x29 0x29 0x2a 0x29 0x29 0x29 0x29 0x29 0x29 0x29 0x29 0x29 0x29 0x29 0x29 0x29 0x29 0x29 0x29 0x2c 0x2a 0x2a 0x2a 0x2a 0x2a 0x2a 0x2c 0x29 0x29 0x29 0x29 0x29 0x29 0x29 0x29 0x29 0x29 0x29 0x29 0x29 0x29 0x29 0x29 0x2a 0x29 0x29 0x29 0x29 0x29 0x29 0x2a 0x2c 0x2c 0x2c 0x2c 0x2c 0x2c 0x2c 0x2c 0x2a 0x2a 0x29 0x29 0x29 0x29 0x29 0x2a 0x29 0x29 0x29 0x29 0x29 0x29 0x29 0x2a 0x2a 0x2a 0x29 0x2a 0x2a 0x29 0x29 0x2a 0x2a 0x2a 0x2a 0x2a 0x2a 0x2a 0x2a 0x2c 0x2a 0x2a 0x2a 0x2a 0x2a 0x2a 0x2a 0x2c 0x2a 0x29 0x29 0x2a 0x29 0x2a 0x2a 0x2c 0x2a 0x2a 0x2a 0x2a 0x2a 0x2a 0x29 0x2a 0x2c 0x2a 0x2a 0x2a 0x2a 0x2c 0x2a 0x2c 0x2a 0x2a 0x29 0x29 0x29 0x29 0x29 0x2c 0x29 0x29 0x29 0x29 0x29 0x29 0x29 0x29 0x29 0x29 0x29 0x29 0x29 0x29 0x29 0x2a 0x2c 0x29 0x29 0x2c 0x2a 0x2c 0x2c 0x2c 0x2a 0x2a 0x29 0x29 0x29 0x29 0x29 0x2c 0x2a 0x29 0x29 0x29 0x2a 0x2a 0x2a 0x2c 0x2a 0x2a 0x2a 0x2a 0x2a 0x2a 0x29 0x2a 0x29 0x29 0x29 0x29 0x29 0x2a 0x2a 0x2c 0x29 0x2a 0x2a 0x29 0x29 0x29 0x29 0x2c 0x2c 0x29 0x29 0x29 0x29 0x2a 0x29 0x29 0x29 0x29 0x29 0x29 0x29 0x29 0x29 0x29 0x2c 0x2a 0x2a 0x2a 0x29 0x2a 0x2a 0x2a 0x29 0x29 0x29 0x29 0x29 0x29 0x29 0x29 0x29 0x29 0x29 0x29 0x29 0x29 0x29 0x29 0x2a 0x2a 0x2a 0x2a 0x2a 0x2a 0x2a 0x2c 0x2c 0x29 0x29 0x29 0x29 0x29 0x29 0x29 0x2a 0x29 0x29 0x29 0x29 0x29 0x29 0x2a 0x2a 0x29 0x29 0x29 0x29 0x29 0x29 0x29 0x29 0x29 0x29 0x29 0x29 0x29 0x29 0x2a 0x2c 0x2a 0x2a 0x2a 0x2a 0x2a 0x2a 0x2a 0x2a 0x29 0x29 0x29 0x29 0x29 0x29 0x2a 0x2c 0x2a 0x2a 0x2a 0x2a 0x29 0x2a 0x2a 0x29 0x29 0x29 0x29 0x29 0x29 0x29 0x29 0x2a 0x29 0x29 0x2a 0x29 0x29 0x2a 0x2a 0x2a 0x29 0x29 0x29 0x29 0x2a 0x2a 0x2a 0x2a 0x29 0x29 0x29 0x29 0x29 0x29 0x29 0x29 0x29 0x29 0x29 0x29 0x29 0x29 0x2a 0x2c 0x2a 0x2a 0x2a 0x2a 0x2a 0x2a 0x2a 0x29 0x29 0x29 0x29 0x29 0x29 0x29 0x29 0x29 0x29 0x29 0x29 0x29 0x29 0x29 0x29 0x29 0x29 0x29 0x29 0x29 0x29 0x29 0x29 0x2c 0x2a 0x2a 0x29 0x29 0x29 0x2a 0x2a 0x29 0x29 0x29 0x29 0x29 0x29 0x29 0x2a 0x2a 0x29 0x29 0x29 0x29 0x29 0x29 0x29 0x29 0x29 0x29 0x29 0x29 0x29 0x29 0x2a 0x2a 0x29 0x29 0x29 0x29 0x29 0x29 0x29 0x29 0x29 0x29 0x29 0x29 0x29 0x29 0x2a 0x29 0x29 0x29 0x29 0x29 0x29 0x29 0x29 0x29 0x29 0x29 0x29 0x29 0x29 0x29 0x29 0x2a 0x29 0x29 0x29 0x29 0x29 0x29 0x29 0x29 0x29 0x29 0x29 0x29 0x29 0x29 0x29 0x29 0x29 0x29 0x29 0x29 0x29 0x29 0x29 0x29 0x29 0x29 0x29 0x29 0x29 0x29 0x29 0x29 0x29 0x29 0x29 0x29 0x29 0x2a 0x2a 0x2c 0x29 0x29 0x29 0x29 0x29 0x29 0x29 0x13a 0x13a 0x13a>;
					PS_Config_Lmt_FW_Diff_N = <0xffffffce 0xffffffce 0xffffffce 0xffffffce 0xffffffce 0xffffffce 0xffffffce 0xffffffce 0xffffffce 0xffffffce 0xffffffce 0xffffffce 0xffffffce 0xffffffce 0xffffffce 0xffffffce 0xffffffce 0xffffffce 0xffffffce 0xffffffce 0xffffffce 0xffffffce 0xffffffce 0xffffffce 0xffffffce 0xffffffce 0xffffffce 0xffffffce 0xffffffce 0xffffffce 0xffffffce 0xffffffce 0xffffffce 0xffffffce 0xffffffce 0xffffffce 0xffffffce 0xffffffce 0xffffffce 0xffffffce 0xffffffce 0xffffffce 0xffffffce 0xffffffce 0xffffffce 0xffffffce 0xffffffce 0xffffffce 0xffffffce 0xffffffce 0xffffffce 0xffffffce 0xffffffce 0xffffffce 0xffffffce 0xffffffce 0xffffffce 0xffffffce 0xffffffce 0xffffffce 0xffffffce 0xffffffce 0xffffffce 0xffffffce 0xffffffce 0xffffffce 0xffffffce 0xffffffce 0xffffffce 0xffffffce 0xffffffce 0xffffffce 0xffffffce 0xffffffce 0xffffffce 0xffffffce 0xffffffce 0xffffffce 0xffffffce 0xffffffce 0xffffffce 0xffffffce 0xffffffce 0xffffffce 0xffffffce 0xffffffce 0xffffffce 0xffffffce 0xffffffce 0xffffffce 0xffffffce 0xffffffce 0xffffffce 0xffffffce 0xffffffce 0xffffffce 0xffffffce 0xffffffce 0xffffffce 0xffffffce 0xffffffce 0xffffffce 0xffffffce 0xffffffce 0xffffffce 0xffffffce 0xffffffce 0xffffffce 0xffffffce 0xffffffce 0xffffffce 0xffffffce 0xffffffce 0xffffffce 0xffffffce 0xffffffce 0xffffffce 0xffffffce 0xffffffce 0xffffffce 0xffffffce 0xffffffce 0xffffffce 0xffffffce 0xffffffce 0xffffffce 0xffffffce 0xffffffce 0xffffffce 0xffffffce 0xffffffce 0xffffffce 0xffffffce 0xffffffce 0xffffffce 0xffffffce 0xffffffce 0xffffffce 0xffffffce 0xffffffce 0xffffffce 0xffffffce 0xffffffce 0xffffffce 0xffffffce 0xffffffce 0xffffffce 0xffffffce 0xffffffce 0xffffffce 0xffffffce 0xffffffce 0xffffffce 0xffffffce 0xffffffce 0xffffffce 0xffffffce 0xffffffce 0xffffffce 0xffffffce 0xffffffce 0xffffffce 0xffffffce 0xffffffce 0xffffffce 0xffffffce 0xffffffce 0xffffffce 0xffffffce 0xffffffce 0xffffffce 0xffffffce 0xffffffce 0xffffffce 0xffffffce 0xffffffce 0xffffffce 0xffffffce 0xffffffce 0xffffffce 0xffffffce 0xffffffce 0xffffffce 0xffffffce 0xffffffce 0xffffffce 0xffffffce 0xffffffce 0xffffffce 0xffffffce 0xffffffce 0xffffffce 0xffffffce 0xffffffce 0xffffffce 0xffffffce 0xffffffce 0xffffffce 0xffffffce 0xffffffce 0xffffffce 0xffffffce 0xffffffce 0xffffffce 0xffffffce 0xffffffce 0xffffffce 0xffffffce 0xffffffce 0xffffffce 0xffffffce 0xffffffce 0xffffffce 0xffffffce 0xffffffce 0xffffffce 0xffffffce 0xffffffce 0xffffffce 0xffffffce 0xffffffce 0xffffffce 0xffffffce 0xffffffce 0xffffffce 0xffffffce 0xffffffce 0xffffffce 0xffffffce 0xffffffce 0xffffffce 0xffffffce 0xffffffce 0xffffffce 0xffffffce 0xffffffce 0xffffffce 0xffffffce 0xffffffce 0xffffffce 0xffffffce 0xffffffce 0xffffffce 0xffffffce 0xffffffce 0xffffffce 0xffffffce 0xffffffce 0xffffffce 0xffffffce 0xffffffce 0xffffffce 0xffffffce 0xffffffce 0xffffffce 0xffffffce 0xffffffce 0xffffffce 0xffffffce 0xffffffce 0xffffffce 0xffffffce 0xffffffce 0xffffffce 0xffffffce 0xffffffce 0xffffffce 0xffffffce 0xffffffce 0xffffffce 0xffffffce 0xffffffce 0xffffffce 0xffffffce 0xffffffce 0xffffffce 0xffffffce 0xffffffce 0xffffffce 0xffffffce 0xffffffce 0xffffffce 0xffffffce 0xffffffce 0xffffffce 0xffffffce 0xffffffce 0xffffffce 0xffffffce 0xffffffce 0xffffffce 0xffffffce 0xffffffce 0xffffffce 0xffffffce 0xffffffce 0xffffffce 0xffffffce 0xffffffce 0xffffffce 0xffffffce 0xffffffce 0xffffffce 0xffffffce 0xffffffce 0xffffffce 0xffffffce 0xffffffce 0xffffffce 0xffffffce 0xffffffce 0xffffffce 0xffffffce 0xffffffce 0xffffffce 0xffffffce 0xffffffce 0xffffffce 0xffffffce 0xffffffce 0xffffffce 0xffffffce 0xffffffce 0xffffffce 0xffffffce 0xffffffce 0xffffffce 0xffffffce 0xffffffce 0xffffffce 0xffffffce 0xffffffce 0xffffffce 0xffffffce 0xffffffce 0xffffffce 0xffffffce 0xffffffce 0xffffffce 0xffffffce 0xffffffce 0xffffffce 0xffffffce 0xffffffce 0xffffffce 0xffffffce 0xffffffce 0xffffffce 0xffffffce 0xffffffce 0xffffffce 0xffffffce 0xffffffce 0xffffffce 0xffffffce 0xffffffce 0xffffffce 0xffffffce 0xffffffce 0xffffffce 0xffffffce 0xffffffce 0xffffffce 0xffffffce 0xffffffce 0xffffffce 0xffffffce 0xffffffce 0xffffffce 0xffffffce 0xffffffce 0xffffffce 0xffffffce 0xffffffce 0xffffffce 0xffffffce 0xffffffce 0xffffffce 0xffffffce 0xffffffce 0xffffffce 0xffffffce 0xffffffce 0xffffffce 0xffffffce 0xffffffce 0xffffffce 0xffffffce 0xffffffce 0xffffffce 0xffffffce 0xffffffce 0xffffffce 0xffffffce 0xffffffce 0xffffffce 0xffffffce 0xffffffce 0xffffffce 0xffffffce 0xffffffce 0xffffffce 0xffffffce 0xffffffce 0xffffffce 0xffffffce 0xffffffce 0xffffffce 0xffffffce 0xffffffce 0xffffffce 0xffffffce 0xffffffce 0xffffffce 0xffffffce 0xffffffce 0xffffffce 0xffffffce 0xffffffce 0xffffffce 0xffffffce 0xffffffce 0xffffffce 0xffffffce 0xffffffce 0xffffffce 0xffffffce 0xffffffce 0xffffffce 0xffffffce 0xffffffce 0xffffffce 0xffffffce 0xffffffce 0xffffffce 0xffffffce 0xffffffce 0xffffffce 0xffffffce 0xffffffce 0xffffffce 0xffffffce 0xffffffce 0xffffffce 0xffffffce 0xffffffce 0xffffffce 0xffffffce 0xffffffce 0xffffffce 0xffffffce 0xffffffce 0xffffffce 0xffffffce 0xffffffce 0xffffffce 0xffffffce 0xffffffce 0xffffffce 0xffffffce 0xffffffce 0xffffffce 0xffffffce 0xffffffce 0xffffffce 0xffffffce 0xffffffce 0xffffffce 0xffffffce 0xffffffce 0xffffffce 0xffffffce 0xffffffce 0xffffffce 0xffffffce 0xffffffce 0xffffffce 0xffffffce 0xffffffce 0xffffffce 0xffffffce 0xffffffce 0xffffffce 0xffffffce 0xffffffce 0xffffffce 0xffffffce 0xffffffce 0xffffffce 0xffffffce 0xffffffce 0xffffffce 0xffffffce 0xffffffce 0xffffffce 0xffffffce 0xffffffce 0xffffffce 0xffffffce 0xffffffce 0xffffffce 0xffffffce 0xffffffce 0xffffffce 0xffffffce 0xffffffce 0xffffffce 0xffffffce 0xffffffce 0xffffffce 0xffffffce 0xffffffce 0xffffffce 0xffffffce 0xffffffce 0xffffffce 0xffffffce 0xffffffce 0xffffffce 0xffffffce 0xffffffce 0xffffffce 0xffffffce 0xffffffce 0xffffffce 0xffffffce 0xffffffce 0xffffffce 0xffffffce 0xffffffce 0xffffffce 0xffffffce 0xffffffce 0xffffffce 0xffffffce 0xffffffce 0xffffffce 0xffffffce 0xffffffce 0xffffffce 0xffffffce 0xffffffce 0xffffffce 0xffffffce 0xffffffce 0xffffffce 0xffffffce 0xffffffce 0xffffffce 0xffffffce 0xffffffce 0xffffffce 0xffffffce 0xffffffce 0xffffffce 0xffffffce 0xffffffce 0xffffffce 0xffffffce 0xffffffce 0xffffffce 0xffffffce 0xffffffce 0xffffffce 0xffffffce 0xffffffce 0xffffffce 0xffffffce 0xffffffce 0xffffffce 0xffffffce 0xffffffce 0xffffffce 0xffffffce 0xffffffce 0xffffffce 0xffffffb5 0xffffffb5 0xffffffb5>;
					PS_Config_Lmt_FW_Diff_P = <0x32 0x32 0x32 0x32 0x32 0x32 0x32 0x32 0x32 0x32 0x32 0x32 0x32 0x32 0x32 0x32 0x32 0x32 0x32 0x32 0x32 0x32 0x32 0x32 0x32 0x32 0x32 0x32 0x32 0x32 0x32 0x32 0x32 0x32 0x32 0x32 0x32 0x32 0x32 0x32 0x32 0x32 0x32 0x32 0x32 0x32 0x32 0x32 0x32 0x32 0x32 0x32 0x32 0x32 0x32 0x32 0x32 0x32 0x32 0x32 0x32 0x32 0x32 0x32 0x32 0x32 0x32 0x32 0x32 0x32 0x32 0x32 0x32 0x32 0x32 0x32 0x32 0x32 0x32 0x32 0x32 0x32 0x32 0x32 0x32 0x32 0x32 0x32 0x32 0x32 0x32 0x32 0x32 0x32 0x32 0x32 0x32 0x32 0x32 0x32 0x32 0x32 0x32 0x32 0x32 0x32 0x32 0x32 0x32 0x32 0x32 0x32 0x32 0x32 0x32 0x32 0x32 0x32 0x32 0x32 0x32 0x32 0x32 0x32 0x32 0x32 0x32 0x32 0x32 0x32 0x32 0x32 0x32 0x32 0x32 0x32 0x32 0x32 0x32 0x32 0x32 0x32 0x32 0x32 0x32 0x32 0x32 0x32 0x32 0x32 0x32 0x32 0x32 0x32 0x32 0x32 0x32 0x32 0x32 0x32 0x32 0x32 0x32 0x32 0x32 0x32 0x32 0x32 0x32 0x32 0x32 0x32 0x32 0x32 0x32 0x32 0x32 0x32 0x32 0x32 0x32 0x32 0x32 0x32 0x32 0x32 0x32 0x32 0x32 0x32 0x32 0x32 0x32 0x32 0x32 0x32 0x32 0x32 0x32 0x32 0x32 0x32 0x32 0x32 0x32 0x32 0x32 0x32 0x32 0x32 0x32 0x32 0x32 0x32 0x32 0x32 0x32 0x32 0x32 0x32 0x32 0x32 0x32 0x32 0x32 0x32 0x32 0x32 0x32 0x32 0x32 0x32 0x32 0x32 0x32 0x32 0x32 0x32 0x32 0x32 0x32 0x32 0x32 0x32 0x32 0x32 0x32 0x32 0x32 0x32 0x32 0x32 0x32 0x32 0x32 0x32 0x32 0x32 0x32 0x32 0x32 0x32 0x32 0x32 0x32 0x32 0x32 0x32 0x32 0x32 0x32 0x32 0x32 0x32 0x32 0x32 0x32 0x32 0x32 0x32 0x32 0x32 0x32 0x32 0x32 0x32 0x32 0x32 0x32 0x32 0x32 0x32 0x32 0x32 0x32 0x32 0x32 0x32 0x32 0x32 0x32 0x32 0x32 0x32 0x32 0x32 0x32 0x32 0x32 0x32 0x32 0x32 0x32 0x32 0x32 0x32 0x32 0x32 0x32 0x32 0x32 0x32 0x32 0x32 0x32 0x32 0x32 0x32 0x32 0x32 0x32 0x32 0x32 0x32 0x32 0x32 0x32 0x32 0x32 0x32 0x32 0x32 0x32 0x32 0x32 0x32 0x32 0x32 0x32 0x32 0x32 0x32 0x32 0x32 0x32 0x32 0x32 0x32 0x32 0x32 0x32 0x32 0x32 0x32 0x32 0x32 0x32 0x32 0x32 0x32 0x32 0x32 0x32 0x32 0x32 0x32 0x32 0x32 0x32 0x32 0x32 0x32 0x32 0x32 0x32 0x32 0x32 0x32 0x32 0x32 0x32 0x32 0x32 0x32 0x32 0x32 0x32 0x32 0x32 0x32 0x32 0x32 0x32 0x32 0x32 0x32 0x32 0x32 0x32 0x32 0x32 0x32 0x32 0x32 0x32 0x32 0x32 0x32 0x32 0x32 0x32 0x32 0x32 0x32 0x32 0x32 0x32 0x32 0x32 0x32 0x32 0x32 0x32 0x32 0x32 0x32 0x32 0x32 0x32 0x32 0x32 0x32 0x32 0x32 0x32 0x32 0x32 0x32 0x32 0x32 0x32 0x32 0x32 0x32 0x32 0x32 0x32 0x32 0x32 0x32 0x32 0x32 0x32 0x32 0x32 0x32 0x32 0x32 0x32 0x32 0x32 0x32 0x32 0x32 0x32 0x32 0x32 0x32 0x32 0x32 0x32 0x32 0x32 0x32 0x32 0x32 0x32 0x32 0x32 0x32 0x32 0x32 0x32 0x32 0x32 0x32 0x32 0x32 0x32 0x32 0x32 0x32 0x32 0x32 0x32 0x32 0x32 0x32 0x32 0x32 0x32 0x32 0x32 0x32 0x32 0x32 0x32 0x32 0x32 0x32 0x32 0x32 0x32 0x32 0x32 0x32 0x32 0x32 0x32 0x32 0x32 0x32 0x32 0x32 0x32 0x32 0x32 0x32 0x32 0x32 0x32 0x32 0x32 0x32 0x32 0x32 0x32 0x32 0x32 0x32 0x32 0x32 0x32 0x32 0x32 0x32 0x32 0x32 0x32 0x32 0x32 0x32 0x32 0x32 0x32 0x32 0x32 0x32 0x32 0x32 0x32 0x32 0x32 0x32 0x32 0x32 0x4b 0x4b 0x4b>;
					PS_Config_Lmt_FW_Rawdata_N = <0x1d7 0x1e1 0x1df 0x1e7 0x1df 0x1e3 0x1e0 0x1e7 0x1f4 0x1e1 0x1dc 0x1f3 0x1de 0x1e9 0x1f2 0x1eb 0x1f1 0x1e3 0x1e3 0x1ec 0x1dd 0x1e9 0x1e6 0x1f1 0x1f6 0x1e7 0x1e1 0x1e1 0x1e2 0x1e4 0x1e0 0x1f2 0x1de 0x1d7 0x1da 0x1e2 0x1dd 0x1d8 0x1dd 0x1db 0x1e7 0x1e3 0x1dd 0x1db 0x1e0 0x1e4 0x1d7 0x1ee 0x1d5 0x1c6 0x1c8 0x1cd 0x1d1 0x1cc 0x1d1 0x1da 0x1db 0x1cc 0x1c2 0x1cc 0x1c5 0x1cc 0x1da 0x1e1 0x1d2 0x1df 0x1dd 0x1ca 0x1e8 0x1cb 0x1ca 0x1d0 0x1db 0x1f1 0x1eb 0x1dd 0x1ed 0x1ed 0x1ed 0x1e2 0x1e2 0x1c6 0x1ce 0x1cf 0x1ce 0x1d5 0x1ce 0x1e1 0x1f3 0x1f6 0x1f0 0x1f0 0x1f0 0x1f1 0x1e9 0x1f2 0x1e0 0x1cd 0x1cb 0x1d5 0x1ca 0x1d5 0x1cc 0x1da 0x1f9 0x1f6 0x1ef 0x1ef 0x1ed 0x1ed 0x1ec 0x1f2 0x1ce 0x1f5 0x1eb 0x1ee 0x1fc 0x1f2 0x1f5 0x1d7 0x1d4 0x1d1 0x1cc 0x1cc 0x1d2 0x1d3 0x1d2 0x1dd 0x1dc 0x1dd 0x1de 0x1dd 0x1de 0x1d9 0x1d9 0x1dc 0x1d9 0x1d7 0x1d7 0x1da 0x1db 0x1d7 0x1d3 0x1da 0x1cd 0x1c2 0x1c6 0x1c5 0x1c6 0x1cc 0x1c3 0x1e3 0x1cb 0x1d4 0x1fe 0x1fc 0x1fe 0x1f9 0x1fb 0x1c6 0x1f2 0x1ed 0x1e7 0x1f2 0x1ea 0x1f0 0x1ef 0x1e6 0x1ea 0x1e3 0x1e6 0x1e3 0x1e3 0x1e1 0x1dd 0x1ec 0x1ef 0x1e4 0x1e9 0x1e7 0x1ec 0x1f0 0x1e7 0x1d4 0x1dd 0x1e1 0x1de 0x1e1 0x1e0 0x1da 0x1d4 0x1e0 0x1e6 0x1e9 0x1dd 0x1d8 0x1de 0x1d4 0x1d7 0x1b9 0x1da 0x1d7 0x1e7 0x1d7 0x1dc 0x1e6 0x1ed 0x1dc 0x1c9 0x1c9 0x1d4 0x1e2 0x1db 0x1d8 0x1e4 0x1d7 0x1e6 0x1ed 0x1e8 0x1e9 0x1ef 0x1ea 0x1e6 0x1ea 0x1f2 0x1d8 0x1dd 0x1ea 0x1df 0x1f3 0x1ef 0x201 0x1e7 0x1e8 0x1f2 0x1ed 0x1ec 0x1ee 0x1ea 0x1e3 0x1d2 0x201 0x208 0x1d2 0x202 0x1b7 0x1bc 0x1d1 0x1d6 0x1da 0x1e7 0x1f2 0x1f9 0x1f8 0x1f3 0x1ba 0x1d3 0x1bc 0x1c5 0x1cf 0x1c9 0x1d6 0x1d3 0x1d8 0x1d7 0x1df 0x1e0 0x1dc 0x1d4 0x1d2 0x1d7 0x1da 0x1e1 0x1f1 0x1f0 0x1f4 0x1ed 0x1de 0x1e1 0x1ce 0x1d7 0x1cb 0x1cc 0x1d2 0x1e0 0x1dc 0x1ec 0x1d2 0x1dd 0x1db 0x1ec 0x1ed 0x1e6 0x1db 0x1de 0x1e0 0x1dd 0x1d8 0x1d1 0x1d2 0x1ce 0x1d2 0x1cd 0x1e6 0x1cf 0x1e2 0x1de 0x1e3 0x1f3 0x1e5 0x1ec 0x1eb 0x1db 0x1de 0x1dc 0x1e6 0x1db 0x1e9 0x1e8 0x1ef 0x1dd 0x1ec 0x1e7 0x1e1 0x1e4 0x1e4 0x1e1 0x1e2 0x1e1 0x1d4 0x1d2 0x1c3 0x1cd 0x1ca 0x1c1 0x1e5 0x1e8 0x1d0 0x1cb 0x1cf 0x1cc 0x1cd 0x1d5 0x1d5 0x1e5 0x1d2 0x1d2 0x1ca 0x1cf 0x1d6 0x1cf 0x1ed 0x1cf 0x1dd 0x1e1 0x1dc 0x1e6 0x1e1 0x1de 0x1e1 0x1e3 0x1e4 0x1e5 0x1e3 0x1e3 0x1e3 0x1e2 0x1de 0x1e7 0x1da 0x1dd 0x1e0 0x1d5 0x1d3 0x1e1 0x1e5 0x1e4 0x1e7 0x1e1 0x1f1 0x1e7 0x1ea 0x1e7 0x1d5 0x1e8 0x1d8 0x1d2 0x1d6 0x1cc 0x1d3 0x1cf 0x1cc 0x1eb 0x1e3 0x1e4 0x1dd 0x1e1 0x1e7 0x1e3 0x1f0 0x1e6 0x1e4 0x1df 0x1d8 0x1df 0x1dc 0x1da 0x1df 0x1e0 0x1cf 0x1cc 0x1d5 0x1cc 0x1c8 0x1ca 0x1dc 0x1dc 0x1e9 0x1e6 0x1e4 0x1e4 0x1e4 0x1e5 0x1e7 0x1ce 0x1d1 0x1d2 0x1cc 0x1d2 0x1d9 0x1d7 0x1e9 0x1fe 0x1e4 0x1e1 0x1dd 0x1d8 0x1da 0x1df 0x1ea 0x1dd 0x1cd 0x1ce 0x1c9 0x1cd 0x1d6 0x1d3 0x1e9 0x1da 0x1c3 0x1bd 0x1bc 0x1be 0x1b9 0x1bf 0x1c1 0x1c8 0x1c5 0x1c6 0x1c3 0x1c2 0x1c6 0x1c5 0x1dd 0x1e9 0x1d4 0x1d3 0x1e0 0x1e0 0x1df 0x1cf 0x1cc 0x1cb 0x1dc 0x1de 0x1da 0x1dd 0x1da 0x1d9 0x1d2 0x1db 0x1cb 0x1cf 0x1d7 0x1d7 0x1d5 0x1d4 0x1d5 0x1c6 0x1bf 0x1c3 0x1c9 0x1c3 0x1bc 0x1cd 0x1d9 0x1e7 0x1de 0x1db 0x1de 0x1e2 0x1dd 0x1d9 0x1db 0x1e3 0x1d4 0x1d1 0x1d1 0x1da 0x1d5 0x1da 0x1e3 0x1d8 0x1d7 0x1dc 0x1d4 0x1e2 0x1d5 0x1da 0x1db 0x1db 0x1dd 0x1d5 0x1d4 0x1d5 0x1dd 0x1d3 0x1ef 0x1ea 0x1df 0x1e6 0x1de 0x1e1 0x1df 0x1e4 0x1e4 0x1e7 0x1dd 0x1d5 0x1d5 0x1d7 0x1dd 0x1d5 0x1f2 0x1e3 0x1d9 0x1de 0x1e3 0x1db 0x1da 0x1df 0x1dd 0x1f4 0x1f5 0x1f9 0x1fa 0x1f9 0x1f7 0x1f9 0x1ee 0x1dd 0x1d9 0x1e0 0x1e0 0x1e3 0x1eb 0x1e1 0x1e6 0x1d1 0x1f9 0x1f8 0x1fc 0x1ef 0x1f0 0x1ea 0x1ee 0xf0 0xf0 0xf0>;
					PS_Config_Lmt_FW_Rawdata_P = <0x44b 0x464 0x45e 0x470 0x45e 0x467 0x461 0x472 0x48f 0x464 0x457 0x48e 0x45d 0x476 0x48a 0x47a 0x488 0x467 0x468 0x47d 0x45a 0x475 0x46f 0x488 0x493 0x472 0x464 0x464 0x465 0x46b 0x460 0x48a 0x45d 0x44c 0x452 0x465 0x459 0x44f 0x459 0x456 0x472 0x468 0x45a 0x454 0x460 0x469 0x44b 0x481 0x446 0x425 0x428 0x434 0x43d 0x431 0x43e 0x453 0x456 0x431 0x41b 0x433 0x422 0x431 0x452 0x462 0x441 0x45e 0x459 0x42d 0x473 0x42f 0x42d 0x43b 0x454 0x488 0x47a 0x45a 0x47e 0x47e 0x47e 0x465 0x465 0x423 0x437 0x43a 0x436 0x448 0x436 0x462 0x48c 0x493 0x487 0x485 0x485 0x488 0x476 0x48b 0x461 0x434 0x430 0x446 0x42d 0x448 0x433 0x452 0x49c 0x493 0x484 0x483 0x480 0x47e 0x47d 0x48b 0x437 0x492 0x47a 0x481 0x4a1 0x48b 0x492 0x44c 0x445 0x43e 0x431 0x433 0x43f 0x442 0x441 0x45a 0x457 0x459 0x45d 0x45a 0x45d 0x450 0x450 0x457 0x450 0x44c 0x44b 0x453 0x456 0x44c 0x442 0x452 0x434 0x41a 0x423 0x421 0x425 0x433 0x41e 0x467 0x42f 0x445 0x4a6 0x4a3 0x4a7 0x49a 0x49f 0x425 0x48a 0x47e 0x472 0x48b 0x477 0x487 0x483 0x46e 0x477 0x468 0x46f 0x468 0x468 0x464 0x459 0x47d 0x484 0x469 0x475 0x470 0x47c 0x487 0x470 0x444 0x45a 0x462 0x45b 0x464 0x461 0x452 0x445 0x461 0x46e 0x475 0x45a 0x44f 0x45d 0x445 0x44c 0x406 0x453 0x44c 0x472 0x44b 0x457 0x46e 0x480 0x457 0x42c 0x42a 0x445 0x465 0x454 0x44f 0x46b 0x44c 0x46f 0x47e 0x473 0x476 0x484 0x477 0x46e 0x477 0x48b 0x44f 0x459 0x477 0x45e 0x48e 0x484 0x4ae 0x470 0x473 0x48a 0x480 0x47c 0x481 0x477 0x467 0x441 0x4ad 0x4bd 0x43f 0x4af 0x400 0x40d 0x43e 0x449 0x453 0x472 0x48a 0x49a 0x498 0x48c 0x407 0x442 0x40d 0x422 0x438 0x42a 0x449 0x442 0x44d 0x44c 0x45e 0x460 0x457 0x445 0x43f 0x44c 0x453 0x464 0x488 0x487 0x48f 0x47e 0x45d 0x464 0x436 0x44b 0x42f 0x433 0x441 0x460 0x457 0x47c 0x43f 0x459 0x456 0x47c 0x47e 0x46f 0x454 0x45b 0x461 0x45a 0x44f 0x43d 0x43f 0x436 0x43f 0x434 0x46f 0x43a 0x465 0x45d 0x467 0x48c 0x46c 0x47c 0x47a 0x454 0x45b 0x457 0x46e 0x454 0x476 0x473 0x484 0x45a 0x47d 0x472 0x462 0x469 0x469 0x464 0x465 0x464 0x445 0x43f 0x41e 0x434 0x42d 0x418 0x46c 0x473 0x43b 0x430 0x438 0x433 0x434 0x446 0x446 0x46c 0x441 0x441 0x42d 0x43a 0x449 0x438 0x47e 0x43a 0x45a 0x464 0x457 0x46e 0x464 0x45b 0x464 0x467 0x469 0x46c 0x468 0x467 0x468 0x465 0x45d 0x472 0x452 0x459 0x460 0x446 0x442 0x464 0x46c 0x469 0x470 0x464 0x488 0x470 0x479 0x470 0x448 0x473 0x44f 0x441 0x449 0x431 0x442 0x438 0x431 0x47a 0x468 0x469 0x45a 0x464 0x470 0x468 0x487 0x46f 0x46b 0x45e 0x44d 0x45e 0x457 0x452 0x45e 0x461 0x438 0x431 0x448 0x431 0x429 0x42d 0x457 0x457 0x476 0x46e 0x46b 0x469 0x46b 0x46c 0x472 0x436 0x43e 0x441 0x433 0x43f 0x450 0x44b 0x475 0x4a6 0x46b 0x462 0x459 0x44f 0x452 0x45e 0x477 0x45a 0x434 0x437 0x42c 0x434 0x449 0x442 0x475 0x452 0x41c 0x410 0x40c 0x411 0x406 0x414 0x418 0x428 0x421 0x423 0x41c 0x41b 0x425 0x421 0x459 0x475 0x445 0x442 0x461 0x460 0x45e 0x438 0x431 0x430 0x457 0x45b 0x453 0x45a 0x452 0x450 0x43f 0x454 0x42f 0x438 0x44b 0x44c 0x446 0x445 0x446 0x423 0x414 0x41c 0x42c 0x41e 0x40d 0x434 0x450 0x472 0x45d 0x456 0x45b 0x465 0x459 0x450 0x454 0x467 0x444 0x43e 0x43d 0x453 0x446 0x452 0x467 0x44f 0x44b 0x457 0x445 0x465 0x446 0x453 0x454 0x456 0x459 0x446 0x444 0x446 0x459 0x442 0x483 0x477 0x45e 0x46f 0x45d 0x462 0x45e 0x46b 0x46b 0x470 0x45a 0x446 0x448 0x44b 0x459 0x446 0x48a 0x468 0x450 0x45d 0x467 0x454 0x453 0x45e 0x45a 0x48f 0x492 0x49a 0x49d 0x49c 0x496 0x49c 0x481 0x459 0x450 0x460 0x461 0x467 0x47a 0x464 0x46e 0x43e 0x49c 0x498 0x4a3 0x484 0x485 0x479 0x481 0xf00 0xf00 0xf00>;
					PS_Config_Lmt_Open_Rawdata_N = <0x5bb 0x617 0x625 0x645 0x627 0x637 0x630 0x5c5 0x5cf 0x651 0x634 0x63c 0x637 0x62d 0x606 0x5b2 0x5c4 0x615 0x622 0x643 0x627 0x634 0x629 0x5d9 0x5e5 0x652 0x636 0x63a 0x637 0x62a 0x602 0x5c2 0x604 0x625 0x632 0x659 0x63e 0x649 0x63e 0x63d 0x63f 0x657 0x63d 0x643 0x644 0x62b 0x60b 0x5f2 0x607 0x626 0x631 0x65b 0x63d 0x647 0x63a 0x630 0x624 0x63a 0x61f 0x625 0x622 0x60d 0x5ea 0x5ce 0x604 0x624 0x62a 0x655 0x63f 0x649 0x638 0x63d 0x63a 0x653 0x634 0x63d 0x633 0x61c 0x5f9 0x5ea 0x612 0x631 0x639 0x666 0x652 0x65f 0x64b 0x651 0x648 0x661 0x640 0x64c 0x642 0x62a 0x609 0x5fa 0x61d 0x639 0x647 0x670 0x65e 0x66d 0x655 0x65d 0x64e 0x666 0x648 0x650 0x63f 0x62c 0x605 0x5fa 0x60f 0x62a 0x63a 0x660 0x657 0x666 0x645 0x654 0x661 0x675 0x65a 0x663 0x64b 0x639 0x60c 0x608 0x60b 0x626 0x635 0x65c 0x658 0x666 0x654 0x657 0x675 0x684 0x66a 0x673 0x654 0x643 0x622 0x610 0x637 0x64f 0x65c 0x685 0x682 0x68e 0x67c 0x67b 0x685 0x693 0x676 0x683 0x65d 0x64f 0x630 0x61e 0x625 0x642 0x64f 0x67b 0x67c 0x680 0x675 0x67c 0x684 0x697 0x678 0x688 0x658 0x643 0x62a 0x61a 0x628 0x648 0x64f 0x67c 0x681 0x693 0x67e 0x680 0x68c 0x69d 0x681 0x694 0x663 0x65b 0x637 0x625 0x634 0x64f 0x65a 0x682 0x68d 0x6a2 0x688 0x688 0x69d 0x6ac 0x695 0x6a0 0x66f 0x66b 0x645 0x630 0x636 0x655 0x660 0x685 0x696 0x6ac 0x692 0x68d 0x68a 0x699 0x67f 0x68e 0x653 0x651 0x62e 0x61a 0x636 0x654 0x65d 0x683 0x68b 0x6ae 0x699 0x68f 0x6a3 0x6ac 0x690 0x6a0 0x660 0x65d 0x63a 0x621 0x64c 0x66d 0x674 0x696 0x6af 0x6c6 0x6b5 0x6ae 0x6a7 0x6ae 0x692 0x6a3 0x669 0x65e 0x63c 0x624 0x63f 0x661 0x65e 0x685 0x6a2 0x6c0 0x6ae 0x6a4 0x6bb 0x6c4 0x6a4 0x6b5 0x678 0x66c 0x642 0x630 0x642 0x665 0x65e 0x67f 0x6a2 0x6be 0x6b2 0x6a9 0x6a8 0x6b4 0x695 0x6a0 0x669 0x65e 0x630 0x61b 0x62a 0x629 0x617 0x619 0x602 0x612 0x610 0x625 0x5e5 0x60e 0x5fb 0x5fa 0x603 0x626 0x62a 0x64e 0x628 0x62a 0x615 0x61b 0x603 0x60e 0x60e 0x623 0x5e4 0x60b 0x5fc 0x601 0x601 0x622 0x624 0x646 0x62c 0x633 0x61b 0x61f 0x609 0x613 0x612 0x624 0x5fa 0x61b 0x612 0x61b 0x619 0x63a 0x639 0x651 0x61d 0x627 0x608 0x613 0x5fa 0x608 0x609 0x617 0x5f1 0x616 0x607 0x61a 0x61a 0x639 0x634 0x64d 0x636 0x645 0x62a 0x62d 0x61b 0x622 0x622 0x631 0x60c 0x62a 0x622 0x636 0x630 0x64b 0x645 0x657 0x639 0x64a 0x631 0x638 0x621 0x62b 0x627 0x636 0x5ff 0x61b 0x616 0x628 0x624 0x63f 0x636 0x64b 0x62d 0x644 0x62c 0x62e 0x61c 0x627 0x61f 0x62e 0x600 0x61c 0x617 0x628 0x625 0x643 0x63c 0x64c 0x622 0x637 0x623 0x626 0x611 0x620 0x61b 0x628 0x611 0x61f 0x621 0x634 0x631 0x64d 0x642 0x64d 0x62b 0x64a 0x631 0x633 0x621 0x62a 0x628 0x636 0x60e 0x627 0x625 0x636 0x634 0x64e 0x649 0x64a 0x618 0x639 0x621 0x623 0x610 0x61b 0x618 0x622 0x5fc 0x613 0x60d 0x61f 0x61a 0x636 0x62e 0x630 0x61e 0x649 0x62e 0x638 0x61d 0x62c 0x62a 0x634 0x5fe 0x61e 0x614 0x626 0x622 0x63b 0x631 0x62a 0x626 0x64b 0x631 0x63d 0x621 0x62e 0x62e 0x634 0x606 0x621 0x615 0x628 0x626 0x643 0x637 0x631 0x617 0x640 0x62b 0x634 0x618 0x629 0x625 0x62a 0x607 0x623 0x61b 0x627 0x622 0x640 0x62e 0x625 0x5ae 0x643 0x5bc 0x63c 0x5af 0x636 0x5bb 0x633 0x58e 0x619 0x59a 0x61d 0x5a4 0x636 0x5ac 0x61b 0x5aa 0x5c6 0x5be 0x5c7 0x5b1 0x5c3 0x5be 0x5c4 0x59d 0x5b6 0x5aa 0x5b8 0x5b3 0x5cb 0x5b8 0x5b2 0x5c1 0x5de 0x5d8 0x5e3 0x5cb 0x5dc 0x5d6 0x5de 0x5c7 0x5e0 0x5d2 0x5e0 0x5da 0x5f2 0x5dc 0x5d4 0x560 0x5e0 0x5da 0x5e7 0x5ce 0x5e0 0x5da 0x5e2 0x5bc 0x5da 0x5c7 0x5db 0x5d2 0x5eb 0x5d3 0x56b 0x536 0x5d6 0x5d1 0x5e7 0x5c7 0x5d6 0x5cf 0x5da 0x5bc 0x5da 0x5c6 0x5d8 0x5d9 0x5ea 0x5ce 0x54c 0xfffffe01 0xfffffe01 0xfffffe01>;
					PS_Config_Lmt_Open_Rawdata_P = <0xd60 0xe36 0xe56 0xea1 0xe5b 0xe80 0xe70 0xd76 0xd8e 0xebe 0xe7b 0xe8d 0xe82 0xe6a 0xe0e 0xd4b 0xd74 0xe31 0xe51 0xe9c 0xe5c 0xe7b 0xe60 0xda6 0xdc2 0xec1 0xe7f 0xe89 0xe80 0xe62 0xe05 0xd6f 0xe0b 0xe56 0xe75 0xed0 0xe91 0xeaa 0xe91 0xe90 0xe94 0xecb 0xe90 0xe9c 0xe9f 0xe66 0xe1a 0xde1 0xe10 0xe59 0xe72 0xed4 0xe90 0xea6 0xe89 0xe70 0xe54 0xe89 0xe4a 0xe58 0xe4f 0xe1e 0xdcd 0xd8d 0xe09 0xe54 0xe62 0xec6 0xe94 0xeaa 0xe83 0xe8e 0xe89 0xec2 0xe7b 0xe8e 0xe77 0xe41 0xdf0 0xdcd 0xe2b 0xe74 0xe85 0xeef 0xec1 0xede 0xeaf 0xebe 0xea8 0xee2 0xe97 0xeb3 0xe9a 0xe63 0xe15 0xdf3 0xe44 0xe85 0xea6 0xf07 0xedd 0xefe 0xec8 0xed9 0xeb6 0xeee 0xea8 0xebb 0xe93 0xe67 0xe0c 0xdf2 0xe23 0xe63 0xe89 0xee1 0xecb 0xeef 0xea2 0xec4 0xee2 0xf11 0xed3 0xee7 0xeb0 0xe86 0xe1c 0xe13 0xe1a 0xe59 0xe7c 0xed7 0xecf 0xeee 0xec5 0xecc 0xf12 0xf34 0xef7 0xf0e 0xec4 0xe9c 0xe4f 0xe25 0xe80 0xeba 0xed7 0xf36 0xf31 0xf4d 0xf21 0xf20 0xf36 0xf58 0xf15 0xf32 0xeda 0xeba 0xe70 0xe47 0xe56 0xe9b 0xeb8 0xf20 0xf21 0xf2b 0xf11 0xf21 0xf35 0xf60 0xf19 0xf3d 0xecf 0xe9e 0xe62 0xe3d 0xe5f 0xea8 0xeba 0xf23 0xf2e 0xf58 0xf26 0xf2b 0xf47 0xf6e 0xf2d 0xf59 0xee7 0xed4 0xe82 0xe58 0xe79 0xeba 0xed3 0xf2f 0xf4a 0xf7b 0xf3f 0xf3d 0xf6e 0xf93 0xf5c 0xf77 0xf04 0xefa 0xea1 0xe71 0xe7e 0xec8 0xee1 0xf38 0xf5f 0xf93 0xf55 0xf4a 0xf42 0xf66 0xf28 0xf4d 0xec2 0xebe 0xe6d 0xe3d 0xe7e 0xec5 0xeda 0xf32 0xf46 0xf97 0xf65 0xf4e 0xf7c 0xf93 0xf50 0xf77 0xee0 0xed9 0xe89 0xe4e 0xeb3 0xf00 0xf0f 0xf5e 0xf98 0xfce 0xfa8 0xf96 0xf86 0xf96 0xf55 0xf7c 0xef6 0xedd 0xe8d 0xe54 0xe94 0xee2 0xedb 0xf38 0xf7a 0xfc0 0xf97 0xf7f 0xfb4 0xfc9 0xf7f 0xfa8 0xf18 0xefd 0xe9b 0xe70 0xe9a 0xeec 0xedb 0xf28 0xf7a 0xfbb 0xf9f 0xf8a 0xf89 0xfa5 0xf5c 0xf75 0xef6 0xedd 0xe70 0xe40 0xe62 0xe60 0xe36 0xe3c 0xe05 0xe2a 0xe27 0xe56 0xdc2 0xe21 0xdf4 0xdf3 0xe07 0xe59 0xe62 0xeb7 0xe5f 0xe62 0xe31 0xe3f 0xe07 0xe21 0xe21 0xe52 0xdbf 0xe1a 0xdf7 0xe04 0xe04 0xe51 0xe54 0xea3 0xe67 0xe78 0xe40 0xe4a 0xe16 0xe2e 0xe2b 0xe55 0xdf3 0xe3f 0xe2a 0xe3f 0xe3a 0xe89 0xe86 0xebd 0xe44 0xe5c 0xe13 0xe2c 0xdf3 0xe13 0xe15 0xe36 0xdde 0xe35 0xe12 0xe3d 0xe3d 0xe86 0xe7b 0xeb4 0xe7e 0xea2 0xe63 0xe6a 0xe40 0xe51 0xe51 0xe72 0xe1d 0xe62 0xe4f 0xe7e 0xe70 0xeaf 0xea1 0xecc 0xe86 0xead 0xe72 0xe83 0xe4e 0xe66 0xe5c 0xe7e 0xdfe 0xe40 0xe35 0xe5f 0xe55 0xe93 0xe7f 0xeaf 0xe69 0xe9f 0xe67 0xe6d 0xe41 0xe5b 0xe4a 0xe6d 0xe00 0xe43 0xe36 0xe5d 0xe58 0xe9c 0xe8c 0xeb3 0xe51 0xe82 0xe52 0xe59 0xe28 0xe4b 0xe40 0xe5f 0xe28 0xe4a 0xe4e 0xe79 0xe72 0xeb4 0xe9a 0xeb4 0xe64 0xead 0xe74 0xe78 0xe4d 0xe63 0xe5f 0xe7f 0xe21 0xe5b 0xe56 0xe7e 0xe7b 0xeb7 0xeaa 0xead 0xe39 0xe85 0xe4e 0xe52 0xe25 0xe3f 0xe38 0xe51 0xdf7 0xe2e 0xe20 0xe48 0xe3d 0xe7e 0xe6d 0xe71 0xe46 0xeac 0xe6d 0xe83 0xe44 0xe67 0xe62 0xe7b 0xdfb 0xe46 0xe2f 0xe59 0xe4f 0xe8a 0xe72 0xe63 0xe59 0xeaf 0xe74 0xe8e 0xe4e 0xe6d 0xe6b 0xe7b 0xe0e 0xe4e 0xe32 0xe5f 0xe59 0xe9c 0xe80 0xe74 0xe36 0xe97 0xe66 0xe79 0xe39 0xe60 0xe58 0xe63 0xe10 0xe52 0xe3f 0xe5c 0xe4f 0xe97 0xe6d 0xe56 0xd41 0xe9e 0xd63 0xe8c 0xd44 0xe7e 0xd5f 0xe78 0xcf7 0xe3a 0xd13 0xe44 0xd2b 0xe7f 0xd3d 0xe40 0xd39 0xd79 0xd66 0xd7c 0xd48 0xd72 0xd66 0xd74 0xd1a 0xd53 0xd39 0xd58 0xd4c 0xd84 0xd59 0xd4a 0xd6e 0xdb1 0xda3 0xdbc 0xd86 0xdad 0xd9e 0xdb1 0xd7c 0xdb5 0xd95 0xdb7 0xda9 0xddf 0xdac 0xd9b 0xc8b 0xdb5 0xda9 0xdc6 0xd8d 0xdb7 0xda7 0xdba 0xd63 0xda9 0xd7b 0xdaa 0xd95 0xdd0 0xd97 0xca4 0xc29 0xd9e 0xd92 0xdc6 0xd7c 0xd9e 0xd8e 0xda9 0xd63 0xda9 0xd79 0xda3 0xda6 0xdcd 0xd8d 0xc5d 0x1400 0x1400 0x1400>;
					PS_Config_Lmt_Short_Rawdata_N = <0x2774 0x2774 0x2774 0x2774 0x2774 0x2774 0x2774 0x2774 0x2774 0x2774 0x2774 0x2774 0x2774 0x2774 0x2774 0x2774 0x2774 0x2774 0x2774 0x2774 0x2774 0x2774 0x2774 0x2774 0x2774 0x2774 0x2774 0x2774 0x2774 0x2774 0x2774 0x2774 0x2774 0x2774 0x2774 0x2774 0x2774 0x2774 0x2774 0x2774 0x2774 0x2774 0x2774 0x2774 0x2774 0x2774 0x2774 0x2774 0x2774 0x2774 0x2774 0x2774 0x2774 0x2774 0x2774 0x2774 0x2774 0x2774 0x2774 0x2774 0x2774 0x2774 0x2774 0x2774 0x2774 0x2774 0x2774 0x2774 0x2774 0x2774 0x2774 0x2774 0x2774 0x2774 0x2774 0x2774 0x2774 0x2774 0x2774 0x2774 0x2774 0x2774 0x2774 0x2774 0x2774 0x2774 0x2774 0x2774 0x2774 0x2774 0x2774 0x2774 0x2774 0x2774 0x2774 0x2774 0x2774 0x2774 0x2774 0x2774 0x2774 0x2774 0x2774 0x2774 0x2774 0x2774 0x2774 0x2774 0x2774 0x2774 0x2774 0x2774 0x2774 0x2774 0x2774 0x2774 0x2774 0x2774 0x2774 0x2774 0x2774 0x2774 0x2774 0x2774 0x2774 0x2774 0x2774 0x2774 0x2774 0x2774 0x2774 0x2774 0x2774 0x2774 0x2774 0x2774 0x2774 0x2774 0x2774 0x2774 0x2774 0x2774 0x2774 0x2774 0x2774 0x2774 0x2774 0x2774 0x2774 0x2774 0x2774 0x2774 0x2774 0x2774 0x2774 0x2774 0x2774 0x2774 0x2774 0x2774 0x2774 0x2774 0x2774 0x2774 0x2774 0x2774 0x2774 0x2774 0x2774 0x2774 0x2774 0x2774 0x2774 0x2774 0x2774 0x2774 0x2774 0x2774 0x2774 0x2774 0x2774 0x2774 0x2774 0x2774 0x2774 0x2774 0x2774 0x2774 0x2774 0x2774 0x2774 0x2774 0x2774 0x2774 0x2774 0x2774 0x2774 0x2774 0x2774 0x2774 0x2774 0x2774 0x2774 0x2774 0x2774 0x2774 0x2774 0x2774 0x2774 0x2774 0x2774 0x2774 0x2774 0x2774 0x2774 0x2774 0x2774 0x2774 0x2774 0x2774 0x2774 0x2774 0x2774 0x2774 0x2774 0x2774 0x2774 0x2774 0x2774 0x2774 0x2774 0x2774 0x2774 0x2774 0x2774 0x2774 0x2774 0x2774 0x2774 0x2774 0x2774 0x2774 0x2774 0x2774 0x2774 0x2774 0x2774 0x2774 0x2774 0x2774 0x2774 0x2774 0x2774 0x2774 0x2774 0x2774 0x2774 0x2774 0x2774 0x2774 0x2774 0x2774 0x2774 0x2774 0x2774 0x2774 0x2774 0x2774 0x2774 0x2774 0x2774 0x2774 0x2774 0x2774 0x2774 0x2774 0x2774 0x2774 0x2774 0x2774 0x2774 0x2774 0x2774 0x2774 0x2774 0x2774 0x2774 0x2774 0x2774 0x2774 0x2774 0x2774 0x2774 0x2774 0x2774 0x2774 0x2774 0x2774 0x2774 0x2774 0x2774 0x2774 0x2774 0x2774 0x2774 0x2774 0x2774 0x2774 0x2774 0x2774 0x2774 0x2774 0x2774 0x2774 0x2774 0x2774 0x2774 0x2774 0x2774 0x2774 0x2774 0x2774 0x2774 0x2774 0x2774 0x2774 0x2774 0x2774 0x2774 0x2774 0x2774 0x2774 0x2774 0x2774 0x2774 0x2774 0x2774 0x2774 0x2774 0x2774 0x2774 0x2774 0x2774 0x2774 0x2774 0x2774 0x2774 0x2774 0x2774 0x2774 0x2774 0x2774 0x2774 0x2774 0x2774 0x2774 0x2774 0x2774 0x2774 0x2774 0x2774 0x2774 0x2774 0x2774 0x2774 0x2774 0x2774 0x2774 0x2774 0x2774 0x2774 0x2774 0x2774 0x2774 0x2774 0x2774 0x2774 0x2774 0x2774 0x2774 0x2774 0x2774 0x2774 0x2774 0x2774 0x2774 0x2774 0x2774 0x2774 0x2774 0x2774 0x2774 0x2774 0x2774 0x2774 0x2774 0x2774 0x2774 0x2774 0x2774 0x2774 0x2774 0x2774 0x2774 0x2774 0x2774 0x2774 0x2774 0x2774 0x2774 0x2774 0x2774 0x2774 0x2774 0x2774 0x2774 0x2774 0x2774 0x2774 0x2774 0x2774 0x2774 0x2774 0x2774 0x2774 0x2774 0x2774 0x2774 0x2774 0x2774 0x2774 0x2774 0x2774 0x2774 0x2774 0x2774 0x2774 0x2774 0x2774 0x2774 0x2774 0x2774 0x2774 0x2774 0x2774 0x2774 0x2774 0x2774 0x2774 0x2774 0x2774 0x2774 0x2774 0x2774 0x2774 0x2774 0x2774 0x2774 0x2774 0x2774 0x2774 0x2774 0x2774 0x2774 0x2774 0x2774 0x2774 0x2774 0x2774 0x2774 0x2774 0x2774 0x2774 0x2774 0x2774 0x2774 0x2774 0x2774 0x2774 0x2774 0x2774 0x2774 0x2774 0x2774 0x2774 0x2774 0x2774 0x2774 0x2774 0x2774 0x2774 0x2774 0x2774 0x2774 0x2774 0x2774 0x2774 0x2774 0x2774 0x2774 0x2774 0x2774 0x2774 0x2774 0x2774 0x2774 0x2774 0x2774 0x2774 0x2774 0x2774 0x2774 0x2774 0x2774 0x2774 0x2774 0x2774 0x2774 0x2774 0x2774 0x2774 0x2774 0x2774 0x2774 0x2774 0x2774 0x2774 0x2774 0x2774 0x2774 0x2774 0x2774 0x2774 0x2774 0x2774 0x2774 0x2774 0x2774 0x2774 0x2774 0x2774 0x2774 0x2774 0x2774 0x2774 0x2774 0x2774 0x2774 0x2774 0x2774 0x2774 0x2774 0x2774 0x2774 0x2774 0x2774 0x2774 0x2774 0x2774 0x2774 0x2774 0x2774 0x2774 0x2774 0x2774 0x2774 0x2774 0x2774 0x2774 0x2774 0x2774 0x2774 0x2774 0x2774 0x2774 0x2774 0x2710 0x2710 0x2710>;
					PS_Config_Lmt_Short_Rawdata_P = <0x36b8 0x36b8 0x36b8 0x36b8 0x36b8 0x36b8 0x36b8 0x36b8 0x36b8 0x36b8 0x36b8 0x36b8 0x36b8 0x36b8 0x36b8 0x36b8 0x36b8 0x36b8 0x36b8 0x36b8 0x36b8 0x36b8 0x36b8 0x36b8 0x36b8 0x36b8 0x36b8 0x36b8 0x36b8 0x36b8 0x36b8 0x36b8 0x36b8 0x36b8 0x36b8 0x36b8 0x36b8 0x36b8 0x36b8 0x36b8 0x36b8 0x36b8 0x36b8 0x36b8 0x36b8 0x36b8 0x36b8 0x36b8 0x36b8 0x36b8 0x36b8 0x36b8 0x36b8 0x36b8 0x36b8 0x36b8 0x36b8 0x36b8 0x36b8 0x36b8 0x36b8 0x36b8 0x36b8 0x36b8 0x36b8 0x36b8 0x36b8 0x36b8 0x36b8 0x36b8 0x36b8 0x36b8 0x36b8 0x36b8 0x36b8 0x36b8 0x36b8 0x36b8 0x36b8 0x36b8 0x36b8 0x36b8 0x36b8 0x36b8 0x36b8 0x36b8 0x36b8 0x36b8 0x36b8 0x36b8 0x36b8 0x36b8 0x36b8 0x36b8 0x36b8 0x36b8 0x36b8 0x36b8 0x36b8 0x36b8 0x36b8 0x36b8 0x36b8 0x36b8 0x36b8 0x36b8 0x36b8 0x36b8 0x36b8 0x36b8 0x36b8 0x36b8 0x36b8 0x36b8 0x36b8 0x36b8 0x36b8 0x36b8 0x36b8 0x36b8 0x36b8 0x36b8 0x36b8 0x36b8 0x36b8 0x36b8 0x36b8 0x36b8 0x36b8 0x36b8 0x36b8 0x36b8 0x36b8 0x36b8 0x36b8 0x36b8 0x36b8 0x36b8 0x36b8 0x36b8 0x36b8 0x36b8 0x36b8 0x36b8 0x36b8 0x36b8 0x36b8 0x36b8 0x36b8 0x36b8 0x36b8 0x36b8 0x36b8 0x36b8 0x36b8 0x36b8 0x36b8 0x36b8 0x36b8 0x36b8 0x36b8 0x36b8 0x36b8 0x36b8 0x36b8 0x36b8 0x36b8 0x36b8 0x36b8 0x36b8 0x36b8 0x36b8 0x36b8 0x36b8 0x36b8 0x36b8 0x36b8 0x36b8 0x36b8 0x36b8 0x36b8 0x36b8 0x36b8 0x36b8 0x36b8 0x36b8 0x36b8 0x36b8 0x36b8 0x36b8 0x36b8 0x36b8 0x36b8 0x36b8 0x36b8 0x36b8 0x36b8 0x36b8 0x36b8 0x36b8 0x36b8 0x36b8 0x36b8 0x36b8 0x36b8 0x36b8 0x36b8 0x36b8 0x36b8 0x36b8 0x36b8 0x36b8 0x36b8 0x36b8 0x36b8 0x36b8 0x36b8 0x36b8 0x36b8 0x36b8 0x36b8 0x36b8 0x36b8 0x36b8 0x36b8 0x36b8 0x36b8 0x36b8 0x36b8 0x36b8 0x36b8 0x36b8 0x36b8 0x36b8 0x36b8 0x36b8 0x36b8 0x36b8 0x36b8 0x36b8 0x36b8 0x36b8 0x36b8 0x36b8 0x36b8 0x36b8 0x36b8 0x36b8 0x36b8 0x36b8 0x36b8 0x36b8 0x36b8 0x36b8 0x36b8 0x36b8 0x36b8 0x36b8 0x36b8 0x36b8 0x36b8 0x36b8 0x36b8 0x36b8 0x36b8 0x36b8 0x36b8 0x36b8 0x36b8 0x36b8 0x36b8 0x36b8 0x36b8 0x36b8 0x36b8 0x36b8 0x36b8 0x36b8 0x36b8 0x36b8 0x36b8 0x36b8 0x36b8 0x36b8 0x36b8 0x36b8 0x36b8 0x36b8 0x36b8 0x36b8 0x36b8 0x36b8 0x36b8 0x36b8 0x36b8 0x36b8 0x36b8 0x36b8 0x36b8 0x36b8 0x36b8 0x36b8 0x36b8 0x36b8 0x36b8 0x36b8 0x36b8 0x36b8 0x36b8 0x36b8 0x36b8 0x36b8 0x36b8 0x36b8 0x36b8 0x36b8 0x36b8 0x36b8 0x36b8 0x36b8 0x36b8 0x36b8 0x36b8 0x36b8 0x36b8 0x36b8 0x36b8 0x36b8 0x36b8 0x36b8 0x36b8 0x36b8 0x36b8 0x36b8 0x36b8 0x36b8 0x36b8 0x36b8 0x36b8 0x36b8 0x36b8 0x36b8 0x36b8 0x36b8 0x36b8 0x36b8 0x36b8 0x36b8 0x36b8 0x36b8 0x36b8 0x36b8 0x36b8 0x36b8 0x36b8 0x36b8 0x36b8 0x36b8 0x36b8 0x36b8 0x36b8 0x36b8 0x36b8 0x36b8 0x36b8 0x36b8 0x36b8 0x36b8 0x36b8 0x36b8 0x36b8 0x36b8 0x36b8 0x36b8 0x36b8 0x36b8 0x36b8 0x36b8 0x36b8 0x36b8 0x36b8 0x36b8 0x36b8 0x36b8 0x36b8 0x36b8 0x36b8 0x36b8 0x36b8 0x36b8 0x36b8 0x36b8 0x36b8 0x36b8 0x36b8 0x36b8 0x36b8 0x36b8 0x36b8 0x36b8 0x36b8 0x36b8 0x36b8 0x36b8 0x36b8 0x36b8 0x36b8 0x36b8 0x36b8 0x36b8 0x36b8 0x36b8 0x36b8 0x36b8 0x36b8 0x36b8 0x36b8 0x36b8 0x36b8 0x36b8 0x36b8 0x36b8 0x36b8 0x36b8 0x36b8 0x36b8 0x36b8 0x36b8 0x36b8 0x36b8 0x36b8 0x36b8 0x36b8 0x36b8 0x36b8 0x36b8 0x36b8 0x36b8 0x36b8 0x36b8 0x36b8 0x36b8 0x36b8 0x36b8 0x36b8 0x36b8 0x36b8 0x36b8 0x36b8 0x36b8 0x36b8 0x36b8 0x36b8 0x36b8 0x36b8 0x36b8 0x36b8 0x36b8 0x36b8 0x36b8 0x36b8 0x36b8 0x36b8 0x36b8 0x36b8 0x36b8 0x36b8 0x36b8 0x36b8 0x36b8 0x36b8 0x36b8 0x36b8 0x36b8 0x36b8 0x36b8 0x36b8 0x36b8 0x36b8 0x36b8 0x36b8 0x36b8 0x36b8 0x36b8 0x36b8 0x36b8 0x36b8 0x36b8 0x36b8 0x36b8 0x36b8 0x36b8 0x36b8 0x36b8 0x36b8 0x36b8 0x36b8 0x36b8 0x36b8 0x36b8 0x36b8 0x36b8 0x36b8 0x36b8 0x36b8 0x36b8 0x36b8 0x36b8 0x36b8 0x36b8 0x36b8 0x36b8 0x36b8 0x36b8 0x36b8 0x36b8 0x36b8 0x36b8 0x36b8 0x36b8 0x36b8 0x36b8 0x36b8 0x36b8 0x36b8 0x36b8 0x36b8 0x36b8 0x36b8 0x36b8 0x36b8 0x36b8 0x36b8 0x36b8 0x36b8 0x36b8 0x36b8 0x36b8 0x36b8 0x36b8 0x36b8 0x36b8 0x36b8 0x36b8 0x36b8 0x36b8 0x36b8 0x36b8 0x36b8 0x36b8 0x36b8 0x36b8 0x36b8 0x36b8 0x36b8 0x36b8 0x36b8 0x36b8 0x36b8 0x36b8 0x36b8 0x36b8 0x36b8 0x36b8 0x36b8 0x36b8 0x36b8 0x36b8 0x36b8 0x36b8 0x36b8 0x36b8 0x36b8 0x36b8 0x36b8 0x36b8 0x36b8 0x36b8 0x36b8>;
					X_Channel = <0x10>;
					Y_Channel = <0x24>;
					compatible = "novatek-mp-criteria-625B";
				};
			};
		};
	};

	fragment@22 {
		target = <0xffffffff>;

		__overlay__ {

			adc_channel@ {
				compatible = "mediatek,adc_channel";
				mediatek,adc_fdd_rf_params_dynamic_custom_ch = <0x2>;
				mediatek,temperature0 = <0x0>;
				mediatek,temperature1 = <0x1>;
				status = "okay";
			};
		};
	};

	fragment@23 {
		target = <0xffffffff>;

		__overlay__ {
			io-channels = <0xffffffff 0x2>;
		};
	};

	fragment@24 {
		target = <0xffffffff>;

		__overlay__ {
			mediatek,clkbuf-config = <0x2 0x1 0x1 0x2 0x2 0x2 0x2>;
			mediatek,clkbuf-driving-current = <0x1 0x1 0x1 0x1 0x1 0x1 0x1>;
			mediatek,clkbuf-quantity = <0x7>;
			status = "okay";
		};
	};

	fragment@25 {
		target = <0xffffffff>;

		__overlay__ {
			#address-cells = <0x1>;
			#size-cells = <0x0>;
			clock-frequency = <0x61a80>;
			mediatek,use-open-drain;
		};
	};

	fragment@26 {
		target = <0xffffffff>;

		__overlay__ {
			#address-cells = <0x1>;
			#size-cells = <0x0>;
			clock-frequency = <0x61a80>;
			mediatek,use-open-drain;
		};
	};

	fragment@27 {
		target = <0xffffffff>;

		__overlay__ {
			#address-cells = <0x1>;
			#size-cells = <0x0>;
			clock-frequency = <0x61a80>;
			mediatek,use-open-drain;

			camera_main_two@10 {
				compatible = "mediatek,camera_main_two";
				phandle = <0x60>;
				reg = <0x10>;
				status = "okay";
			};

			camera_sub@36 {
				compatible = "mediatek,camera_sub";
				phandle = <0x61>;
				reg = <0x36>;
				status = "okay";
			};

			camera_sub_eeprom@51 {
				compatible = "mediatek,camera_sub_eeprom";
				phandle = <0x62>;
				reg = <0x51>;
				status = "okay";
			};

			ccu_sensor_i2c_2_hw@11 {
				compatible = "mediatek,ccu_sensor_i2c_2_hw";
				phandle = <0x63>;
				reg = <0x11>;
				status = "okay";
			};
		};
	};

	fragment@28 {
		target = <0xffffffff>;

		__overlay__ {
			#address-cells = <0x1>;
			#size-cells = <0x0>;
			clock-frequency = <0x61a80>;
			mediatek,use-open-drain;

			camera_sub_two@40 {
				compatible = "mediatek,camera_sub_two";
				phandle = <0x65>;
				reg = <0x40>;
				status = "okay";
			};

			nfc@08 {
				compatible = "mediatek,nfc";
				phandle = <0x64>;
				reg = <0x8>;
				status = "okay";
			};
		};
	};

	fragment@29 {
		target = <0xffffffff>;

		__overlay__ {
			#address-cells = <0x1>;
			#size-cells = <0x0>;
			clock-frequency = <0x61a80>;
			mediatek,use-open-drain;

			camera_main@10 {
				compatible = "mediatek,camera_main";
				phandle = <0x66>;
				reg = <0x10>;
				status = "okay";
			};

			camera_main_af@0c {
				compatible = "mediatek,camera_main_af";
				phandle = <0x68>;
				reg = <0xc>;
				status = "okay";
			};

			camera_main_eeprom@50 {
				compatible = "mediatek,camera_main_eeprom";
				phandle = <0x67>;
				reg = <0x50>;
				status = "okay";
			};

			ccu_sensor_i2c_4_hw@12 {
				compatible = "mediatek,ccu_sensor_i2c_4_hw";
				phandle = <0x69>;
				reg = <0x12>;
				status = "okay";
			};
		};
	};

	fragment@3 {
		target = <0xffffffff>;

		__overlay__ {

			fingerprint@0 {
				compatible = "tran_fp";
				debounce = <0x7 0x0>;
				interrupt-parent = <0xffffffff>;
				interrupts = <0x7 0x1 0x7 0x0>;
				irq-gpio = <0x7>;
				irq-gpio-std = <0xffffffff 0x7 0x0>;
				pinctrl-0 = <0x1>;
				pinctrl-1 = <0x2>;
				pinctrl-2 = <0x3>;
				pinctrl-3 = <0x4>;
				pinctrl-4 = <0x5>;
				pinctrl-names = "tran_fp_default", "tran_fp_pin_irq", "tran_fp_irq_pull_down", "tran_fp_reset_high", "tran_fp_reset_low";
				reg = <0x0>;
				reset-gpio = <0x6>;
				reset-gpio-std = <0xffffffff 0x6 0x0>;
				spi-max-frequency = <0x19bfcc0>;
				status = "okay";
			};
		};
	};

	fragment@30 {
		target = <0xffffffff>;

		__overlay__ {
			#address-cells = <0x1>;
			#size-cells = <0x0>;
			clock-frequency = <0x61a80>;
			mediatek,use-open-drain;
		};
	};

	fragment@31 {
		target = <0xffffffff>;

		__overlay__ {
			#address-cells = <0x1>;
			#size-cells = <0x0>;
			clock-frequency = <0x61a80>;
			mediatek,use-open-drain;

			i2c_lcd_bias@3e {
				compatible = "mediatek,i2c_lcd_bias";
				phandle = <0x6a>;
				reg = <0x3e>;
				status = "okay";
			};

			strobe_main@63 {
				compatible = "mediatek,strobe_main";
				phandle = <0x6b>;
				reg = <0x63>;
				status = "okay";
			};
		};
	};

	fragment@32 {
		target = <0xffffffff>;

		__overlay__ {
			#address-cells = <0x1>;
			#size-cells = <0x0>;
			clock-frequency = <0x61a80>;
			mediatek,use-open-drain;
		};
	};

	fragment@33 {
		target = <0xffffffff>;

		__overlay__ {
			#address-cells = <0x1>;
			#size-cells = <0x0>;
			clock-frequency = <0x61a80>;
			mediatek,use-open-drain;
		};
	};

	fragment@34 {
		target = <0xffffffff>;

		__overlay__ {
			GPIO_FDD_BAND_SUPPORT_DETECT_1ST_PIN = <0xffffffff 0x44 0x0>;
			GPIO_FDD_BAND_SUPPORT_DETECT_2ND_PIN = <0xffffffff 0x41 0x0>;
			GPIO_FDD_BAND_SUPPORT_DETECT_3RD_PIN = <0xffffffff 0x42 0x0>;
			GPIO_SIM1_HOT_PLUG = <0xffffffff 0x2f 0x0>;
			GPIO_SIM1_SCLK = <0xffffffff 0xac 0x0>;
			GPIO_SIM1_SIO = <0xffffffff 0xae 0x0>;
			GPIO_SIM1_SRST = <0xffffffff 0xad 0x0>;
			GPIO_SIM2_SCLK = <0xffffffff 0x9d 0x0>;
			GPIO_SIM2_SIO = <0xffffffff 0x9b 0x0>;
			GPIO_SIM2_SRST = <0xffffffff 0x9c 0x0>;
		};
	};

	fragment@35 {
		target = <0xffffffff>;

		__overlay__ {
			gpio_init_default = <0x0 0x0 0x1 0x0 0x1 0x0 0x1 0x1 0x0 0x0 0x0 0x1 0x1 0x1 0x2 0x0 0x0 0x0 0x1 0x0 0x1 0x3 0x0 0x0 0x0 0x1 0x0 0x1 0x4 0x0 0x0 0x0 0x1 0x1 0x0 0x5 0x0 0x0 0x0 0x1 0x1 0x0 0x6 0x0 0x1 0x0 0x1 0x0 0x0 0x7 0x0 0x0 0x0 0x1 0x0 0x0 0x8 0x0 0x0 0x0 0x1 0x1 0x0 0x9 0x0 0x0 0x0 0x1 0x0 0x0 0xa 0x0 0x0 0x0 0x1 0x1 0x0 0xb 0x1 0x0 0x0 0x1 0x0 0x0 0xc 0x2 0x0 0x0 0x1 0x0 0x0 0xd 0x2 0x0 0x0 0x1 0x0 0x0 0xe 0x2 0x1 0x0 0x0 0x0 0x0 0xf 0x2 0x1 0x0 0x0 0x0 0x0 0x10 0x2 0x1 0x0 0x0 0x0 0x0 0x11 0x2 0x0 0x0 0x1 0x0 0x0 0x12 0x2 0x1 0x0 0x0 0x0 0x0 0x13 0x2 0x1 0x0 0x0 0x0 0x0 0x14 0x2 0x1 0x0 0x0 0x0 0x0 0x15 0x5 0x0 0x0 0x1 0x0 0x0 0x16 0x5 0x0 0x0 0x1 0x0 0x0 0x17 0x0 0x1 0x0 0x0 0x0 0x0 0x18 0x5 0x0 0x0 0x1 0x0 0x0 0x19 0x2 0x1 0x0 0x1 0x0 0x0 0x1a 0x2 0x1 0x0 0x1 0x0 0x0 0x1b 0x2 0x1 0x0 0x1 0x0 0x0 0x1c 0x2 0x0 0x0 0x0 0x0 0x0 0x1d 0x0 0x1 0x0 0x0 0x0 0x0 0x1e 0x0 0x1 0x0 0x0 0x0 0x0 0x1f 0x0 0x0 0x0 0x1 0x0 0x0 0x20 0x1 0x0 0x0 0x1 0x0 0x0 0x21 0x1 0x1 0x0 0x1 0x0 0x0 0x22 0x1 0x1 0x0 0x1 0x0 0x0 0x23 0x1 0x1 0x0 0x1 0x0 0x0 0x24 0x0 0x1 0x0 0x0 0x0 0x0 0x25 0x0 0x1 0x0 0x1 0x0 0x0 0x26 0x0 0x1 0x0 0x0 0x0 0x0 0x27 0x0 0x0 0x0 0x1 0x1 0x1 0x28 0x0 0x1 0x0 0x1 0x0 0x0 0x29 0x0 0x0 0x0 0x1 0x1 0x1 0x2a 0x0 0x1 0x0 0x0 0x0 0x0 0x2b 0x1 0x1 0x0 0x1 0x0 0x0 0x2c 0x1 0x0 0x0 0x1 0x0 0x0 0x2d 0x0 0x1 0x0 0x1 0x0 0x0 0x2e 0x0 0x1 0x0 0x1 0x0 0x0 0x2f 0x1 0x0 0x0 0x1 0x1 0x0 0x30 0x1 0x0 0x0 0x1 0x1 0x1 0x31 0x1 0x0 0x0 0x1 0x1 0x1 0x32 0x1 0x0 0x0 0x1 0x1 0x1 0x33 0x1 0x0 0x0 0x1 0x1 0x1 0x34 0x1 0x0 0x0 0x1 0x0 0x0 0x35 0x1 0x0 0x0 0x1 0x0 0x0 0x36 0x1 0x0 0x0 0x1 0x0 0x0 0x37 0x1 0x0 0x0 0x1 0x0 0x0 0x38 0x1 0x0 0x0 0x1 0x0 0x0 0x39 0x1 0x0 0x0 0x1 0x0 0x0 0x3a 0x0 0x0 0x0 0x1 0x0 0x0 0x3b 0x1 0x0 0x0 0x1 0x0 0x0 0x3c 0x1 0x0 0x0 0x1 0x0 0x0 0x3d 0x1 0x0 0x0 0x1 0x0 0x0 0x3e 0x1 0x0 0x0 0x1 0x0 0x0 0x3f 0x1 0x0 0x0 0x1 0x0 0x0 0x40 0x1 0x0 0x0 0x1 0x0 0x0 0x41 0x0 0x0 0x0 0x1 0x0 0x0 0x42 0x0 0x0 0x0 0x1 0x0 0x0 0x43 0x0 0x0 0x0 0x1 0x0 0x0 0x44 0x0 0x0 0x0 0x1 0x0 0x0 0x45 0x1 0x0 0x0 0x1 0x0 0x0 0x46 0x1 0x0 0x0 0x1 0x0 0x0 0x47 0x1 0x0 0x0 0x1 0x0 0x0 0x48 0x1 0x0 0x0 0x1 0x0 0x0 0x49 0x1 0x0 0x0 0x1 0x0 0x0 0x4a 0x1 0x0 0x0 0x1 0x0 0x0 0x4b 0x1 0x0 0x0 0x1 0x0 0x0 0x4c 0x1 0x0 0x0 0x1 0x0 0x0 0x4d 0x1 0x0 0x0 0x1 0x0 0x0 0x4e 0x1 0x0 0x0 0x1 0x0 0x0 0x4f 0x0 0x0 0x0 0x1 0x0 0x0 0x50 0x0 0x0 0x0 0x1 0x1 0x0 0x51 0x2 0x0 0x0 0x1 0x1 0x1 0x52 0x1 0x0 0x0 0x1 0x1 0x1 0x53 0x1 0x0 0x0 0x1 0x1 0x1 0x54 0x2 0x0 0x0 0x1 0x1 0x1 0x55 0x2 0x0 0x0 0x1 0x0 0x0 0x56 0x2 0x1 0x0 0x0 0x0 0x0 0x57 0x2 0x1 0x0 0x0 0x0 0x0 0x58 0x2 0x1 0x0 0x0 0x0 0x0 0x59 0x1 0x0 0x0 0x1 0x1 0x1 0x5a 0x1 0x0 0x0 0x1 0x1 0x1 0x5b 0x0 0x1 0x0 0x0 0x0 0x0 0x5c 0x0 0x1 0x0 0x0 0x0 0x0 0x5d 0x1 0x0 0x0 0x1 0x1 0x0 0x5e 0x1 0x0 0x0 0x1 0x1 0x0 0x5f 0x1 0x0 0x0 0x1 0x1 0x0 0x60 0x1 0x1 0x0 0x0 0x0 0x0 0x61 0x0 0x1 0x0 0x0 0x0 0x0 0x62 0x0 0x1 0x0 0x0 0x0 0x0 0x63 0x1 0x1 0x0 0x0 0x0 0x0 0x64 0x1 0x1 0x0 0x0 0x0 0x0 0x65 0x0 0x1 0x0 0x0 0x0 0x0 0x66 0x0 0x1 0x0 0x0 0x0 0x0 0x67 0x1 0x0 0x0 0x1 0x1 0x1 0x68 0x1 0x0 0x0 0x1 0x1 0x1 0x69 0x1 0x0 0x0 0x1 0x1 0x1 0x6a 0x1 0x0 0x0 0x1 0x1 0x1 0x6b 0x0 0x1 0x0 0x0 0x0 0x0 0x6c 0x0 0x0 0x0 0x0 0x0 0x0 0x6d 0x0 0x1 0x0 0x0 0x0 0x0 0x6e 0x0 0x1 0x0 0x0 0x0 0x0 0x6f 0x1 0x1 0x0 0x0 0x0 0x0 0x70 0x0 0x1 0x0 0x0 0x0 0x0 0x71 0x0 0x0 0x0 0x1 0x0 0x0 0x72 0x0 0x0 0x0 0x1 0x0 0x0 0x73 0x0 0x0 0x0 0x1 0x0 0x0 0x74 0x0 0x0 0x0 0x1 0x0 0x0 0x75 0x0 0x0 0x0 0x1 0x0 0x0 0x76 0x0 0x0 0x0 0x1 0x0 0x0 0x77 0x0 0x0 0x0 0x1 0x0 0x0 0x78 0x0 0x0 0x0 0x1 0x0 0x0 0x79 0x0 0x0 0x0 0x1 0x0 0x0 0x86 0x1 0x0 0x0 0x1 0x0 0x1 0x87 0x1 0x1 0x0 0x0 0x0 0x0 0x88 0x1 0x1 0x0 0x0 0x0 0x0 0x89 0x1 0x1 0x0 0x0 0x0 0x0 0x8a 0x1 0x1 0x0 0x0 0x0 0x0 0x8b 0x1 0x1 0x0 0x0 0x0 0x0 0x8c 0x1 0x0 0x0 0x1 0x0 0x0 0x8d 0x1 0x0 0x0 0x1 0x0 0x0 0x8e 0x1 0x0 0x0 0x1 0x0 0x0 0x8f 0x1 0x0 0x0 0x1 0x0 0x0 0x90 0x1 0x0 0x0 0x1 0x0 0x0 0x91 0x1 0x1 0x0 0x0 0x0 0x0 0x92 0x1 0x1 0x0 0x0 0x0 0x0 0x93 0x1 0x1 0x0 0x0 0x0 0x0 0x94 0x1 0x1 0x0 0x0 0x0 0x0 0x95 0x1 0x1 0x0 0x0 0x0 0x0 0x96 0x0 0x1 0x0 0x1 0x0 0x0 0x97 0x0 0x1 0x0 0x1 0x0 0x0 0x98 0x0 0x1 0x0 0x1 0x0 0x0 0x99 0x0 0x1 0x0 0x1 0x0 0x0 0x9a 0x1 0x1 0x0 0x0 0x0 0x0 0x9b 0x1 0x0 0x0 0x1 0x1 0x0 0x9c 0x1 0x1 0x0 0x0 0x0 0x0 0x9d 0x1 0x1 0x0 0x0 0x0 0x0 0x9e 0x1 0x1 0x0 0x0 0x0 0x0 0x9f 0x0 0x1 0x0 0x0 0x0 0x0 0xa0 0x0 0x0 0x0 0x1 0x0 0x0 0xa1 0x1 0x0 0x0 0x1 0x1 0x1 0xa2 0x1 0x0 0x0 0x1 0x1 0x1 0xa3 0x1 0x0 0x0 0x1 0x1 0x1 0xa4 0x1 0x0 0x0 0x1 0x1 0x1 0xa5 0x4 0x1 0x0 0x0 0x0 0x0 0xa6 0x0 0x1 0x0 0x1 0x0 0x0 0xa7 0x1 0x0 0x0 0x1 0x0 0x0 0xa8 0x1 0x0 0x0 0x1 0x0 0x0 0xa9 0x4 0x1 0x0 0x0 0x0 0x0 0xaa 0x1 0x0 0x0 0x1 0x1 0x1 0xab 0x1 0x1 0x0 0x0 0x0 0x1 0xac 0x1 0x1 0x0 0x0 0x0 0x0 0xad 0x1 0x1 0x0 0x0 0x0 0x0 0xae 0x1 0x0 0x0 0x1 0x1 0x0 0xaf 0x1 0x0 0x0 0x1 0x1 0x1 0xb0 0x1 0x0 0x0 0x1 0x1 0x1 0xb2 0x0 0x1 0x0 0x0 0x0 0x0 0xb3 0x0 0x1 0x0 0x1 0x0 0x0 0xb4 0x0 0x0 0x0 0x1 0x0 0x0 0xb5 0x0 0x0 0x0 0x1 0x0 0x0 0xb6 0x0 0x0 0x0 0x1 0x0 0x0 0xb7 0x0 0x0 0x0 0x1 0x0 0x0 0xb8 0x0 0x0 0x0 0x1 0x0 0x0 0xb9 0x0 0x0 0x0 0x1 0x0 0x0 0xba 0x0 0x0 0x0 0x1 0x0 0x0>;
		};
	};

	fragment@36 {
		target = <0xffffffff>;

		__overlay__ {
			interrupt-parent = <0xffffffff>;
			interrupts = <0x1 0x2 0x1 0x0>;
			status = "okay";
		};
	};

	fragment@37 {
		target = <0xffffffff>;

		__overlay__ {
			interrupt-parent = <0xffffffff>;
			interrupts = <0x27 0x8 0x27 0x0>;
			status = "okay";
		};
	};

	fragment@38 {
		target = <0xffffffff>;

		__overlay__ {
			interrupt-parent = <0xffffffff>;
			interrupts = <0x29 0x8 0x29 0x0>;
			status = "okay";
		};
	};

	fragment@39 {
		target = <0xffffffff>;

		__overlay__ {
			interrupt-parent = <0xffffffff>;
			interrupts = <0x2c 0x1 0x2c 0x1>;
			status = "okay";
		};
	};

	fragment@4 {
		target = <0xffffffff>;

		__overlay__ {

			fingerprint_default {
				phandle = <0x1>;
			};

			gpio7_eint {
				phandle = <0x2>;

				pins_cmd_dat {
					bias-disable;
					pinmux = <0x700>;
					slew-rate = <0x0>;
				};
			};

			gpio7_eint_pull_down {
				phandle = <0x3>;

				pins_cmd_dat {
					bias-pull-down = <0x0>;
					output-low;
					pinmux = <0x700>;
					slew-rate = <0x0>;
				};
			};

			rst_out_one {
				phandle = <0x4>;

				pins_cmd_dat {
					bias-disable;
					output-high;
					pinmux = <0x600>;
					slew-rate = <0x1>;
				};
			};

			rst_out_zero {
				phandle = <0x5>;

				pins_cmd_dat {
					bias-disable;
					output-low;
					pinmux = <0x600>;
					slew-rate = <0x1>;
				};
			};
		};
	};

	fragment@40 {
		target = <0xffffffff>;

		__overlay__ {
			interrupt-parent = <0xffffffff>;
			interrupts = <0x90 0x4 0xb4 0x0>;
			status = "okay";
		};
	};

	fragment@41 {
		target = <0xffffffff>;

		__overlay__ {
			compatible = "mediatek,md1_sim1_hot_plug_eint-eint";
			debounce = <0x0 0x2710>;
			dedicated = <0x0 0x0>;
			interrupts = <0x0 0x8>;
			sockettype = <0x0 0x0>;
			src_pin = <0x0 0x1>;
			status = "okay";
		};
	};

	fragment@42 {
		target = <0xffffffff>;

		__overlay__ {
			regulator-default-on = <0x1>;
			regulator-name = "vcama1";
			status = "okay";
		};
	};

	fragment@43 {
		target = <0xffffffff>;

		__overlay__ {
			regulator-default-on = <0x1>;
			regulator-name = "vcama2";
			status = "okay";
		};
	};

	fragment@44 {
		target = <0xffffffff>;

		__overlay__ {
			regulator-default-on = <0x1>;
			regulator-name = "vsim1";
			status = "okay";
		};
	};

	fragment@45 {
		target = <0xffffffff>;

		__overlay__ {
			regulator-default-on = <0x1>;
			regulator-name = "vsim2";
			status = "okay";
		};
	};

	fragment@46 {
		target = <0xffffffff>;

		__overlay__ {
			regulator-default-on = <0x1>;
			regulator-name = "vcamd";
			status = "okay";
		};
	};

	fragment@47 {
		target = <0xffffffff>;

		__overlay__ {
			regulator-default-on = <0x1>;
			regulator-name = "vcamio";
			status = "okay";
		};
	};

	fragment@48 {
		target = <0xffffffff>;

		__overlay__ {
			regulator-default-on = <0x1>;
			regulator-name = "vldo28";
			status = "okay";
		};
	};

	fragment@49 {
		target = <0xffffffff>;

		__overlay__ {
			status = "okay";
			vcama_main2-supply = <0xffffffff>;
			vcama_sub2-supply = <0xffffffff>;
			vcamaf-supply = <0xffffffff>;
			vcamd_sub-supply = <0xffffffff>;
			vcamio-supply = <0xffffffff>;
			vcamio_main2-supply = <0xffffffff>;
			vcamio_sub-supply = <0xffffffff>;
		};
	};

	fragment@5 {
		target = <0xffffffff>;

		__overlay__ {
			clock-frequency = <0x61a80>;

			mtk-usb@60 {
				compatible = "mediatek,mtk-usb";
				reg = <0x60>;
				status = "okay";
			};
		};
	};

	fragment@50 {
		target = <0xffffffff>;

		__overlay__ {
			status = "okay";
			vtouch-supply = <0xffffffff>;
		};
	};

	fragment@51 {
		target = <0xffffffff>;

		__overlay__ {
			mediatek,kpd-hw-dl-key0 = <0x0>;
			mediatek,kpd-hw-dl-key1 = <0x1>;
			mediatek,kpd-hw-dl-key2 = <0x8>;
			mediatek,kpd-hw-factory-key = <0x1>;
			mediatek,kpd-hw-init-map = <0x73 0x72 0x0 0x0 0x0 0x0 0x0 0x0 0x0 0x0 0x0 0x0 0x0 0x0 0x0 0x0 0x0 0x0 0x0 0x0 0x0 0x0 0x0 0x0 0x0 0x0 0x0 0x0 0x0 0x0 0x0 0x0 0x0 0x0 0x0 0x0 0x0 0x0 0x0 0x0 0x0 0x0 0x0 0x0 0x0 0x0 0x0 0x0 0x0 0x0 0x0 0x0 0x0 0x0 0x0 0x0 0x0 0x0 0x0 0x0 0x0 0x0 0x0 0x0 0x0 0x0 0x0 0x0 0x0 0x0 0x0 0x0>;
			mediatek,kpd-hw-map-num = <0x48>;
			mediatek,kpd-hw-pwrkey = <0x8>;
			mediatek,kpd-hw-recovery-key = <0x0>;
			mediatek,kpd-key-debounce = <0x400>;
			mediatek,kpd-pwkey-gpio-din = <0x0>;
			mediatek,kpd-pwrkey-eint-gpio = <0x0>;
			mediatek,kpd-sw-pwrkey = <0x74>;
			mediatek,kpd-use-extend-type = <0x0>;
			status = "okay";
		};
	};

	fragment@52 {
		target = <0xffffffff>;

		__overlay__ {

			camdefault {
				phandle = <0x24>;
			};

			camera0_mclk_2mA@gpio100 {
				phandle = <0x3c>;

				pins_cmd_dat {
					drive-strength = <0x2>;
					pinmux = <0x6401>;
				};
			};

			camera0_mclk_4mA@gpio100 {
				phandle = <0x3d>;

				pins_cmd_dat {
					drive-strength = <0x4>;
					pinmux = <0x6401>;
				};
			};

			camera0_mclk_6mA@gpio100 {
				phandle = <0x3e>;

				pins_cmd_dat {
					drive-strength = <0x6>;
					pinmux = <0x6401>;
				};
			};

			camera0_mclk_8mA@gpio100 {
				phandle = <0x3f>;

				pins_cmd_dat {
					drive-strength = <0x7>;
					pinmux = <0x6401>;
				};
			};

			camera0_mclk_gpio_mode@gpio100 {
				phandle = <0x3b>;

				pins_cmd_dat {
					drive-strength = <0x4>;
					pinmux = <0x6400>;
				};
			};

			camera0_pdn_output_high@gpio98 {
				phandle = <0x28>;

				pins_cmd_dat {
					output-high;
					pinmux = <0x6200>;
				};
			};

			camera0_pdn_output_low@gpio98 {
				phandle = <0x27>;

				pins_cmd_dat {
					output-low;
					pinmux = <0x6200>;
				};
			};

			camera0_rst_output_high@gpio102 {
				phandle = <0x26>;

				pins_cmd_dat {
					output-high;
					pinmux = <0x6600>;
				};
			};

			camera0_rst_output_low@gpio102 {
				phandle = <0x25>;

				pins_cmd_dat {
					output-low;
					pinmux = <0x6600>;
				};
			};

			camera0_vcama_output_high@gpio23 {
				phandle = <0x33>;

				pins_cmd_dat {
					output-high;
					pinmux = <0x1700>;
				};
			};

			camera0_vcama_output_high@gpio40 {
				phandle = <0x35>;

				pins_cmd_dat {
					output-high;
					pinmux = <0x2800>;
				};
			};

			camera0_vcama_output_low@gpio23 {
				phandle = <0x34>;

				pins_cmd_dat {
					output-low;
					pinmux = <0x1700>;
				};
			};

			camera0_vcama_output_low@gpio40 {
				phandle = <0x36>;

				pins_cmd_dat {
					output-low;
					pinmux = <0x2800>;
				};
			};

			camera1_mclk_2mA@gpio99 {
				phandle = <0x41>;

				pins_cmd_dat {
					drive-strength = <0x2>;
					pinmux = <0x6301>;
				};
			};

			camera1_mclk_4mA@gpio99 {
				phandle = <0x42>;

				pins_cmd_dat {
					drive-strength = <0x4>;
					pinmux = <0x6301>;
				};
			};

			camera1_mclk_6mA@gpio99 {
				phandle = <0x43>;

				pins_cmd_dat {
					drive-strength = <0x6>;
					pinmux = <0x6301>;
				};
			};

			camera1_mclk_8mA@gpio99 {
				phandle = <0x44>;

				pins_cmd_dat {
					drive-strength = <0x7>;
					pinmux = <0x6301>;
				};
			};

			camera1_mclk_gpio_mode@gpio99 {
				phandle = <0x40>;

				pins_cmd_dat {
					drive-strength = <0x4>;
					pinmux = <0x6300>;
				};
			};

			camera1_pdn_output_high@gpio97 {
				phandle = <0x2c>;

				pins_cmd_dat {
					output-high;
					pinmux = <0x6100>;
				};
			};

			camera1_pdn_output_low@gpio97 {
				phandle = <0x2b>;

				pins_cmd_dat {
					output-low;
					pinmux = <0x6100>;
					slew-rate = <0x1>;
				};
			};

			camera1_rst_output_high@gpio101 {
				phandle = <0x2a>;

				pins_cmd_dat {
					output-high;
					pinmux = <0x6500>;
				};
			};

			camera1_rst_output_low@gpio101 {
				phandle = <0x29>;

				pins_cmd_dat {
					output-low;
					pinmux = <0x6500>;
				};
			};

			camera1_vcama_output_high@gpio23 {
				phandle = <0x37>;

				pins_cmd_dat {
					output-high;
					pinmux = <0x1700>;
				};
			};

			camera1_vcama_output_low@gpio23 {
				phandle = <0x38>;

				pins_cmd_dat {
					output-low;
					pinmux = <0x1700>;
				};
			};

			camera2_mclk_2mA@gpio111 {
				phandle = <0x46>;

				pins_cmd_dat {
					drive-strength = <0x2>;
					pinmux = <0x6f01>;
				};
			};

			camera2_mclk_4mA@gpio111 {
				phandle = <0x47>;

				pins_cmd_dat {
					drive-strength = <0x4>;
					pinmux = <0x6f01>;
				};
			};

			camera2_mclk_6mA@gpio111 {
				phandle = <0x48>;

				pins_cmd_dat {
					drive-strength = <0x6>;
					pinmux = <0x6f01>;
				};
			};

			camera2_mclk_8mA@gpio111 {
				phandle = <0x49>;

				pins_cmd_dat {
					drive-strength = <0x7>;
					pinmux = <0x6f01>;
				};
			};

			camera2_mclk_gpio_mode@gpio111 {
				phandle = <0x45>;

				pins_cmd_dat {
					drive-strength = <0x4>;
					pinmux = <0x6f00>;
				};
			};

			camera2_pdn_output_high@gpio110 {
				phandle = <0x30>;

				pins_cmd_dat {
					output-high;
					pinmux = <0x6e00>;
				};
			};

			camera2_pdn_output_low@gpio110 {
				phandle = <0x2f>;

				pins_cmd_dat {
					output-low;
					pinmux = <0x6e00>;
				};
			};

			camera2_rst_output_high@gpio112 {
				phandle = <0x2e>;

				pins_cmd_dat {
					output-high;
					pinmux = <0x7000>;
				};
			};

			camera2_rst_output_low@gpio112 {
				phandle = <0x2d>;

				pins_cmd_dat {
					output-low;
					pinmux = <0x7000>;
				};
			};

			camera2_vcama_output_high@gpio46 {
				phandle = <0x39>;

				pins_cmd_dat {
					output-high;
					pinmux = <0x2e00>;
				};
			};

			camera2_vcama_output_low@gpio46 {
				phandle = <0x3a>;

				pins_cmd_dat {
					output-low;
					pinmux = <0x2e00>;
				};
			};

			camera3_mclk_2mA@gpio111 {
				phandle = <0x4b>;

				pins_cmd_dat {
					drive-strength = <0x2>;
					pinmux = <0x6f01>;
				};
			};

			camera3_mclk_4mA@gpio111 {
				phandle = <0x4c>;

				pins_cmd_dat {
					drive-strength = <0x4>;
					pinmux = <0x6f01>;
				};
			};

			camera3_mclk_6mA@gpio111 {
				phandle = <0x4d>;

				pins_cmd_dat {
					drive-strength = <0x6>;
					pinmux = <0x6f01>;
				};
			};

			camera3_mclk_8mA@gpio111 {
				phandle = <0x4e>;

				pins_cmd_dat {
					drive-strength = <0x7>;
					pinmux = <0x6f01>;
				};
			};

			camera3_mclk_gpio_mode@gpio111 {
				phandle = <0x4a>;

				pins_cmd_dat {
					drive-strength = <0x4>;
					pinmux = <0x6f00>;
				};
			};

			camera3_pdn_output_high@gpio36 {
				phandle = <0x32>;

				pins_cmd_dat {
					output-high;
					pinmux = <0x2400>;
				};
			};

			camera3_pdn_output_low@gpio36 {
				phandle = <0x31>;

				pins_cmd_dat {
					output-low;
					pinmux = <0x2400>;
				};
			};
		};
	};

	fragment@53 {
		target = <0xffffffff>;

		__overlay__ {
			cam0_vcamaf-supply = <0xffffffff>;
			cam0_vcamio-supply = <0xffffffff>;
			cam1_vcamd-supply = <0xffffffff>;
			cam1_vcamio-supply = <0xffffffff>;
			cam2_vcama-supply = <0xffffffff>;
			cam2_vcamio-supply = <0xffffffff>;
			cam3_vcama-supply = <0xffffffff>;
			pinctrl-0 = <0x24>;
			pinctrl-1 = <0x25>;
			pinctrl-10 = <0x2e>;
			pinctrl-11 = <0x2f>;
			pinctrl-12 = <0x30>;
			pinctrl-13 = <0x31>;
			pinctrl-14 = <0x32>;
			pinctrl-15 = <0x33>;
			pinctrl-16 = <0x34>;
			pinctrl-17 = <0x35>;
			pinctrl-18 = <0x36>;
			pinctrl-19 = <0x37>;
			pinctrl-2 = <0x26>;
			pinctrl-20 = <0x38>;
			pinctrl-21 = <0x39>;
			pinctrl-22 = <0x3a>;
			pinctrl-23 = <0x3b>;
			pinctrl-24 = <0x3c>;
			pinctrl-25 = <0x3d>;
			pinctrl-26 = <0x3e>;
			pinctrl-27 = <0x3f>;
			pinctrl-28 = <0x40>;
			pinctrl-29 = <0x41>;
			pinctrl-3 = <0x27>;
			pinctrl-30 = <0x42>;
			pinctrl-31 = <0x43>;
			pinctrl-32 = <0x44>;
			pinctrl-33 = <0x45>;
			pinctrl-34 = <0x46>;
			pinctrl-35 = <0x47>;
			pinctrl-36 = <0x48>;
			pinctrl-37 = <0x49>;
			pinctrl-38 = <0x4a>;
			pinctrl-39 = <0x4b>;
			pinctrl-4 = <0x28>;
			pinctrl-40 = <0x4c>;
			pinctrl-41 = <0x4d>;
			pinctrl-42 = <0x4e>;
			pinctrl-5 = <0x29>;
			pinctrl-6 = <0x2a>;
			pinctrl-7 = <0x2b>;
			pinctrl-8 = <0x2c>;
			pinctrl-9 = <0x2d>;
			pinctrl-names = "default", "cam0_rst0", "cam0_rst1", "cam0_pnd0", "cam0_pnd1", "cam1_rst0", "cam1_rst1", "cam1_pnd0", "cam1_pnd1", "cam2_rst0", "cam2_rst1", "cam2_pnd0", "cam2_pnd1", "cam3_pnd0", "cam3_pnd1", "cam0_vcama_on", "cam0_vcama_off", "cam0_vcamd_on", "cam0_vcamd_off", "cam1_vcama_on", "cam1_vcama_off", "cam2_vcamd_on", "cam2_vcamd_off", "cam0_mclk_off", "cam0_mclk_2mA", "cam0_mclk_4mA", "cam0_mclk_6mA", "cam0_mclk_8mA", "cam1_mclk_off", "cam1_mclk_2mA", "cam1_mclk_4mA", "cam1_mclk_6mA", "cam1_mclk_8mA", "cam2_mclk_off", "cam2_mclk_2mA", "cam2_mclk_4mA", "cam2_mclk_6mA", "cam2_mclk_8mA", "cam3_mclk_off", "cam3_mclk_2mA", "cam3_mclk_4mA", "cam3_mclk_6mA", "cam3_mclk_8mA";
			status = "okay";
		};
	};

	fragment@54 {
		target = <0xffffffff>;

		__overlay__ {

			aw36515default {
				phandle = <0x4f>;
			};

			aw36515hwen_high {
				phandle = <0x50>;

				pins_cmd_dat {
					output-high;
					pinmux = <0xa900>;
					slew-rate = <0x1>;
				};
			};

			aw36515hwen_low {
				phandle = <0x51>;

				pins_cmd_dat {
					output-low;
					pinmux = <0xa900>;
					slew-rate = <0x1>;
				};
			};
		};
	};

	fragment@55 {
		target = <0xffffffff>;

		__overlay__ {
			pinctrl-0 = <0x4f>;
			pinctrl-1 = <0x50>;
			pinctrl-2 = <0x51>;
			pinctrl-names = "aw36515default", "aw36515hwen_high", "aw36515hwen_low";
			status = "okay";
		};
	};

	fragment@56 {
		target = <0xffffffff>;

		__overlay__ {

			ocp81375default {
				phandle = <0x52>;
			};

			ocp81375hwen_high {
				phandle = <0x53>;

				pins_cmd_dat {
					output-high;
					pinmux = <0xa900>;
					slew-rate = <0x1>;
				};
			};

			ocp81375hwen_low {
				phandle = <0x54>;

				pins_cmd_dat {
					output-low;
					pinmux = <0xa900>;
					slew-rate = <0x1>;
				};
			};
		};
	};

	fragment@57 {
		target = <0xffffffff>;

		__overlay__ {
			pinctrl-0 = <0x52>;
			pinctrl-1 = <0x53>;
			pinctrl-2 = <0x54>;
			pinctrl-names = "ocp81375default", "ocp81375hwen_high", "ocp81375hwen_low";
			status = "okay";
		};
	};

	fragment@6 {
		target = <0xffffffff>;

		__overlay__ {
			accdet-mic-mode = <0x1>;
			accdet-mic-vol = <0x6>;
			accdet-plugout-debounce = <0x1>;
			headset-eint-level-pol = <0x8>;
			headset-four-key-threshold = <0x0 0x3a 0x79 0xc0 0x190>;
			headset-mode-setting = <0x500 0x500 0x1 0x1f0 0x800 0x800 0x20 0x44>;
			headset-three-key-threshold = <0x0 0x50 0xdc 0x190>;
			headset-three-key-threshold-CDD = <0x0 0x79 0xc0 0x258>;
			status = "okay";
		};
	};

	fragment@7 {
		target = <0xffffffff>;

		__overlay__ {
			mt6370,intr_gpio = <0xffffffff 0x14 0x0>;
			mt6370,intr_gpio_num = <0x14>;
		};
	};

	fragment@8 {
		target = <0xffffffff>;

		__overlay__ {
			mt6370pd,intr_gpio = <0xffffffff 0x29 0x0>;
			mt6370pd,intr_gpio_num = <0x29>;
		};
	};

	fragment@9 {
		target = <0xffffffff>;

		__overlay__ {

			consys_default {
				phandle = <0x6>;
			};

			fmgpio@3 {
				phandle = <0xa>;

				pins_cmd_dat {
					output-high;
					pinmux = <0x5c00>;
					slew-rate = <0x1>;
				};
			};

			fmgpio@4 {
				phandle = <0xb>;

				pins_cmd_dat {
					output-low;
					pinmux = <0x5c00>;
					slew-rate = <0x1>;
				};
			};

			gpslna@0 {
				phandle = <0x7>;

				pins_cmd_dat {
					bias-disable;
					output-low;
					pinmux = <0x5b00>;
					slew-rate = <0x0>;
				};
			};

			gpslna@1 {
				phandle = <0x8>;

				pins_cmd_dat {
					output-high;
					pinmux = <0x5b00>;
					slew-rate = <0x1>;
				};
			};

			gpslna@2 {
				phandle = <0x9>;

				pins_cmd_dat {
					output-low;
					pinmux = <0x5b00>;
					slew-rate = <0x1>;
				};
			};
		};
	};
};
